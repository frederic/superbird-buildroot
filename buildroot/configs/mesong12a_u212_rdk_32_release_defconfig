## buildroot/configs/txlx_t962e_r321_release_defconfig
```kconfig
# Mirrors and Download locations
BR2_BACKUP_SITE="http://openlinux.amlogic.com:8000/download/GPL_code_release/ThirdParty"
# Architecture
BR2_aarch64=y
BR2_ARM_ENABLE_NEON=y
BR2_ARM_FPU_NEON=y
BR2_TOOLCHAIN_EXTERNAL_LINARO_AARCH64_6DOT2_201702_PREINSTALLED=y
BR2_DEPRECATED=y
BR2_TOOLCHAIN_EXTERNAL=y
BR2_TOOLCHAIN_EXTERNAL_PREINSTALLED=y
BR2_TOOLCHAIN_EXTERNAL_PATH="$(TOPDIR)/../toolchain/gcc/linux-x86/aarch64/gcc-linaro-6.3.1-2017.02-x86_64_aarch64-linux-gnu"
BR2_KERNEL_TOOLCHAIN_PATH="$(TOPDIR)/../toolchain/gcc/linux-x86/aarch64/gcc-linaro-6.3.1-2017.02-x86_64_aarch64-linux-gnu"
BR2_KERNEL_TOOLCHAIN_LINARO_AARCH64_201702=y
#BR2_ENABLE_DEBUG=y
BR2_PACKAGE_BUSYBOX_SHOW_OTHERS=y
BR2_PACKAGE_HOST_GDB=y
BR2_PACKAGE_ALSA_UTILS=y
# FFTW for alsabat
BR2_PACKAGE_FFTW=y
BR2_PACKAGE_FFTW_FAST=y
#
# ALSA utils selection
#
BR2_PACKAGE_ALSA_UTILS_ALSACTL=y
BR2_PACKAGE_ALSA_UTILS_ALSACONF=y
BR2_PACKAGE_ALSA_UTILS_AMIXER=y
BR2_PACKAGE_ALSA_UTILS_ALSAMIXER=y
BR2_PACKAGE_ALSA_UTILS_APLAY=y
BR2_PACKAGE_ALSA_UTILS_ALSALOOP=y
BR2_PACKAGE_ALSA_UTILS_ALSATPLG=y
BR2_PACKAGE_ALSA_UTILS_BAT=y
BR2_PACKAGE_ALSA_UTILS_IECSET=y
BR2_PACKAGE_ALSA_UTILS_SPEAKER_TEST=y
BR2_PACKAGE_AMAUDIO=y
#BR2_PACKAGE_AML_LIBS=y
#
# Gstreamer 1
#
BR2_PACKAGE_GSTREAMER1=y
BR2_PACKAGE_GSTREAMER1_PARSE=y
BR2_PACKAGE_GSTREAMER1_TRACE=y
BR2_PACKAGE_GSTREAMER1_GST_DEBUG=y
BR2_PACKAGE_GSTREAMER1_PLUGIN_REGISTRY=y
BR2_PACKAGE_GSTREAMER1_INSTALL_TOOLS=y
BR2_PACKAGE_GST1_PLUGINS_BASE=y

#
# dependency-less plugins
#
BR2_PACKAGE_GST1_PLUGINS_BASE_PLUGIN_APP=y
BR2_PACKAGE_GST1_PLUGINS_BASE_PLUGIN_AUDIOCONVERT=y
BR2_PACKAGE_GST1_PLUGINS_BASE_PLUGIN_VIDEOCONVERT=y
BR2_PACKAGE_GST1_PLUGINS_BASE_PLUGIN_PLAYBACK=y
BR2_PACKAGE_GST1_PLUGINS_BASE_PLUGIN_AUDIORESAMPLE=y
BR2_PACKAGE_GST1_PLUGINS_BASE_PLUGIN_SUBPARSE=y
BR2_PACKAGE_GST1_PLUGINS_BASE_PLUGIN_TYPEFIND=y
BR2_PACKAGE_GST1_PLUGINS_BASE_PLUGIN_VIDEOSCALE=y
BR2_PACKAGE_GST1_PLUGINS_BASE_PLUGIN_VOLUME=y

#
# plugins with external dependencies
#
BR2_PACKAGE_GST1_PLUGINS_BASE_PLUGIN_OGG=y
BR2_PACKAGE_GST1_PLUGINS_GOOD=y
BR2_PACKAGE_GST1_PLUGINS_GOOD_ZLIB=y

#
# dependency-less plugins
#
BR2_PACKAGE_GST1_PLUGINS_GOOD_PLUGIN_ALPHA=y
BR2_PACKAGE_GST1_PLUGINS_GOOD_PLUGIN_APETAG=y
BR2_PACKAGE_GST1_PLUGINS_GOOD_PLUGIN_AUDIOPARSERS=y
BR2_PACKAGE_GST1_PLUGINS_GOOD_PLUGIN_AUPARSE=y
BR2_PACKAGE_GST1_PLUGINS_GOOD_PLUGIN_AUTODETECT=y
BR2_PACKAGE_GST1_PLUGINS_GOOD_PLUGIN_AVI=y
BR2_PACKAGE_GST1_PLUGINS_GOOD_PLUGIN_DEINTERLACE=y
BR2_PACKAGE_GST1_PLUGINS_GOOD_PLUGIN_FLV=y
BR2_PACKAGE_GST1_PLUGINS_GOOD_PLUGIN_ICYDEMUX=y
BR2_PACKAGE_GST1_PLUGINS_GOOD_PLUGIN_ID3DEMUX=y
BR2_PACKAGE_GST1_PLUGINS_GOOD_PLUGIN_ISOMP4=y
BR2_PACKAGE_GST1_PLUGINS_GOOD_PLUGIN_MATROSKA=y
BR2_PACKAGE_GST1_PLUGINS_GOOD_PLUGIN_RTP=y
BR2_PACKAGE_GST1_PLUGINS_GOOD_PLUGIN_RTPMANAGER=y
BR2_PACKAGE_GST1_PLUGINS_GOOD_PLUGIN_RTSP=y
BR2_PACKAGE_GST1_PLUGINS_GOOD_PLUGIN_UDP=y
BR2_PACKAGE_GST1_PLUGINS_GOOD_PLUGIN_VIDEOFILTER=y

#
# plugins with external dependencies
#
BR2_PACKAGE_GST1_PLUGINS_GOOD_PLUGIN_SOUPHTTPSRC=y
BR2_PACKAGE_GST1_PLUGINS_GOOD_PLUGIN_TAGLIB=y
BR2_PACKAGE_GST1_PLUGINS_BAD=y

#
# dependency-less plugins
#
BR2_PACKAGE_GST1_PLUGINS_BAD_PLUGIN_AIFF=y
BR2_PACKAGE_GST1_PLUGINS_BAD_PLUGIN_AUTOCONVERT=y
BR2_PACKAGE_GST1_PLUGINS_BAD_PLUGIN_ID3TAG=y
BR2_PACKAGE_GST1_PLUGINS_BAD_PLUGIN_INTERLACE=y
BR2_PACKAGE_GST1_PLUGINS_BAD_PLUGIN_IVFPARSE=y
BR2_PACKAGE_GST1_PLUGINS_BAD_PLUGIN_MPEGDEMUX=y
BR2_PACKAGE_GST1_PLUGINS_BAD_PLUGIN_MPEGTSDEMUX=y
BR2_PACKAGE_GST1_PLUGINS_BAD_PLUGIN_PCAPPARSE=y
BR2_PACKAGE_GST1_PLUGINS_BAD_PLUGIN_RAWPARSE=y
BR2_PACKAGE_GST1_PLUGINS_BAD_PLUGIN_SMOOTH=y
BR2_PACKAGE_GST1_PLUGINS_BAD_PLUGIN_VIDEOFILTERS=y
BR2_PACKAGE_GST1_PLUGINS_BAD_PLUGIN_VIDEOPARSERS=y

#
# plugins with external dependencies
#
BR2_PACKAGE_GST1_PLUGINS_BAD_PLUGIN_BZ2=y
BR2_PACKAGE_GST1_PLUGINS_BAD_PLUGIN_CURL=y
BR2_PACKAGE_GST1_PLUGINS_BAD_PLUGIN_DASH=y
BR2_PACKAGE_GST1_PLUGINS_BAD_PLUGIN_DIRECTFB=y
#
# gl needs the gst1-plugins-bad opengl library
#
BR2_PACKAGE_GST1_PLUGINS_BAD_PLUGIN_HLS=y
BR2_PACKAGE_GST1_PLUGINS_UGLY=y

#
# dependency-less plugins
#
BR2_PACKAGE_GST1_PLUGINS_UGLY_PLUGIN_ASFDEMUX=y
BR2_PACKAGE_GST1_PLUGINS_UGLY_PLUGIN_REALMEDIA=y

#
# plugins with external dependencies (there may be more available)
#
BR2_PACKAGE_GST1_VALIDATE=y

#
# gst-omx requires a OpenMAX implementation
#
BR2_PACKAGE_KODI_ARCH_SUPPORTS=y
BR2_PACKAGE_KODI_EGL_GLES=y
BR2_PACKAGE_GST_AML_PLUGINS1=y
BR2_PACKAGE_MPLAYER_ARCH_SUPPORTS=y
BR2_PACKAGE_WAVPACK=y

#
# Audio/Sound
#
BR2_PACKAGE_ALSA_LIB=y
BR2_PACKAGE_LIBSAMPLERATE=y

#
# ALSA lib selection
#
BR2_PACKAGE_ALSA_LIB_DEVDIR="/dev/snd"
BR2_PACKAGE_ALSA_LIB_PCM_PLUGINS="all"
BR2_PACKAGE_ALSA_LIB_CTL_PLUGINS="all"
BR2_PACKAGE_ALSA_LIB_ALOAD=y
BR2_PACKAGE_ALSA_LIB_MIXER=y
BR2_PACKAGE_ALSA_LIB_PCM=y
BR2_PACKAGE_ALSA_LIB_RAWMIDI=y
BR2_PACKAGE_ALSA_LIB_HWDEP=y
BR2_PACKAGE_ALSA_LIB_SEQ=y
BR2_PACKAGE_ALSA_LIB_ALISP=y
BR2_PACKAGE_ALSA_LIB_OLD_SYMBOLS=y
BR2_PACKAGE_LIBID3TAG=y
BR2_PACKAGE_LIBMAD=y
BR2_PACKAGE_LIBMAD_OPTIMIZATION_DEFAULT=y
BR2_PACKAGE_LIBMAD_ASO=y
BR2_PACKAGE_LIBPLAYER=y
BR2_PACKAGE_GDB=y
BR2_PACKAGE_GDB_SERVER=y
BR2_PACKAGE_GDB_DEBUGGER=y
BR2_PACKAGE_DIRECTFB=y
BR2_PACKAGE_E2FSPROGS=y
BR2_PACKAGE_FBDUMP=y
BR2_PACKAGE_FBGRAB=y
BR2_PACKAGE_FBSET=y
BR2_PACKAGE_FBTERM=y
BR2_PACKAGE_FB_TEST_APP=y
BR2_PACKAGE_UTIL_LINUX_BINARIES=y
# other GUIs
BR2_PACKAGE_QT5=y
BR2_PACKAGE_QT5BASE=y
BR2_PACKAGE_QT5BASE_LICENSE_APPROVED=y
BR2_PACKAGE_QT5BASE_NETWORK=y
BR2_PACKAGE_QT5BASE_CONCURRENT=y
BR2_PACKAGE_QT5BASE_SQL=y
BR2_PACKAGE_QT5BASE_SQLITE_SYSTEM=y
BR2_PACKAGE_QT5BASE_TEST=y
BR2_PACKAGE_QT5BASE_XML=y
BR2_PACKAGE_QT5BASE_GUI=y
BR2_PACKAGE_QT5BASE_WIDGETS=y
BR2_PACKAGE_QT5BASE_LINUXFB=y
BR2_PACKAGE_QT5BASE_DIRECTFB=y

#
# X.org XCB backend available if X.org is enabled
#
BR2_PACKAGE_QT5BASE_EGLFS=y
BR2_PACKAGE_QT5BASE_PRINTSUPPORT=y
BR2_PACKAGE_QT5BASE_FONTCONFIG=y
BR2_PACKAGE_QT5BASE_GIF=y
BR2_PACKAGE_QT5BASE_JPEG=y
BR2_PACKAGE_QT5BASE_PNG=y
BR2_PACKAGE_QT5BASE_DBUS=y
BR2_PACKAGE_QT5BASE_ICU=y
BR2_PACKAGE_QT5BASE_TSLIB=y
BR2_PACKAGE_QT5DECLARATIVE=y
BR2_PACKAGE_QT5GRAPHICALEFFECTS=y
BR2_PACKAGE_QT5IMAGEFORMATS=y
BR2_PACKAGE_QT5MULTIMEDIA=y
BR2_PACKAGE_QT5QUICKCONTROLS=y
BR2_PACKAGE_QT5SCRIPT=y
BR2_PACKAGE_QT5SENSORS=y
BR2_PACKAGE_QT5SERIALPORT=y
BR2_PACKAGE_QT5SVG=y
BR2_PACKAGE_QT5WEBKIT=y
BR2_PACKAGE_QT5XMLPATTERNS=y
BR2_PACKAGE_QT5BASE_EXAMPLES=y
BR2_PACKAGE_OPENSSL=y
BR2_PACKAGE_OPENSSL_BIN=y
BR2_PACKAGE_OPENSSL_ENGINES=y
BR2_PACKAGE_SQLITE=y
BR2_PACKAGE_CAIRO_SCRIPT=y
BR2_PACKAGE_LIBJPEG=y
BR2_PACKAGE_JPEG=y
BR2_PACKAGE_TSLIB=y
BR2_PACKAGE_NCURSES=y
BR2_PACKAGE_NCURSES_TARGET_PANEL=y
BR2_PACKAGE_NCURSES_TARGET_FORM=y
BR2_PACKAGE_NCURSES_TARGET_MENU=y
BR2_PACKAGE_KMOD=y
BR2_PACKAGE_PANGO=y
BR2_PACKAGE_REMOTECFG=y
BR2_PACKAGE_LIBCARES=y
BR2_PACKAGE_LIBCURL=y
BR2_PACKAGE_BOOST=y
BR2_PACKAGE_LIBEVENT=y
BR2_PACKAGE_ICU=y
BR2_PACKAGE_CJSON=y
BR2_PACKAGE_LIBXSLT=y
BR2_SYSTEM_DHCP="eth0"
BR2_PACKAGE_NETPLUG=y
BR2_PACKAGE_DHCPCD=y
BR2_PACKAGE_DNSMASQ=y
BR2_PACKAGE_DNSMASQ_TFTP=n
BR2_PACKAGE_DNSMASQ_DHCP=n
BR2_PACKAGE_IW=y
BR2_PACKAGE_WPA_SUPPLICANT=y
BR2_PACKAGE_WPA_SUPPLICANT_CLI=y
BR2_PACKAGE_LIBNL=y
BR2_PACKAGE_VIM=y
BR2_PACKAGE_NTFS_3G=y
BR2_TARGET_ROOTFS_CPIO=y
BR2_TARGET_ROOTFS_CPIO_GZIP=y
BR2_TARGET_ROOTFS_CPIO_UIMAGE=y
BR2_TARGET_ROOTFS_INITRAMFS_LIST="board/amlogic/txlx_t962e_r321/initramfs/ramfslist-64"
BR2_TARGET_ROOTFS_EXT2=y
BR2_TARGET_ROOTFS_EXT2_4=y
BR2_TARGET_ROOTFS_EXT2_SIZE="768M"
BR2_TARGET_ROOTFS_TAR_GZIP=y
BR2_ROOTFS_DEVICE_CREATION_DYNAMIC_EUDEV=y
BR2_ROOTFS_COMMON_OVERLAY="board/amlogic/common/rootfs/rootfs-49/"
BR2_ROOTFS_OVERLAY="board/amlogic/txlx_t962e_r321/rootfs/"
BR2_ROOTFS_UPGRADE_DIR="board/amlogic/common/upgrade/upgrade-txlx/"
BR2_ROOTFS_UPGRADE_DIR_OVERLAY="board/amlogic/txlx_t962e_r321/upgrade/"
BR2_LINUX_KERNEL=y
BR2_LINUX_KERNEL_CUSTOM_LOCAL_VERSION_VALUE="amlogic-4.9-dev"
BR2_LINUX_KERNEL_CUSTOM_LOCAL=y
BR2_LINUX_KERNEL_CUSTOM_LOCAL_PATH="$(TOPDIR)/../kernel/aml-4.9"
BR2_LINUX_KERNEL_DEFCONFIG="meson64"
BR2_LINUX_KERNEL_CONFIG_FRAGMENT_FILES="board/amlogic/common/kernel_config/kernel49/drm-v0-4.9.fragment"
BR2_TARGET_BOARD_PLATFORM="meson8"
BR2_LINUX_KERNEL_IMAGE_LOADADDR="0x1008000"
BR2_LINUX_KERNEL_PATCH="amlogic-4.9"
BR2_LINUX_KERNEL_DTS_SUPPORT=y
BR2_LINUX_KERNEL_USE_INTREE_DTS=y
BR2_LINUX_KERNEL_INTREE_DTS_NAME="txlx_t962e_r321_buildroot"
BR2_LINUX_KERNEL_AMLOGIC_DTD=y
BR2_LINUX_KERNEL_ANDROID_FORMAT=y
BR2_LINUX_KERNEL_IMAGE=y
BR2_PACKAGE_GPU=y
BR2_PACKAGE_GPU_LOCAL=y
BR2_PACKAGE_GPU_STANDALONE=y
BR2_PACKAGE_GPU_VERSION="r7p0"
BR2_PACKAGE_GPU_LOCAL_PATH="$(TOPDIR)/../hardware/aml-3.14/arm/gpu"
BR2_PACKAGE_WIFI_FW=y
BR2_PACKAGE_WIFI_FW_LOCAL=y
BR2_PACKAGE_WIFI_CUSTOM_GIT_VERSION="m-amlogic"
BR2_PACKAGE_WIFI_FW_CUSTOM_LOCAL_PATH="$(TOPDIR)/../hardware/aml-3.14/amlogic/wifi"
BR2_PACKAGE_WIFI_FW_WIFI_MODULE="bcm4356"
#BR2_PACKAGE_RTK8188EU=y
#BR2_PACKAGE_RTK8188EU_LOCAL=y
#BR2_PACKAGE_RTK8188EU_STANDALONE=y
#BR2_PACKAGE_RTK8188EU_GIT_VERSION="l-amlogic"
#BR2_PACKAGE_RTK8188EU_LOCAL_PATH="$(TOPDIR)/../hardware/aml-3.14/wifi/realtek/drivers/8188eu"
#BR2_PACKAGE_RTK8192CU=y
#BR2_PACKAGE_RTK8192CU_LOCAL=y
#BR2_PACKAGE_RTK8192CU_GIT_VERSION="8192cu"
#BR2_PACKAGE_RTK8192CU_LOCAL_PATH="$(TOPDIR)/../hardware/aml-3.14/wifi/realtek/drivers/8192cu"
#BR2_PACKAGE_RTK8192DU=y
#BR2_PACKAGE_RTK8192DU_LOCAL=y
#BR2_PACKAGE_RTK8192DU_GIT_VERSION="8192du"
#BR2_PACKAGE_RTK8192DU_LOCAL_PATH="$(TOPDIR)/../hardware/aml-3.14/wifi/realtek/drivers/8192du"
#BR2_PACKAGE_RTK8192EU=y
#BR2_PACKAGE_RTK8192EU_LOCAL=y
#BR2_PACKAGE_RTK8192EU_STANDALONE=y
#BR2_PACKAGE_RTK8192EU_GIT_VERSION="m-amlogic"
#BR2_PACKAGE_RTK8192EU_LOCAL_PATH="$(TOPDIR)/../hardware/aml-3.14/wifi/realtek/drivers/8192eu"
BR2_PACKAGE_RTK8189ES=y
BR2_PACKAGE_RTK8189ES_LOCAL=y
BR2_PACKAGE_RTK8189ES_STANDALONE=y
BR2_PACKAGE_RTK8189ES_GIT_VERSION="l-amlogic"
BR2_PACKAGE_RTK8189ES_LOCAL_PATH="$(TOPDIR)/../hardware/aml-3.14/wifi/realtek/drivers/8189es"
#BR2_PACKAGE_RTK8189FTV=y
#BR2_PACKAGE_RTK8189FTV_LOCAL=y
#BR2_PACKAGE_RTK8189FTV_STANDALONE=y
#BR2_PACKAGE_RTK8189FTV_GIT_VERSION="m-amlogic"
#BR2_PACKAGE_RTK8189FTV_LOCAL_PATH="$(TOPDIR)/../hardware/aml-3.14/wifi/realtek/drivers/8189ftv"
#BR2_PACKAGE_RTK8723BS=y
#BR2_PACKAGE_RTK8723BS_LOCAL=y
#BR2_PACKAGE_RTK8723BS_STANDALONE=y
#BR2_PACKAGE_RTK8723BS_GIT_VERSION="l-amlogic"
#BR2_PACKAGE_RTK8723BS_LOCAL_PATH="$(TOPDIR)/../hardware/aml-3.14/wifi/realtek/drivers/8723bs"
#BR2_PACKAGE_RTK8723AU=y
#BR2_PACKAGE_RTK8723AU_LOCAL=y
#BR2_PACKAGE_RTK8723AU_GIT_VERSION="8723au"
#BR2_PACKAGE_RTK8723AU_LOCAL_PATH="$(TOPDIR)/../hardware/aml-3.14/wifi/realtek/drivers/8723au"
#BR2_PACKAGE_RTK8723BU=y
#BR2_PACKAGE_RTK8723BU_LOCAL=y
#BR2_PACKAGE_RTK8723BU_STANDALONE=y
#BR2_PACKAGE_RTK8723BU_GIT_VERSION="m-amlogic"
#BR2_PACKAGE_RTK8723BU_LOCAL_PATH="$(TOPDIR)/../hardware/aml-3.14/wifi/realtek/drivers/8723bu"
#BR2_PACKAGE_RTK8811AU=y
#BR2_PACKAGE_RTK8811AU_LOCAL=y
#BR2_PACKAGE_RTK8811AU_GIT_VERSION="8811au"
#BR2_PACKAGE_RTK8811AU_LOCAL_PATH="$(TOPDIR)/../hardware/aml-3.14/wifi/realtek/drivers/8811au"
#BR2_PACKAGE_RTK8812AU=y
#BR2_PACKAGE_RTK8812AU_LOCAL=y
#BR2_PACKAGE_RTK8812AU_STANDALONE=y
#BR2_PACKAGE_RTK8812AU_GIT_VERSION="m-amlogic"
#BR2_PACKAGE_RTK8812AU_LOCAL_PATH="$(TOPDIR)/../hardware/aml-3.14/wifi/realtek/drivers/8812au"
BR2_PACKAGE_RTK8822BU=y
BR2_PACKAGE_RTK8822BU_LOCAL=y
BR2_PACKAGE_RTK8822BU_STANDALONE=y
BR2_PACKAGE_RTK8822BU_GIT_VERSION="m-amlogic"
BR2_PACKAGE_RTK8822BU_LOCAL_PATH="$(TOPDIR)/../hardware/aml-3.14/wifi/realtek/drivers/8822bu"
BR2_PACKAGE_BRCMAP6XXX=y
BR2_PACKAGE_BRCMAP6XXX_LOCAL=y
BR2_PACKAGE_BRCMAP6XXX_STANDALONE=y
BR2_PACKAGE_BRCMAP6XXX_GIT_VERSION="m-amlogic"
BR2_PACKAGE_BRCMAP6XXX_LOCAL_PATH="$(TOPDIR)/../hardware/aml-3.14/wifi/broadcom/drivers/ap6xxx"
BR2_PACKAGE_BRCMAP6XXX_SDIO_VERSION="bcmdhd.1.363.59.144.x.cn"
BR2_PACKAGE_BRCMAP6XXX_USB_VERSION="bcmdhd-usb.1.363.110.17.x"
#BR2_PACKAGE_BRCMUSI=y
#BR2_PACKAGE_BRCMUSI_LOCAL=y
#BR2_PACKAGE_BRCMUSI_GIT_VERSION="kk-amlogic"
#BR2_PACKAGE_BRCMUSI_LOCAL_PATH="$(TOPDIR)/../hardware/aml-3.14/wifi/broadcom/drivers/usi"
#BR2_PACKAGE_MTK7601=y
#BR2_PACKAGE_MTK7601_LOCAL=y
#BR2_PACKAGE_MTK7601_GIT_VERSION="m-amlogic"
#BR2_PACKAGE_MTK7601_LOCAL_PATH="$(TOPDIR)/../hardware/aml-3.14/wifi/mtk/drivers/mt7601"
#BR2_PACKAGE_MTK7603=y
#BR2_PACKAGE_MTK7603_LOCAL=y
#BR2_PACKAGE_MTK7603_GIT_VERSION="m-amlogic"
#BR2_PACKAGE_MTK7603_LOCAL_PATH="$(TOPDIR)/../hardware/aml-3.14/wifi/mtk/drivers/mt7603"

# bcm bluetooth
BR2_PACKAGE_AML_BRCM_BSA=y

BR2_PACKAGE_AML_UTIL=y
BR2_PACKAGE_MEDIA_MODULES=y
BR2_PACKAGE_MEDIA_MODULES_STANDALONE=y
BR2_PACKAGE_MEDIA_MODULES_LOCAL=y
BR2_PACKAGE_MEDIA_MODULES_LOCAL_PATH="$(TOPDIR)/../hardware/aml-4.9/amlogic/media_modules"
BR2_PACKAGE_MEDIA_MODLUES_VERSION="amlogic-4.9-dev"
BR2_TARGET_UBOOT=y
BR2_TARGET_UBOOT_CUSTOM_LOCAL=y
BR2_TARGET_UBOOT_CUSTOM_LOCAL_VERSION_VALUE="next-2015-dev"
BR2_TARGET_UBOOT_CUSTOM_LOCAL_LOCATION="$(TOPDIR)/../bootloader/uboot-repo"
BR2_TARGET_UBOOT_PATCH=""
BR2_TARGET_UBOOT_BOARDNAME="txlx_t962e_r321_v1"
BR2_TARGET_UBOOT_AMLOGIC_REPO=y
BR2_TARGET_UBOOT_PLATFORM="txlx"
#BR2_PACKAGE_AML_AF_ALG=y
#BR2_PACKAGE_AML_AF_ALG_GIT_URL="git://git.myamlogic.com/vendor/amlogic/external/af_alg.git"
#BR2_PACKAGE_AML_AF_ALG_VERSION="amlogic"
BR2_TARGET_USBTOOL_AMLOGIC=y
#Mali egl
BR2_PACKAGE_MESON_MALI=y
BR2_PACKAGE_PROVIDES_LIBEGL="meson-mali"
BR2_PACKAGE_PROVIDES_LIBGLES="meson-mali"
BR2_PACKAGE_HAS_LIBEGL_WAYLAND=y
BR2_PACKAGE_MESON_MALI_MODEL="m450"
BR2_PACKAGE_MESON_MALI_VERSION="r7p0"
#DRM, for wayland
BR2_PACKAGE_LIBDRM=y
BR2_PACKAGE_LIBDRM_HAS_ATOMIC=y
#Wayland
BR2_PACKAGE_WAYLAND=y
BR2_PACKAGE_WAYLAND_PROTOCOLS=y
BR2_PACKAGE_WESTON=y
BR2_PACKAGE_WESTON_FBDEV=y
#BR2_PACKAGE_WESTON_DRM=y
BR2_PACKAGE_XKEYBOARD_CONFIG=y
BR2_PACKAGE_LIBPTHREAD_STUBS=y
BR2_PACKAGE_LIBINPUT=y
BR2_PACKAGE_LIBXKBCOMMON=y
BR2_PACKAGE_QT5_VERSION_5_6=y
BR2_PACKAGE_QT5WAYLAND=y
#Weston drm
BR2_PACKAGE_LINUX_PAM=y
BR2_PACKAGE_KBD=y
#EUDEV, for wayland
BR2_PACKAGE_EUDEV=y
BR2_PACKAGE_PROVIDES_UDEV="eudev"
BR2_PACKAGE_EUDEV_ENABLE_HWDB=y
BR2_PACKAGE_HAS_UDEV=y
BR2_PACKAGE_MTDEV=y
BR2_PACKAGE_LIBEVDEV=y
#Chromium app
BR2_PACKAGE_CHROMIUM=y
#Wpe app
BR2_PACKAGE_WPE=y
BR2_PACKAGE_LIBWPE=y
BR2_PACKAGE_WPE_USE_WEB_AUDIO=y
BR2_PACKAGE_WPE_LAUNCHER=y
BR2_PACKAGE_WPE_USE_GSTREAMER_WEBKIT_HTTP_SRC=y
BR2_PACKAGE_WPE_USE_PUNCH_HOLE_GSTREAMER=y
#system control
BR2_PACKAGE_SYSTEM_CONTROL=y
#aml launcher
BR2_PACKAGE_AML_LAUNCHER=y
```

## buildroot/package/alsaplayer/Config.in
```kconfig
config BR2_PACKAGE_ALSAPLAYER
	bool "alsaplayer"
	select BR2_PACKAGE_LIBVORBIS
	select BR2_PACKAGE_FLAC
	select BR2_PACKAGE_LIBSNDFILE
    select BR2_PACKAGE_LIBID3TAG
    select BR2_PACKAGE_LIBMAD
    select BR2_PACKAGE_LIBOGG
	help
		alsaplayer is a player for audio that it supports .mp3 .ogg .flac .wav CD file.
```
