## buildroot/configs/mesontm2_ab311_SBR_a6432_release_defconfig
```kconfig
# Mirrors and Download locations
BR2_BACKUP_SITE="http://sources.buildroot.net"
# Architecture
BR2_arm=y
BR2_cortex_a9=y
BR2_ARM_KERNEL_64=y
BR2_ARM_ENABLE_VFP=y
BR2_ARM_ENABLE_NEON=y
BR2_ARM_FPU_NEON=y
BR2_TOOLCHAIN_EXTERNAL_LINARO_ARM_6DOT2_201702_PREINSTALLED=y
BR2_DEPRECATED=y
BR2_TOOLCHAIN_EXTERNAL=y
BR2_TOOLCHAIN_EXTERNAL_PREINSTALLED=y
BR2_TOOLCHAIN_EXTERNAL_PATH="$(TOPDIR)/../toolchain/gcc/linux-x86/arm/gcc-linaro-6.3.1-2017.02-x86_64_arm-linux-gnueabihf"
BR2_KERNEL_TOOLCHAIN_PATH="$(TOPDIR)/../toolchain/gcc/linux-x86/aarch64/gcc-linaro-6.3.1-2017.02-x86_64_aarch64-linux-gnu"
BR2_KERNEL_TOOLCHAIN_LINARO_AARCH64_201702=y
#BR2_ENABLE_DEBUG=y

BR2_LINUX_KERNEL=y
BR2_LINUX_KERNEL_CUSTOM_LOCAL_VERSION_VALUE="amlogic-4.9-dev"
BR2_LINUX_KERNEL_CUSTOM_LOCAL=y
BR2_LINUX_KERNEL_CUSTOM_LOCAL_PATH="$(TOPDIR)/../kernel/aml-4.9"
BR2_LINUX_KERNEL_DEFCONFIG="meson64"
BR2_TARGET_BOARD_PLATFORM="meson8"
BR2_LINUX_KERNEL_IMAGE_LOADADDR="0x1008000"
BR2_LINUX_KERNEL_PATCH="amlogic-4.9"
BR2_LINUX_KERNEL_DTS_SUPPORT=y
BR2_LINUX_KERNEL_USE_INTREE_DTS=y
BR2_LINUX_KERNEL_INTREE_DTS_NAME="tm2_t962e2_ab311_sbr"
BR2_LINUX_KERNEL_AMLOGIC_DTD=y
BR2_LINUX_KERNEL_ANDROID_FORMAT=y
BR2_LINUX_KERNEL_UIMAGE=y
BR2_LINUX_KERNEL_IMAGE=y


BR2_TARGET_UBOOT=y
BR2_TARGET_UBOOT_CUSTOM_LOCAL=y
BR2_TARGET_UBOOT_CUSTOM_LOCAL_VERSION_VALUE="next-2015-dev"
BR2_TARGET_UBOOT_CUSTOM_LOCAL_LOCATION="$(TOPDIR)/../bootloader/uboot-repo"
BR2_TARGET_UBOOT_PATCH=""
BR2_TARGET_UBOOT_BOARDNAME="tm2_t962e2_ab311_v1"
BR2_TARGET_UBOOT_AMLOGIC_REPO=y
BR2_TARGET_UBOOT_PLATFORM="tm2"

BR2_TARGET_ROOTFS_CPIO=y
BR2_TARGET_ROOTFS_CPIO_GZIP=y
BR2_TARGET_ROOTFS_CPIO_UIMAGE=y
BR2_TARGET_ROOTFS_INITRAMFS_LIST="board/amlogic/mesontm2_ab311_sbr/initramfs/ramfslist-32"

BR2_TARGET_ROOTFS_EXT2=y
BR2_TARGET_ROOTFS_EXT2_4=y
BR2_TARGET_ROOTFS_EXT2_SIZE="384M"
BR2_TARGET_ROOTFS_TAR_GZIP=y

BR2_ROOTFS_DEVICE_CREATION_DYNAMIC_EUDEV=y
BR2_ROOTFS_COMMON_OVERLAY="board/amlogic/common/rootfs/rootfs-49/"
BR2_ROOTFS_OVERLAY="board/amlogic/mesontm2_ab311_sbr/rootfs/"
BR2_ROOTFS_UPGRADE_DIR="board/amlogic/common/upgrade/upgrade-tm2/"
BR2_ROOTFS_POST_BUILD_SCRIPT="$(TOPDIR)/board/amlogic/mesontm2_ab311_sbr/post_build.sh"
BR2_RECOVERY_OTA_DIR="board/amlogic/common/ota/ota-tm2/"

BR2_PACKAGE_BUSYBOX_SHOW_OTHERS=y
BR2_PACKAGE_HOST_GDB=y
BR2_PACKAGE_ALSA_UTILS=y
# FFTW for alsabat
BR2_PACKAGE_FFTW=y
BR2_PACKAGE_FFTW_FAST=y
#
# ALSA utils selection
#
BR2_PACKAGE_ALSA_UTILS_ALSACTL=y
BR2_PACKAGE_ALSA_UTILS_ALSACONF=y
BR2_PACKAGE_ALSA_UTILS_AMIXER=y
BR2_PACKAGE_ALSA_UTILS_ALSAMIXER=y
BR2_PACKAGE_ALSA_UTILS_APLAY=y
BR2_PACKAGE_ALSA_UTILS_ALSALOOP=y
BR2_PACKAGE_ALSA_UTILS_ALSATPLG=y
BR2_PACKAGE_ALSA_UTILS_BAT=y
BR2_PACKAGE_ALSA_UTILS_IECSET=y
BR2_PACKAGE_ALSA_UTILS_SPEAKER_TEST=y
BR2_PACKAGE_AMAUDIO=y
#BR2_PACKAGE_AML_LIBS=y
#
# Gstreamer 1
#
BR2_PACKAGE_GSTREAMER1=y
BR2_PACKAGE_GSTREAMER1_PARSE=y
BR2_PACKAGE_GSTREAMER1_TRACE=y
BR2_PACKAGE_GSTREAMER1_GST_DEBUG=y
BR2_PACKAGE_GSTREAMER1_PLUGIN_REGISTRY=y
BR2_PACKAGE_GSTREAMER1_INSTALL_TOOLS=y
BR2_PACKAGE_GST1_PLUGINS_BASE=y

#
# dependency-less plugins
#
BR2_PACKAGE_GST1_PLUGINS_BASE_PLUGIN_APP=y
BR2_PACKAGE_GST1_PLUGINS_BASE_PLUGIN_AUDIOCONVERT=y
BR2_PACKAGE_GST1_PLUGINS_BASE_PLUGIN_VIDEOCONVERT=y
BR2_PACKAGE_GST1_PLUGINS_BASE_PLUGIN_PLAYBACK=y
BR2_PACKAGE_GST1_PLUGINS_BASE_PLUGIN_AUDIORESAMPLE=y
BR2_PACKAGE_GST1_PLUGINS_BASE_PLUGIN_SUBPARSE=y
BR2_PACKAGE_GST1_PLUGINS_BASE_PLUGIN_TYPEFIND=y
BR2_PACKAGE_GST1_PLUGINS_BASE_PLUGIN_VIDEOSCALE=y
BR2_PACKAGE_GST1_PLUGINS_BASE_PLUGIN_VOLUME=y

#
# plugins with external dependencies
#
BR2_PACKAGE_GST1_PLUGINS_BASE_PLUGIN_OGG=y
BR2_PACKAGE_GST1_PLUGINS_GOOD=y
BR2_PACKAGE_GST1_PLUGINS_GOOD_ZLIB=y

#
# dependency-less plugins
#
BR2_PACKAGE_GST1_PLUGINS_GOOD_PLUGIN_ALPHA=y
BR2_PACKAGE_GST1_PLUGINS_GOOD_PLUGIN_APETAG=y
BR2_PACKAGE_GST1_PLUGINS_GOOD_PLUGIN_AUDIOPARSERS=y
BR2_PACKAGE_GST1_PLUGINS_GOOD_PLUGIN_AUPARSE=y
BR2_PACKAGE_GST1_PLUGINS_GOOD_PLUGIN_AUTODETECT=y
BR2_PACKAGE_GST1_PLUGINS_GOOD_PLUGIN_AVI=y
BR2_PACKAGE_GST1_PLUGINS_GOOD_PLUGIN_DEINTERLACE=y
BR2_PACKAGE_GST1_PLUGINS_GOOD_PLUGIN_FLV=y
BR2_PACKAGE_GST1_PLUGINS_GOOD_PLUGIN_ICYDEMUX=y
BR2_PACKAGE_GST1_PLUGINS_GOOD_PLUGIN_ID3DEMUX=y
BR2_PACKAGE_GST1_PLUGINS_GOOD_PLUGIN_ISOMP4=y
BR2_PACKAGE_GST1_PLUGINS_GOOD_PLUGIN_MATROSKA=y
BR2_PACKAGE_GST1_PLUGINS_GOOD_PLUGIN_RTP=y
BR2_PACKAGE_GST1_PLUGINS_GOOD_PLUGIN_RTPMANAGER=y
BR2_PACKAGE_GST1_PLUGINS_GOOD_PLUGIN_RTSP=y
BR2_PACKAGE_GST1_PLUGINS_GOOD_PLUGIN_UDP=y
BR2_PACKAGE_GST1_PLUGINS_GOOD_PLUGIN_VIDEOFILTER=y

#
# plugins with external dependencies
#
BR2_PACKAGE_GST1_PLUGINS_GOOD_PLUGIN_SOUPHTTPSRC=y
BR2_PACKAGE_GST1_PLUGINS_GOOD_PLUGIN_TAGLIB=y
BR2_PACKAGE_GST1_PLUGINS_BAD=y

#
# dependency-less plugins
#
BR2_PACKAGE_GST1_PLUGINS_BAD_PLUGIN_AIFF=y
BR2_PACKAGE_GST1_PLUGINS_BAD_PLUGIN_AUTOCONVERT=y
BR2_PACKAGE_GST1_PLUGINS_BAD_PLUGIN_ID3TAG=y
BR2_PACKAGE_GST1_PLUGINS_BAD_PLUGIN_INTERLACE=y
BR2_PACKAGE_GST1_PLUGINS_BAD_PLUGIN_IVFPARSE=y
BR2_PACKAGE_GST1_PLUGINS_BAD_PLUGIN_MPEGDEMUX=y
BR2_PACKAGE_GST1_PLUGINS_BAD_PLUGIN_MPEGTSDEMUX=y
BR2_PACKAGE_GST1_PLUGINS_BAD_PLUGIN_PCAPPARSE=y
BR2_PACKAGE_GST1_PLUGINS_BAD_PLUGIN_RAWPARSE=y
BR2_PACKAGE_GST1_PLUGINS_BAD_PLUGIN_SMOOTH=y
BR2_PACKAGE_GST1_PLUGINS_BAD_PLUGIN_VIDEOFILTERS=y
BR2_PACKAGE_GST1_PLUGINS_BAD_PLUGIN_VIDEOPARSERS=y

#
# plugins with external dependencies
#
BR2_PACKAGE_GST1_PLUGINS_BAD_PLUGIN_BZ2=y
BR2_PACKAGE_GST1_PLUGINS_BAD_PLUGIN_CURL=y
BR2_PACKAGE_GST1_PLUGINS_BAD_PLUGIN_DASH=y
BR2_PACKAGE_GST1_PLUGINS_BAD_PLUGIN_DIRECTFB=y
#
# gl needs the gst1-plugins-bad opengl library
#
BR2_PACKAGE_GST1_PLUGINS_BAD_PLUGIN_HLS=y
BR2_PACKAGE_GST1_PLUGINS_UGLY=y

#
# dependency-less plugins
#
BR2_PACKAGE_GST1_PLUGINS_UGLY_PLUGIN_ASFDEMUX=y
BR2_PACKAGE_GST1_PLUGINS_UGLY_PLUGIN_REALMEDIA=y

#
# plugins with external dependencies (there may be more available)
#
BR2_PACKAGE_GST1_VALIDATE=y

#
# gst-omx requires a OpenMAX implementation
#
#BR2_PACKAGE_KODI_ARCH_SUPPORTS=y
#BR2_PACKAGE_KODI_EGL_GLES=y
BR2_PACKAGE_GST_AML_PLUGINS1=y
BR2_PACKAGE_MPLAYER_ARCH_SUPPORTS=y
BR2_PACKAGE_WAVPACK=y

#
# Audio/Sound
#
BR2_PACKAGE_ALSA_LIB=y
BR2_PACKAGE_LIBSAMPLERATE=y
BR2_PACKAGE_ALSA_PLUGINS=y

#
# ALSA lib selection
#
BR2_PACKAGE_ALSA_LIB_DEVDIR="/dev/snd"
BR2_PACKAGE_ALSA_LIB_PCM_PLUGINS="all"
BR2_PACKAGE_ALSA_LIB_CTL_PLUGINS="all"
BR2_PACKAGE_ALSA_LIB_ALOAD=y
BR2_PACKAGE_ALSA_LIB_MIXER=y
BR2_PACKAGE_ALSA_LIB_PCM=y
BR2_PACKAGE_ALSA_LIB_RAWMIDI=y
BR2_PACKAGE_ALSA_LIB_HWDEP=y
BR2_PACKAGE_ALSA_LIB_SEQ=y
BR2_PACKAGE_ALSA_LIB_ALISP=y
BR2_PACKAGE_ALSA_LIB_OLD_SYMBOLS=y
BR2_PACKAGE_LIBID3TAG=y
BR2_PACKAGE_LIBMAD=y
BR2_PACKAGE_LIBMAD_OPTIMIZATION_DEFAULT=y
BR2_PACKAGE_LIBMAD_ASO=y
BR2_PACKAGE_LIBPLAYER=y

BR2_PACKAGE_GDB=y
BR2_PACKAGE_GDB_SERVER=y
BR2_PACKAGE_GDB_DEBUGGER=y

BR2_PACKAGE_DIRECTFB=y
BR2_PACKAGE_E2FSPROGS=y
BR2_PACKAGE_FBDUMP=y
BR2_PACKAGE_FBGRAB=y
BR2_PACKAGE_FBSET=y
BR2_PACKAGE_FBTERM=y
BR2_PACKAGE_FB_TEST_APP=y
BR2_PACKAGE_UTIL_LINUX_BINARIES=y

# other GUIs
BR2_PACKAGE_OPENSSL=y
BR2_PACKAGE_OPENSSL_BIN=y
BR2_PACKAGE_OPENSSL_ENGINES=y
BR2_PACKAGE_SQLITE=y
BR2_PACKAGE_LIBJPEG=y
BR2_PACKAGE_JPEG=y
BR2_PACKAGE_NCURSES=y
BR2_PACKAGE_NCURSES_TARGET_PANEL=y
BR2_PACKAGE_NCURSES_TARGET_FORM=y
BR2_PACKAGE_NCURSES_TARGET_MENU=y
BR2_PACKAGE_KMOD=y
BR2_PACKAGE_REMOTECFG=y
BR2_PACKAGE_LIBCARES=y
BR2_PACKAGE_LIBCURL=y
BR2_PACKAGE_LIBEVENT=y
BR2_PACKAGE_ICU=y
BR2_PACKAGE_CJSON=y
BR2_PACKAGE_LIBXSLT=y

BR2_SYSTEM_DHCP="eth0"
BR2_PACKAGE_NETPLUG=y

BR2_PACKAGE_DHCPCD=y
BR2_PACKAGE_DNSMASQ=y
BR2_PACKAGE_DNSMASQ_TFTP=y
BR2_PACKAGE_DNSMASQ_DHCP=y
BR2_PACKAGE_DNSMASQ_DNSSEC=y
BR2_PACKAGE_DNSMASQ_IDN=y
BR2_PACKAGE_DNSMASQ_CONNTRACK=y
BR2_PACKAGE_IW=y

BR2_PACKAGE_WPA_SUPPLICANT=y
BR2_PACKAGE_WPA_SUPPLICANT_CLI=y
BR2_PACKAGE_LIBNL=y

BR2_PACKAGE_NTFS_3G=y


BR2_PACKAGE_WIFI_FW=y
BR2_PACKAGE_WIFI_FW_LOCAL=y
BR2_PACKAGE_WIFI_CUSTOM_GIT_VERSION="m-amlogic"
BR2_PACKAGE_WIFI_FW_CUSTOM_LOCAL_PATH="$(TOPDIR)/../hardware/aml-4.9/amlogic/wifi"
BR2_PACKAGE_WIFI_FW_WIFI_MODULE="AP6398"

BR2_PACKAGE_BRCMAP6XXX=y
BR2_PACKAGE_BRCMAP6XXX_LOCAL=y
BR2_PACKAGE_BRCMAP6XXX_STANDALONE=y
BR2_PACKAGE_BRCMAP6XXX_GIT_VERSION="m-amlogic"
BR2_PACKAGE_BRCMAP6XXX_LOCAL_PATH="$(TOPDIR)/../hardware/aml-4.9/wifi/broadcom/drivers/ap6xxx"
BR2_PACKAGE_BRCMAP6XXX_SDIO_VERSION="bcmdhd.1.363.59.144.x.cn"
BR2_PACKAGE_BRCMAP6XXX_USB_VERSION="bcmdhd-usb.1.363.110.17.x"
BR2_PACKAGE_DHD_PRIV=y

# bcm bluetooth
BR2_PACKAGE_AML_BRCM_BSA=y
BR2_PACKAGE_AML_UTIL=y
BR2_PACKAGE_MEDIA_MODULES=y
BR2_PACKAGE_MEDIA_MODULES_STANDALONE=y
BR2_PACKAGE_MEDIA_MODULES_LOCAL=y
BR2_PACKAGE_MEDIA_MODULES_LOCAL_PATH="$(TOPDIR)/../hardware/aml-4.9/amlogic/media_modules"
BR2_PACKAGE_MEDIA_MODLUES_VERSION="amlogic-4.9-dev"

# for WIFI Host AP
BR2_PACKAGE_HOSTAPD=y
BR2_PACKAGE_HOSTAPD_ACS=y
BR2_PACKAGE_HOSTAPD_EAP=y
BR2_PACKAGE_HOSTAPD_WPS=y

# Boa web server
BR2_PACKAGE_BOA=y

# Web ui wifi config
BR2_PACKAGE_WEB_UI_WIFI=y

BR2_TARGET_USBTOOL_AMLOGIC=y
#BR2_TARGET_USBTOOL_UBI_AMLOGIC=y
#BR2_TARGET_UBOOT_AMLOGIC_BOOTARGS="root=/dev/ubi0_0 rootfstype=ubifs init=/sbin/init"
BR2_PACKAGE_AML_USB_CONFIG=y
BR2_PACKAGE_ADB_RNDIS=y


BR2_PACKAGE_LIBPTHREAD_STUBS=y
BR2_PACKAGE_LIBINPUT=y
BR2_PACKAGE_LIBXKBCOMMON=y
#Weston drm
BR2_PACKAGE_LINUX_PAM=y

#EUDEV, for wayland
BR2_PACKAGE_EUDEV=y
BR2_PACKAGE_PROVIDES_UDEV="eudev"
BR2_PACKAGE_EUDEV_ENABLE_HWDB=y
BR2_PACKAGE_HAS_UDEV=y
BR2_PACKAGE_MTDEV=y
BR2_PACKAGE_LIBEVDEV=y

#
##swupdate
#
BR2_PACKAGE_SWUPDATE=y
BR2_PACKAGE_SWUPDATE_CONFIG="package/swupdate/swupdate.config"
BR2_PACKAGE_SWUPDATE_INSTALL_WEBSITE=y
#BR2_PACKAGE_SWUPDATE_AB_SUPPORT="absystem"
#
#uboot env
#
BR2_PACKAGE_AML_UBOOTENV=y
#
#misc bootloader_message
#
BR2_PACKAGE_AML_BOOTLOADER_MESSAGE=y
#BR2_PACKAGE_VCCKTEST=y
#
# ANDROID_TOOLS
#
BR2_PACKAGE_ANDROID_TOOLS=y
BR2_PACKAGE_ANDROID_TOOLS_FASTBOOT_GOOD_KERNEL_HEADERS=y
BR2_PACKAGE_ANDROID_TOOLS_ADBD=y

#
# usb function
#
BR2_PACKAGE_AML_USB_CONFIG=y
BR2_PACKAGE_ADB_RNDIS=y
#BR2_PACKAGE_MASS_STORAGE=y
#BR2_PACKAGE_DOSFSTOOLS=y
#BR2_PACKAGE_DOSFSTOOLS_MKFS_FAT=y

#dropbear for ssh
BR2_PACKAGE_DROPBEAR=y
BR2_PACKAGE_DROPBEAR_CLIENT=y
BR2_PACKAGE_DROPBEAR_SMALL=y

#htop
BR2_PACKAGE_HTOP=y
#procrank
BR2_PACKAGE_PROCRANK_LINUX=y

#ATMOS
BR2_PACKAGE_DOLBY_ATMOS_RELEASE=y

#For Audio Service
BR2_PACKAGE_DBUS=y
BR2_PACKAGE_AUDIOSERVICE=y
#BR2_PACKAGE_AUDIOSERVICE_FFMPEG=y
BR2_PACKAGE_AUDIOSERVICE_STRESSTEST=y

#For rsyslog, needed by audio service
BR2_PACKAGE_RSYSLOG=y
BR2_PACKAGE_LIBESTR=y
BR2_PACKAGE_LIBFASTJSON=y
BR2_PACKAGE_LIBLOGGING=y

# FFMPEG for USBPlayer, audio only
#
BR2_PACKAGE_FFMPEG_ARCH_SUPPORTS=y
BR2_PACKAGE_FFMPEG=y
# BR2_PACKAGE_FFMPEG_GPL is not set
# # BR2_PACKAGE_FFMPEG_NONFREE is not set
BR2_PACKAGE_FFMPEG_FFMPEG=y
BR2_PACKAGE_FFMPEG_FFPLAY=y
# # BR2_PACKAGE_FFMPEG_FFSERVER is not set
# # BR2_PACKAGE_FFMPEG_FFPROBE is not set
# # BR2_PACKAGE_FFMPEG_AVRESAMPLE is not set
 BR2_PACKAGE_FFMPEG_SWSCALE=y
 BR2_PACKAGE_FFMPEG_ENCODERS=""
 BR2_PACKAGE_FFMPEG_DECODERS="8svx_exp, 8svx_fib, aac, aac_fixed, aac_latm, ac3, ac3_fixed, adpcm_4xm, adpcm_adx, adpcm_afc, adpcm_aica, adpcm_ct, adpcm_dtk, adpcm_ea, adpcm_ea_maxis_xa, adpcm_ea_r1, adpcm_ea_r2, adpcm_ea_r3, adpcm_ea_xas, g722, g726, g726le, adpcm_ima_amv, adpcm_ima_apc, adpcm_ima_dat4, adpcm_ima_dk3, adpcm_ima_dk4, adpcm_ima_ea_eacs, adpcm_ima_ea_sead, adpcm_ima_iss, adpcm_ima_oki, adpcm_ima_qt, adpcm_ima_rad, adpcm_ima_smjpeg, adpcm_ima_wav, adpcm_ima_ws, adpcm_ms, adpcm_mtaf, adpcm_psx, adpcm_sbpro_2, adpcm_sbpro_3, adpcm_sbpro_4, adpcm_swf, adpcm_thp, adpcm_thp_le, adpcm_vima, adpcm_xa, adpcm_yamaha, alac, amrnb, libopencore_amrnb, amrwb, libopencore_amrwb, ape, aptx, aptx_hd, atrac1, atrac3, atrac3al, atrac3plus, atrac3plusal, on2avc, binkaudio_dct, binkaudio_rdft, bmv_audio, comfortnoise, cook, dolby_e, dsd_lsbf, dsd_lsbf_planar, dsd_msbf, dsd_msbf_planar, dsicinaudio, dss_sp, dst, dca, dvaudio, eac3, evrc, flac, g723_1, g729, gremlin_dpcm, gsm, gsm_ms, iac, imc, interplay_dpcm, interplayacm, mace3, mace6, metasound, mlp, mp1, mp1float, mp2, mp2float, mp3float, mp3, mp3adufloat, mp3adu, mp3on4float, mp3on4, als, mpc7, mpc8, nellymoser, opus, libopus, paf_audio, pcm_alaw, pcm_bluray, pcm_dvd, pcm_f16le, pcm_f24le, pcm_f32be, pcm_f32le, pcm_f64be, pcm_f64le, pcm_lxf, pcm_mulaw, pcm_s16be, pcm_s16be_planar, pcm_s16le, pcm_s16le_planar, pcm_s24be, pcm_s24daud, pcm_s24le, pcm_s24le_planar, pcm_s32be, pcm_s32le, pcm_s32le_planar, pcm_s64be, pcm_s64le, pcm_s8, pcm_s8_planar, pcm_u16be, pcm_u16le, pcm_u24be, pcm_u24le, pcm_u32be, pcm_u32le, pcm_u8, pcm_zork, qcelp, qdm2, qdmc, real_144, real_288, ralf, roq_dpcm, s302m, sbc, sdx2_dpcm, shorten, sipr, smackaud, sol_dpcm, sonic, libspeex, tak, truehd, truespeech, tta, twinvq, vmdaudio, vorbis, libvorbis, wavesynth, wavpack, ws_snd1, wmalossless, wmapro, wmav1, wmav2, wmavoice, xan_dpcm, xma1, xma2"
 BR2_PACKAGE_FFMPEG_MUXERS=""
 BR2_PACKAGE_FFMPEG_DEMUXERS="all"
 BR2_PACKAGE_FFMPEG_PARSERS="all"
 BR2_PACKAGE_FFMPEG_BSFS="all"
 BR2_PACKAGE_FFMPEG_PROTOCOLS="all"
 BR2_PACKAGE_FFMPEG_FILTERS="amix,aresample"
 BR2_PACKAGE_FFMPEG_INDEVS=y
 BR2_PACKAGE_FFMPEG_OUTDEVS=y
 BR2_PACKAGE_FFMPEG_EXTRACONF=""

# Add USB Player
#
BR2_PACKAGE_AUDIOSERVICE_USBPLAYER=y

# Add AirPlay
#
BR2_PACKAGE_AUDIOSERVICE_AIRPLAY=y

BR2_PACKAGE_AML_CUSTOMIZE_KERNEL=y
BR2_PACKAGE_AML_CUSTOMIZE_KERNEL_ENABLE_OPT_LIST="CONFIG_AMLOGIC_SND_SOC_TAS5782M"
```

## buildroot/configs/sm1_ac200_a6432_release_defconfig
```kconfig
#----------------------------------------------------------#
#include "arch_a6432_6.3.1.config"

#----------------------------------------------------------#
#include "sm1_ac200.config"
BR2_TARGET_ROOTFS_INITRAMFS_LIST="board/amlogic/mesonsm1_ac200/initramfs/ramfslist-32"
```

## buildroot/configs/sm1_ac213_a6432_release_defconfig
```kconfig
#----------------------------------------------------------#
#include "arch_a6432_6.3.1.config"

#----------------------------------------------------------#
#include "sm1_ac213.config"
BR2_TARGET_ROOTFS_INITRAMFS_LIST="board/amlogic/mesonsm1_ac213/initramfs/ramfslist-32"
```

## buildroot/configs/sm1_ac213_a64_release_defconfig
```kconfig
#----------------------------------------------------------#
#include "arch_a64_6.3.1.config"

#----------------------------------------------------------#
#include "sm1_ac213.config"
BR2_PACKAGE_LAUNCHER_USE_COBALT=n
BR2_PACKAGE_COBALT=n
BR2_TARGET_ROOTFS_INITRAMFS_LIST="board/amlogic/mesonsm1_ac213/initramfs/ramfslist-64"
```

## buildroot/configs/tm2_ab311_SBR_a6432_release_defconfig
```kconfig
#----------------------------------------------------------#
#include "arch_a6432_6.3.1.config"

#----------------------------------------------------------#
#include "tm2_ab311_SBR.config"
BR2_TARGET_ROOTFS_INITRAMFS_LIST="board/amlogic/mesontm2_ab311_sbr/initramfs/ramfslist-32"
```

## buildroot/configs/tm2_ab311_a32_release_defconfig
```kconfig
#----------------------------------------------------------#
#include "arch_a32_6.3.1.config"

#----------------------------------------------------------#
#include "tm2_ab311.config"
BR2_TARGET_ROOTFS_INITRAMFS_LIST="board/amlogic/mesontm2_ab311/initramfs/ramfslist-32"
```
