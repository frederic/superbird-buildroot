## buildroot/configs/mesong12a_u212_rdk_32_release_defconfig
```kconfig
BR2_arm=y
BR2_cortex_a9=y
BR2_ARM_ENABLE_NEON=y
BR2_ARM_ENABLE_VFP=y
BR2_ARM_FPU_NEON=y
BR2_ARM_KERNEL_64=y
BR2_BACKUP_SITE="http://sources.buildroot.net"
BR2_KERNEL_TOOLCHAIN_LINARO_AARCH64_201702=y
BR2_KERNEL_TOOLCHAIN_PATH="$(TOPDIR)/../toolchain/gcc/linux-x86/aarch64/gcc-linaro-6.3.1-2017.02-x86_64_aarch64-linux-gnu"
BR2_TOOLCHAIN_EXTERNAL=y
BR2_TOOLCHAIN_EXTERNAL_LINARO_ARM_6DOT2_201702_PREINSTALLED=y
BR2_TOOLCHAIN_EXTERNAL_PREINSTALLED=y
BR2_TOOLCHAIN_EXTERNAL_PATH="$(TOPDIR)/../toolchain/gcc/linux-x86/arm/gcc-linaro-6.3.1-2017.02-x86_64_arm-linux-gnueabihf"
BR2_PACKAGE_HOST_GDB=y
BR2_ROOTFS_DEVICE_CREATION_DYNAMIC_EUDEV=y
BR2_SYSTEM_DHCP="eth0"
BR2_ROOTFS_COMMON_OVERLAY="board/amlogic/common/rootfs/rootfs-49/"
BR2_ROOTFS_UPGRADE_DIR="board/amlogic/common/upgrade/upgrade-g12a/"
BR2_RECOVERY_OTA_DIR="board/amlogic/common/ota/ota-g12a/"
BR2_ROOTFS_UPGRADE_DIR_OVERLAY="board/amlogic/mesong12a_u212/upgrade/"
BR2_ROOTFS_OVERLAY="board/amlogic/mesong12a_u212/rootfs/"
BR2_LINUX_KERNEL=y
BR2_LINUX_KERNEL_CUSTOM_LOCAL=y
BR2_LINUX_KERNEL_CUSTOM_LOCAL_PATH="$(TOPDIR)/../kernel/aml-4.9"
BR2_LINUX_KERNEL_CUSTOM_LOCAL_VERSION_VALUE="amlogic-4.9-dev"
BR2_LINUX_KERNEL_PATCH="amlogic-4.9"
BR2_LINUX_KERNEL_DEFCONFIG="meson64"
BR2_TARGET_BOARD_PLATFORM="meson8"
BR2_LINUX_KERNEL_CONFIG_FRAGMENT_FILES="board/amlogic/common/kernel_config/kernel49/drm-4.9.fragment"
BR2_LINUX_KERNEL_IMAGE=y
BR2_LINUX_KERNEL_IMAGE_LOADADDR="0x1008000"
BR2_LINUX_KERNEL_DTS_SUPPORT=y
BR2_LINUX_KERNEL_INTREE_DTS_NAME="g12a_s905x2_u212_drm_buildroot"
BR2_LINUX_KERNEL_AMLOGIC_DTD=y
BR2_LINUX_KERNEL_ANDROID_FORMAT=y
BR2_PACKAGE_GPU=y
BR2_PACKAGE_GPU_VERSION="r16p0"
BR2_PACKAGE_GPU_LOCAL=y
BR2_PACKAGE_GPU_LOCAL_PATH="$(TOPDIR)/../hardware/aml-4.9/arm/gpu"
BR2_PACKAGE_GPU_STANDALONE=y
BR2_PACKAGE_GPU_MODEL="dvalin"
BR2_PACKAGE_WIFI_FW=y
BR2_PACKAGE_WIFI_CUSTOM_GIT_VERSION="m-amlogic"
BR2_PACKAGE_WIFI_FW_LOCAL=y
BR2_PACKAGE_WIFI_FW_CUSTOM_LOCAL_PATH="$(TOPDIR)/../hardware/aml-4.9/amlogic/wifi"
BR2_PACKAGE_WIFI_FW_WIFI_MODULE="AP6398 bcm4356p ath10k"
BR2_PACKAGE_RTK8189ES=y
BR2_PACKAGE_RTK8189ES_GIT_VERSION="l-amlogic"
BR2_PACKAGE_RTK8189ES_LOCAL=y
BR2_PACKAGE_RTK8189ES_LOCAL_PATH="$(TOPDIR)/../hardware/aml-4.9/wifi/realtek/drivers/8189es"
BR2_PACKAGE_RTK8189ES_STANDALONE=y
BR2_PACKAGE_BRCMAP6XXX=y
BR2_PACKAGE_BRCMAP6XXX_GIT_VERSION="m-amlogic"
BR2_PACKAGE_BRCMAP6XXX_LOCAL=y
BR2_PACKAGE_BRCMAP6XXX_LOCAL_PATH="$(TOPDIR)/../hardware/aml-4.9/wifi/broadcom/drivers/ap6xxx"
BR2_PACKAGE_BRCMAP6XXX_SDIO_VERSION="bcmdhd.1.363.59.144.x.cn"
BR2_PACKAGE_BRCMAP6XXX_USB_VERSION="bcmdhd-usb.1.363.110.17.x"
BR2_PACKAGE_BRCMAP6XXX_STANDALONE=y
BR2_PACKAGE_BUSYBOX_SHOW_OTHERS=y
BR2_PACKAGE_AML_UTIL=y
BR2_PACKAGE_AML_BRCM_BSA=y
BR2_PACKAGE_MESON_MALI=y
BR2_PACKAGE_MESON_MALI_MODEL="dvalin"
BR2_PACKAGE_MESON_MALI_VERSION="r16p0"
BR2_PACKAGE_MESON_MALI_WAYLAND_DRM_EGL=y
BR2_PACKAGE_SYSTEM_CONTROL=y
BR2_PACKAGE_MEDIA_MODULES=y
BR2_PACKAGE_MEDIA_MODLUES_VERSION="amlogic-4.9-dev"
BR2_PACKAGE_MEDIA_MODULES_LOCAL=y
BR2_PACKAGE_MEDIA_MODULES_LOCAL_PATH="$(TOPDIR)/../hardware/aml-4.9/amlogic/media_modules"
BR2_PACKAGE_AMAUDIO=y
BR2_PACKAGE_ALSA_UTILS=y
BR2_PACKAGE_ALSA_UTILS_ALSACONF=y
BR2_PACKAGE_ALSA_UTILS_ALSALOOP=y
BR2_PACKAGE_ALSA_UTILS_ALSATPLG=y
BR2_PACKAGE_ALSA_UTILS_AMIXER=y
BR2_PACKAGE_ALSA_UTILS_APLAY=y
BR2_PACKAGE_ALSA_UTILS_BAT=y
BR2_PACKAGE_ALSA_UTILS_IECSET=y
BR2_PACKAGE_ALSA_UTILS_SPEAKER_TEST=y
BR2_PACKAGE_GSTREAMER1=y
BR2_PACKAGE_GST1_PLUGINS_BASE_PLUGIN_APP=y
BR2_PACKAGE_GST1_PLUGINS_BASE_PLUGIN_VIDEOCONVERT=y
BR2_PACKAGE_GST1_PLUGINS_BASE_PLUGIN_SUBPARSE=y
BR2_PACKAGE_GST1_PLUGINS_BASE_PLUGIN_VIDEOTESTSRC=y
BR2_PACKAGE_GST1_PLUGINS_BASE_PLUGIN_ALSA=y
BR2_PACKAGE_GST1_PLUGINS_BASE_PLUGIN_OGG=y
BR2_PACKAGE_GST1_PLUGINS_BASE_PLUGIN_OPUS=y
BR2_PACKAGE_GST1_PLUGINS_BASE_PLUGIN_THEORA=y
BR2_PACKAGE_GST1_PLUGINS_BASE_PLUGIN_VORBIS=y
BR2_PACKAGE_GST1_PLUGINS_GOOD=y
BR2_PACKAGE_GST1_PLUGINS_GOOD_ZLIB=y
BR2_PACKAGE_GST1_PLUGINS_GOOD_PLUGIN_ALPHA=y
BR2_PACKAGE_GST1_PLUGINS_GOOD_PLUGIN_APETAG=y
BR2_PACKAGE_GST1_PLUGINS_GOOD_PLUGIN_AUDIOPARSERS=y
BR2_PACKAGE_GST1_PLUGINS_GOOD_PLUGIN_AUPARSE=y
BR2_PACKAGE_GST1_PLUGINS_GOOD_PLUGIN_AUTODETECT=y
BR2_PACKAGE_GST1_PLUGINS_GOOD_PLUGIN_DEINTERLACE=y
BR2_PACKAGE_GST1_PLUGINS_GOOD_PLUGIN_FLV=y
BR2_PACKAGE_GST1_PLUGINS_GOOD_PLUGIN_ICYDEMUX=y
BR2_PACKAGE_GST1_PLUGINS_GOOD_PLUGIN_ID3DEMUX=y
BR2_PACKAGE_GST1_PLUGINS_GOOD_PLUGIN_MATROSKA=y
BR2_PACKAGE_GST1_PLUGINS_GOOD_PLUGIN_RTP=y
BR2_PACKAGE_GST1_PLUGINS_GOOD_PLUGIN_RTPMANAGER=y
BR2_PACKAGE_GST1_PLUGINS_GOOD_PLUGIN_RTSP=y
BR2_PACKAGE_GST1_PLUGINS_GOOD_PLUGIN_UDP=y
BR2_PACKAGE_GST1_PLUGINS_GOOD_PLUGIN_VIDEOFILTER=y
BR2_PACKAGE_GST1_PLUGINS_GOOD_PLUGIN_MPG123=y
BR2_PACKAGE_GST1_PLUGINS_GOOD_PLUGIN_SOUPHTTPSRC=y
BR2_PACKAGE_GST1_PLUGINS_GOOD_PLUGIN_TAGLIB=y
BR2_PACKAGE_GST1_PLUGINS_BAD=y
BR2_PACKAGE_GST1_PLUGINS_BAD_PLUGIN_AIFF=y
BR2_PACKAGE_GST1_PLUGINS_BAD_PLUGIN_AUTOCONVERT=y
BR2_PACKAGE_GST1_PLUGINS_BAD_PLUGIN_ID3TAG=y
BR2_PACKAGE_GST1_PLUGINS_BAD_PLUGIN_IVFPARSE=y
BR2_PACKAGE_GST1_PLUGINS_BAD_PLUGIN_MPEGDEMUX=y
BR2_PACKAGE_GST1_PLUGINS_BAD_PLUGIN_MPEGTSDEMUX=y
BR2_PACKAGE_GST1_PLUGINS_BAD_PLUGIN_PCAPPARSE=y
BR2_PACKAGE_GST1_PLUGINS_BAD_PLUGIN_RAWPARSE=y
BR2_PACKAGE_GST1_PLUGINS_BAD_PLUGIN_SMOOTH=y
BR2_PACKAGE_GST1_PLUGINS_BAD_PLUGIN_VIDEOFILTERS=y
BR2_PACKAGE_GST1_PLUGINS_BAD_PLUGIN_VIDEOPARSERS=y
BR2_PACKAGE_GST1_PLUGINS_BAD_PLUGIN_BZ2=y
BR2_PACKAGE_GST1_PLUGINS_BAD_PLUGIN_CURL=y
BR2_PACKAGE_GST1_PLUGINS_BAD_PLUGIN_DASH=y
# BR2_PACKAGE_GST1_PLUGINS_BAD_PLUGIN_DIRECTFB is not set
BR2_PACKAGE_GST1_PLUGINS_BAD_PLUGIN_HLS=y
# BR2_PACKAGE_GST1_PLUGINS_BAD_PLUGIN_WAYLAND is not set
BR2_PACKAGE_GST1_LIBAV=y
BR2_PACKAGE_PULSEAUDIO=y
BR2_PACKAGE_WAVPACK=y
BR2_PACKAGE_GDB=y
BR2_PACKAGE_GDB_SERVER=y
BR2_PACKAGE_GDB_DEBUGGER=y
BR2_PACKAGE_E2FSPROGS=y
BR2_PACKAGE_NTFS_3G=y
BR2_PACKAGE_DIRECTFB=y
BR2_PACKAGE_FBDUMP=y
BR2_PACKAGE_FBGRAB=y
BR2_PACKAGE_FBSET=y
BR2_PACKAGE_FB_TEST_APP=y
BR2_PACKAGE_FBTERM=y
BR2_PACKAGE_LAUNCHER_NONE=y
BR2_PACKAGE_WESTEROS=y
BR2_PACKAGE_KBD=y
BR2_PACKAGE_PCIUTILS=y
BR2_PACKAGE_RTK8822BU=y
BR2_PACKAGE_RTK8822BU_GIT_VERSION="m-amlogic"
BR2_PACKAGE_RTK8822BU_LOCAL=y
BR2_PACKAGE_RTK8822BU_LOCAL_PATH="$(TOPDIR)/../hardware/aml-4.9/wifi/realtek/drivers/8822bu"
BR2_PACKAGE_RTK8822BU_STANDALONE=y
BR2_PACKAGE_LIBID3TAG=y
BR2_PACKAGE_LIBMAD=y
BR2_PACKAGE_LIBSAMPLERATE=y
BR2_PACKAGE_CA_CERTIFICATES=y
BR2_PACKAGE_LIBGCRYPT=y
BR2_PACKAGE_LIBNSS=y
BR2_PACKAGE_OPENSSL=y
BR2_PACKAGE_LEVELDB=y
BR2_PACKAGE_SQLITE_ENABLE_COLUMN_METADATA=y
BR2_PACKAGE_CAIRO_SCRIPT=y
BR2_PACKAGE_LIBJPEG=y
BR2_PACKAGE_LIBDRM=y
BR2_PACKAGE_LIBEXIF=y
BR2_PACKAGE_PANGO=y
BR2_PACKAGE_LIBINPUT=y
BR2_PACKAGE_REMOTECFG=y
BR2_PACKAGE_TSLIB=y
BR2_PACKAGE_CJSON=y
BR2_PACKAGE_LIBXSLT=y
BR2_PACKAGE_KRB5=y
BR2_PACKAGE_LIBSOUP_SSL=y
BR2_PACKAGE_BOOST=y
BR2_PACKAGE_GCONF=y
BR2_PACKAGE_LIBEVENT=y
BR2_PACKAGE_LINUX_PAM=y
BR2_PACKAGE_ICU=y
BR2_PACKAGE_PCRE_16=y
BR2_PACKAGE_CUPS=y
BR2_PACKAGE_DHCPCD=y
BR2_PACKAGE_DNSMASQ=y
# BR2_PACKAGE_DNSMASQ_TFTP is not set
# BR2_PACKAGE_DNSMASQ_DHCP is not set
BR2_PACKAGE_DROPBEAR=y
BR2_PACKAGE_IW=y
BR2_PACKAGE_NETPLUG=y
BR2_PACKAGE_WPA_SUPPLICANT=y
BR2_PACKAGE_WPA_SUPPLICANT_CLI=y
BR2_PACKAGE_HTOP=y
BR2_PACKAGE_PROCRANK_LINUX=y
BR2_PACKAGE_SWUPDATE=y
BR2_PACKAGE_AML_UBOOTENV=y
BR2_PACKAGE_AML_BOOTLOADER_MESSAGE=y
BR2_PACKAGE_UTIL_LINUX_BINARIES=y
BR2_PACKAGE_VIM=y
BR2_TARGET_ROOTFS_CPIO=y
BR2_TARGET_ROOTFS_CPIO_GZIP=y
BR2_TARGET_ROOTFS_INITRAMFS_LIST="board/amlogic/mesong12a_u212/initramfs/ramfslist-32"
BR2_TARGET_ROOTFS_CPIO_UIMAGE=y
BR2_TARGET_ROOTFS_EXT2=y
BR2_TARGET_ROOTFS_EXT2_4=y
BR2_TARGET_ROOTFS_EXT2_SIZE="2048M"
BR2_TARGET_ROOTFS_TAR_GZIP=y
BR2_TARGET_UBOOT=y
BR2_TARGET_UBOOT_BOARDNAME="g12a_u212_v1"
BR2_TARGET_UBOOT_CUSTOM_LOCAL=y
BR2_TARGET_UBOOT_CUSTOM_LOCAL_VERSION_VALUE="next-2015-dev"
BR2_TARGET_UBOOT_CUSTOM_LOCAL_LOCATION="$(TOPDIR)/../bootloader/uboot-repo"
BR2_TARGET_UBOOT_AMLOGIC_REPO=y
BR2_TARGET_UBOOT_PLATFORM="g12a"
BR2_TARGET_USBTOOL_AMLOGIC=y
```
