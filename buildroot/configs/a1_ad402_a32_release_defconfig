## buildroot/configs/mesonaxg_s420_32_release_defconfig
```kconfig
# Mirrors and Download locations
BR2_BACKUP_SITE="http://sources.buildroot.net"
# Architecture
BR2_arm=y
BR2_cortex_a9=y
BR2_ARM_ENABLE_VFP=y
BR2_ARM_KERNEL_64=y
BR2_ARM_ENABLE_NEON=y
BR2_ARM_FPU_NEON=y
BR2_DEPRECATED=y
BR2_TOOLCHAIN_EXTERNAL_LINARO_ARM_6DOT2_201702_PREINSTALLED=y
BR2_TOOLCHAIN_EXTERNAL=y
BR2_TOOLCHAIN_EXTERNAL_PREINSTALLED=y
BR2_TOOLCHAIN_EXTERNAL_PATH="$(TOPDIR)/../toolchain/gcc/linux-x86/arm/gcc-linaro-6.3.1-2017.02-x86_64_arm-linux-gnueabihf"
BR2_KERNEL_TOOLCHAIN_PATH="$(TOPDIR)/../toolchain/gcc/linux-x86/aarch64/gcc-linaro-6.3.1-2017.02-x86_64_aarch64-linux-gnu"
BR2_KERNEL_TOOLCHAIN_LINARO_AARCH64_201702=y
#BR2_ENABLE_DEBUG=y
BR2_PACKAGE_BUSYBOX_SHOW_OTHERS=y
BR2_PACKAGE_HOST_GDB=y
BR2_PACKAGE_ALSA_UTILS=y
# FFTW for alsabat
BR2_PACKAGE_FFTW=y
BR2_PACKAGE_FFTW_FAST=y
#
# ALSA utils selection
#
BR2_PACKAGE_ALSA_UTILS_ALSACTL=y
BR2_PACKAGE_ALSA_UTILS_ALSACONF=y
BR2_PACKAGE_ALSA_UTILS_AMIXER=y
BR2_PACKAGE_ALSA_UTILS_ALSAMIXER=y
BR2_PACKAGE_ALSA_UTILS_APLAY=y
BR2_PACKAGE_ALSA_UTILS_ALSALOOP=y
BR2_PACKAGE_ALSA_UTILS_ALSATPLG=y
BR2_PACKAGE_ALSA_UTILS_BAT=y
BR2_PACKAGE_ALSA_UTILS_IECSET=y
BR2_PACKAGE_ALSA_UTILS_SPEAKER_TEST=y
#BR2_PACKAGE_AMAUDIO=y

#
# Gstreamer 1
#
BR2_PACKAGE_GSTREAMER1=y
BR2_PACKAGE_GSTREAMER1_PARSE=y
BR2_PACKAGE_GSTREAMER1_TRACE=y
BR2_PACKAGE_GSTREAMER1_GST_DEBUG=y
BR2_PACKAGE_GSTREAMER1_PLUGIN_REGISTRY=y
BR2_PACKAGE_GSTREAMER1_INSTALL_TOOLS=y
BR2_PACKAGE_GST1_PLUGINS_BASE=y

#
# dependency-less plugins
#
BR2_PACKAGE_GST1_PLUGINS_BASE_PLUGIN_APP=y
BR2_PACKAGE_GST1_PLUGINS_BASE_PLUGIN_AUDIOCONVERT=y
BR2_PACKAGE_GST1_PLUGINS_BASE_PLUGIN_PLAYBACK=y
BR2_PACKAGE_GST1_PLUGINS_BASE_PLUGIN_AUDIORESAMPLE=y
BR2_PACKAGE_GST1_PLUGINS_BASE_PLUGIN_TYPEFIND=y
BR2_PACKAGE_GST1_PLUGINS_BASE_PLUGIN_VOLUME=y
BR2_PACKAGE_GST1_PLUGINS_BASE_PLUGIN_ALSA=y
#
# plugins with external dependencies
#
BR2_PACKAGE_GST1_PLUGINS_BASE_PLUGIN_OGG=y
BR2_PACKAGE_GST1_PLUGINS_GOOD=y
BR2_PACKAGE_GST1_PLUGINS_GOOD_ZLIB=y

#
# dependency-less plugins
#
BR2_PACKAGE_GST1_PLUGINS_GOOD_PLUGIN_ALPHA=y
BR2_PACKAGE_GST1_PLUGINS_GOOD_PLUGIN_APETAG=y
BR2_PACKAGE_GST1_PLUGINS_GOOD_PLUGIN_AUDIOPARSERS=y
BR2_PACKAGE_GST1_PLUGINS_GOOD_PLUGIN_AUPARSE=y
BR2_PACKAGE_GST1_PLUGINS_GOOD_PLUGIN_AUTODETECT=y
BR2_PACKAGE_GST1_PLUGINS_GOOD_PLUGIN_DEINTERLACE=y
BR2_PACKAGE_GST1_PLUGINS_GOOD_PLUGIN_FLV=y
BR2_PACKAGE_GST1_PLUGINS_GOOD_PLUGIN_ICYDEMUX=y
BR2_PACKAGE_GST1_PLUGINS_GOOD_PLUGIN_ID3DEMUX=y
BR2_PACKAGE_GST1_PLUGINS_GOOD_PLUGIN_MATROSKA=y
BR2_PACKAGE_GST1_PLUGINS_GOOD_PLUGIN_RTP=y
BR2_PACKAGE_GST1_PLUGINS_GOOD_PLUGIN_RTPMANAGER=y
BR2_PACKAGE_GST1_PLUGINS_GOOD_PLUGIN_RTSP=y
BR2_PACKAGE_GST1_PLUGINS_GOOD_PLUGIN_UDP=y

#
# plugins with external dependencies
#
BR2_PACKAGE_GST1_PLUGINS_GOOD_PLUGIN_SOUPHTTPSRC=y
BR2_PACKAGE_GST1_PLUGINS_GOOD_PLUGIN_TAGLIB=y
BR2_PACKAGE_GST1_PLUGINS_BAD=y

#
# dependency-less plugins
#
BR2_PACKAGE_GST1_PLUGINS_BAD_PLUGIN_AIFF=y
BR2_PACKAGE_GST1_PLUGINS_BAD_PLUGIN_AUTOCONVERT=y
BR2_PACKAGE_GST1_PLUGINS_BAD_PLUGIN_ID3TAG=y
BR2_PACKAGE_GST1_PLUGINS_BAD_PLUGIN_INTERLACE=y
BR2_PACKAGE_GST1_PLUGINS_BAD_PLUGIN_IVFPARSE=y
BR2_PACKAGE_GST1_PLUGINS_BAD_PLUGIN_MPEGDEMUX=y
BR2_PACKAGE_GST1_PLUGINS_BAD_PLUGIN_MPEGTSDEMUX=y
BR2_PACKAGE_GST1_PLUGINS_BAD_PLUGIN_PCAPPARSE=y
BR2_PACKAGE_GST1_PLUGINS_BAD_PLUGIN_RAWPARSE=y
BR2_PACKAGE_GST1_PLUGINS_BAD_PLUGIN_SMOOTH=y

#
# plugins with external dependencies
#
BR2_PACKAGE_GST1_PLUGINS_BAD_PLUGIN_BZ2=y
BR2_PACKAGE_GST1_PLUGINS_BAD_PLUGIN_CURL=y
BR2_PACKAGE_GST1_PLUGINS_BAD_PLUGIN_DASH=y
#
# gl needs the gst1-plugins-bad opengl library
#
BR2_PACKAGE_GST1_PLUGINS_BAD_PLUGIN_HLS=y
BR2_PACKAGE_GST1_PLUGINS_UGLY=y

#
# dependency-less plugins
#
BR2_PACKAGE_GST1_PLUGINS_UGLY_PLUGIN_ASFDEMUX=y

#
# plugins with external dependencies (there may be more available)
#
BR2_PACKAGE_GST1_VALIDATE=y
BR2_PACKAGE_GST1_PLUGINS_UGLY_PLUGIN_DVDREAD=y
BR2_PACKAGE_GST1_PLUGINS_UGLY_PLUGIN_MPEG2DEC=y
BR2_PACKAGE_GST1_LIBAV=y
BR2_PACKAGE_GST1_RTSP_SERVER=y
#Without FFMPEG, GST1_LIBAV compile NG
#BR2_PACKAGE_GST1_LIBAV_WITHOUT_FFMMPEG=y

#
# gst-omx requires a OpenMAX implementation
#
#BR2_PACKAGE_KODI_ARCH_SUPPORTS=y
#BR2_PACKAGE_KODI_EGL_GLES=y
#BR2_PACKAGE_GST_AML_PLUGINS1=y
BR2_PACKAGE_MPLAYER_ARCH_SUPPORTS=y
#BR2_PACKAGE_WAVPACK=y

# MTD tools selection
BR2_PACKAGE_MTD=y
BR2_PACKAGE_MTD_FLASHCP=y
BR2_PACKAGE_MTD_FLASH_ERASE=y
BR2_PACKAGE_MTD_FLASH_LOCK=y
BR2_PACKAGE_MTD_FLASH_UNLOCK=y
BR2_PACKAGE_MTD_MKFSUBIFS=y
BR2_PACKAGE_MTD_MTD_DEBUG=y
BR2_PACKAGE_MTD_NANDDUMP=y
BR2_PACKAGE_MTD_NANDTEST=y
BR2_PACKAGE_MTD_NANDWRITE=y
BR2_PACKAGE_MTD_MTDINFO=y
BR2_PACKAGE_MTD_UBIATTACH=y
#BR2_PACKAGE_MTD_UBICRC32=y
BR2_PACKAGE_MTD_UBIDETACH=y
BR2_PACKAGE_MTD_UBIFORMAT=y
BR2_PACKAGE_MTD_UBIMKVOL=y
BR2_PACKAGE_MTD_UBINFO=y
BR2_PACKAGE_MTD_UBINIZE=y
#BR2_PACKAGE_MTD_UBIRENAME=y
#BR2_PACKAGE_MTD_UBIRMVOL=y
#BR2_PACKAGE_MTD_UBIRSVOL=y
#BR2_PACKAGE_MTD_UBIUPDATEVOL=y
#BR2_PACKAGE_MTD_UBIBLOCK=y
#
# Audio/Sound
#
BR2_PACKAGE_ALSA_LIB=y
BR2_PACKAGE_LIBSAMPLERATE=y
BR2_PACKAGE_ALSAPLAYER=y
BR2_PACKAGE_VLC=y
BR2_VLC_FOR_AUDIO=y
#
# ALSA lib selection
#
BR2_PACKAGE_ALSA_LIB_DEVDIR="/dev/snd"
BR2_PACKAGE_ALSA_LIB_PCM_PLUGINS="all"
BR2_PACKAGE_ALSA_LIB_CTL_PLUGINS="all"
BR2_PACKAGE_ALSA_LIB_ALOAD=y
BR2_PACKAGE_ALSA_LIB_MIXER=y
BR2_PACKAGE_ALSA_LIB_PCM=y
BR2_PACKAGE_ALSA_LIB_RAWMIDI=y
BR2_PACKAGE_ALSA_LIB_HWDEP=y
BR2_PACKAGE_ALSA_LIB_SEQ=y
BR2_PACKAGE_ALSA_LIB_ALISP=y
BR2_PACKAGE_ALSA_LIB_OLD_SYMBOLS=y
BR2_PACKAGE_LIBID3TAG=y
BR2_PACKAGE_LIBMAD=y
BR2_PACKAGE_LIBMAD_OPTIMIZATION_DEFAULT=y
BR2_PACKAGE_LIBMAD_ASO=y
#BR2_PACKAGE_LIBPLAYER=y
#BR2_PACKAGE_GDB is not set
#BR2_PACKAGE_CHECK is not set
#BR2_PACKAGE_GDB_SERVER is not set
#BR2_PACKAGE_GDB_DEBUGGER is not set
BR2_PACKAGE_DIRECTFB=y
#BR2_PACKAGE_E2FSPROGS is not set
#BR2_PACKAGE_FBDUMP is not set
#BR2_PACKAGE_FBGRAB is not set
#BR2_PACKAGE_FBSET is not set
#BR2_PACKAGE_FBTERM is not set
#BR2_PACKAGE_FB_TEST_APP is not set
BR2_PACKAGE_UTIL_LINUX_BINARIES=y

#
# QT Quick2.x build depends on openGL
#
#BR2_PACKAGE_MESON_MALI is not set
#BR2_PACKAGE_PROVIDES_LIBEGL="meson-mali"
#BR2_PACKAGE_PROVIDES_LIBGLES="meson-mali"
#BR2_PACKAGE_HAS_LIBEGL_WAYLAND=y
#BR2_PACKAGE_MESON_MALI_MODEL="m450"
#BR2_PACKAGE_MESON_MALI_VERSION="r7p0"

#
#QT5.6.x support config
#
#BR2_PACKAGE_QT5 is not set
#BR2_PACKAGE_QT5BASE=y
#BR2_PACKAGE_QT5_VERSION_LATEST=y
#BR2_PACKAGE_QT5BASE_LICENSE_APPROVED=y
#BR2_PACKAGE_QT5BASE_NETWORK=y
#BR2_PACKAGE_QT5BASE_CONCURRENT=y
#BR2_PACKAGE_QT5BASE_SQL=y
#BR2_PACKAGE_QT5BASE_SQLITE_SYSTEM=y
#BR2_PACKAGE_QT5BASE_TEST=y
#BR2_PACKAGE_QT5BASE_XML=y
#BR2_PACKAGE_QT5BASE_GUI=y
#BR2_PACKAGE_QT5BASE_WIDGETS=y
#BR2_PACKAGE_QT5BASE_LINUXFB=y
#BR2_PACKAGE_QT5BASE_DIRECTFB=y
#BR2_PACKAGE_QT5BASE_EGLFS=y
#BR2_PACKAGE_QT5BASE_PRINTSUPPORT=y
#BR2_PACKAGE_QT5BASE_FONTCONFIG=y
#BR2_PACKAGE_QT5BASE_GIF=y
#BR2_PACKAGE_QT5BASE_JPEG=y
#BR2_PACKAGE_QT5BASE_PNG=y
#BR2_PACKAGE_QT5BASE_DBUS=y
#BR2_PACKAGE_QT5BASE_ICU=y
#BR2_PACKAGE_QT5BASE_TSLIB=y
#BR2_PACKAGE_QT5DECLARATIVE=y
#BR2_PACKAGE_QT5GRAPHICALEFFECTS=y
#BR2_PACKAGE_QT5IMAGEFORMATS=y
#BR2_PACKAGE_QT5MULTIMEDIA=y
#BR2_PACKAGE_QT5QUICKCONTROLS=y
#BR2_PACKAGE_QT5SCRIPT=y
#BR2_PACKAGE_QT5SENSORS=y
#BR2_PACKAGE_QT5SERIALPORT=y
#BR2_PACKAGE_QT5SVG=y
#BR2_PACKAGE_QT5WEBKIT=y
#BR2_PACKAGE_QT5XMLPATTERNS=y
#BR2_PACKAGE_QT5BASE_EXAMPLES=y

#
#QT4.8.x support config
#
#BR2_PACKAGE_QT=y
#BR2_PACKAGE_QT_DEBUG=y
#BR2_PACKAGE_QT_DEMOS=y
#BR2_PACKAGE_QT_EXAMPLES=y
#BR2_PACKAGE_QT_LICENSE_APPROVED=y
#BR2_PACKAGE_QT_GIF=y
#BR2_PACKAGE_QT_QTJPEG=y
#BR2_PACKAGE_QT_QTPNG=y
#BR2_PACKAGE_QT_QTTIFF=y
#BR2_PACKAGE_QT_GFX_EGLNULLWS=y
#BR2_PACKAGE_QT_MOUSE_PC is not set
#BR2_PACKAGE_QT_MOUSE_LINUXTP is not set
#BR2_PACKAGE_QT_MOUSE_LINUXINPUT is not set
#BR2_PACKAGE_QT_MOUSE_TSLIB is not set
#BR2_PACKAGE_QT_MOUSE_QVFB is not set
#BR2_PACKAGE_QT_MOUSE_NO_QWS_CURSOR=y
#BR2_PACKAGE_QT_KEYBOARD_TTY=y
#BR2_PACKAGE_QT_KEYBOARD_LINUXINPUT=y
#BR2_PACKAGE_QT_OPENGL_ES=y

BR2_PACKAGE_OPENSSL=y
BR2_PACKAGE_OPENSSL_BIN=y
BR2_PACKAGE_OPENSSL_ENGINES=y
BR2_PACKAGE_SQLITE=y
#BR2_PACKAGE_CAIRO_SCRIPT=y
BR2_PACKAGE_LIBJPEG=y
#BR2_PACKAGE_JPEG=y
#BR2_PACKAGE_TSLIB is not set
#BR2_PACKAGE_NCURSES is not set
#BR2_PACKAGE_NCURSES_TARGET_PANEL is not set
#BR2_PACKAGE_NCURSES_TARGET_FORM is not set
#BR2_PACKAGE_NCURSES_TARGET_MENU is not set
BR2_PACKAGE_KMOD=y
BR2_PACKAGE_REMOTECFG=y
BR2_PACKAGE_LIBCARES=y
BR2_PACKAGE_LIBCURL=y
BR2_PACKAGE_CURL=y
BR2_PACKAGE_LIBCURL_VERBOSE=y
BR2_PACKAGE_BOOST=y
BR2_PACKAGE_LIBEVENT=y
BR2_PACKAGE_CJSON=y
BR2_PACKAGE_LIBXSLT=y
# BR2_PACKAGE_BLUEZ_UTILS is not set
BR2_PACKAGE_BLUEZ5_UTILS=y
BR2_PACKAGE_BLUEZ5_UTILS_OBEX=y
BR2_PACKAGE_BLUEZ5_UTILS_CLIENT=y
# BR2_PACKAGE_BLUEZ5_UTILS_EXPERIMENTAL is not set
BR2_PACKAGE_BLUEZ_ALSA=y
BR2_PACKAGE_DHCPCD=y
BR2_PACKAGE_DNSMASQ=y
BR2_PACKAGE_DNSMASQ_TFTP=y
BR2_PACKAGE_DNSMASQ_DHCP=y
BR2_PACKAGE_DNSMASQ_DNSSEC=y
BR2_PACKAGE_DNSMASQ_IDN=y
BR2_PACKAGE_DNSMASQ_CONNTRACK=y
BR2_PACKAGE_IW=y
BR2_PACKAGE_WPA_SUPPLICANT=y
BR2_PACKAGE_WPA_SUPPLICANT_CLI=y
BR2_PACKAGE_LIBNL=y
#BR2_PACKAGE_VIM is not set
#BR2_PACKAGE_NTFS_3G is not set
BR2_PACKAGE_MTD=y
BR2_PACKAGE_MTD_MKFSUBIFS=y
BR2_TARGET_ROOTFS_CPIO=y
BR2_TARGET_ROOTFS_CPIO_GZIP=y
BR2_TARGET_ROOTFS_CPIO_UIMAGE=y
BR2_TARGET_ROOTFS_INITRAMFS_LIST="board/amlogic/common/initramfs/initramfs-49/ramfslist-32-ubi-release"
BR2_TARGET_ROOTFS_UBIFS=y
BR2_TARGET_ROOTFS_UBIFS_LEBSIZE=0x1f000
BR2_TARGET_ROOTFS_UBIFS_MAXLEBCNT=2212
BR2_TARGET_ROOTFS_UBIFS_OPTS="-v"
BR2_TARGET_ROOTFS_UBI=y
BR2_TARGET_ROOTFS_UBI_SUBSIZE=2048
#BR2_TARGET_ROOTFS_EXT2=y
#BR2_TARGET_ROOTFS_EXT2_4=y
BR2_TARGET_ROOTFS_TAR_GZIP=y
BR2_ROOTFS_DEVICE_CREATION_DYNAMIC_MDEV=y
BR2_ROOTFS_COMMON_OVERLAY="board/amlogic/common/rootfs/rootfs-49-audio/"
BR2_ROOTFS_OVERLAY="board/amlogic/mesonaxg_s420/rootfs/"
BR2_ROOTFS_UPGRADE_DIR="board/amlogic/common/upgrade/upgrade-axg/"
BR2_RECOVERY_OTA_DIR="board/amlogic/common/ota/ota-axg/"
BR2_LINUX_KERNEL=y
BR2_LINUX_KERNEL_CUSTOM_LOCAL_VERSION_VALUE="amlogic-4.9-dev"
BR2_LINUX_KERNEL_CUSTOM_LOCAL=y
BR2_LINUX_KERNEL_CUSTOM_LOCAL_PATH="$(TOPDIR)/../kernel/aml-4.9"
BR2_LINUX_KERNEL_DEFCONFIG="meson64_smarthome"
BR2_TARGET_BOARD_PLATFORM="mesonaxg"
BR2_LINUX_KERNEL_IMAGE_LOADADDR="0x1008000"
BR2_LINUX_KERNEL_PATCH="amlogic-4.9"
BR2_LINUX_KERNEL_DTS_SUPPORT=y
BR2_LINUX_KERNEL_USE_INTREE_DTS=y
BR2_LINUX_KERNEL_INTREE_DTS_NAME="axg_s420 axg_s420_v03 axg_s420_128m"
BR2_LINUX_KERNEL_AMLOGIC_DTD=y
BR2_LINUX_KERNEL_ANDROID_FORMAT=y
BR2_LINUX_KERNEL_IMAGE=y
BR2_PACKAGE_WIFI_FW=y
BR2_PACKAGE_WIFI_FW_LOCAL=y
BR2_PACKAGE_WIFI_CUSTOM_GIT_VERSION="m-amlogic"
BR2_PACKAGE_WIFI_FW_CUSTOM_LOCAL_PATH="$(TOPDIR)/../hardware/aml-4.9/amlogic/wifi"
BR2_PACKAGE_WIFI_FW_WIFI_MODULE="bcm4356 AP6398"
#BR2_PACKAGE_RTK8188EU=y
#BR2_PACKAGE_RTK8188EU_LOCAL=y
#BR2_PACKAGE_RTK8188EU_STANDALONE=y
#BR2_PACKAGE_RTK8188EU_GIT_VERSION="l-amlogic"
#BR2_PACKAGE_RTK8188EU_LOCAL_PATH="$(TOPDIR)/../hardware/aml-4.9/wifi/realtek/drivers/8188eu"
#BR2_PACKAGE_RTK8192CU=y
#BR2_PACKAGE_RTK8192CU_LOCAL=y
#BR2_PACKAGE_RTK8192CU_GIT_VERSION="8192cu"
#BR2_PACKAGE_RTK8192CU_LOCAL_PATH="$(TOPDIR)/../hardware/aml-4.9/wifi/realtek/drivers/8192cu"
#BR2_PACKAGE_RTK8192DU=y
#BR2_PACKAGE_RTK8192DU_LOCAL=y
#BR2_PACKAGE_RTK8192DU_GIT_VERSION="8192du"
#BR2_PACKAGE_RTK8192DU_LOCAL_PATH="$(TOPDIR)/../hardware/aml-4.9/wifi/realtek/drivers/8192du"
#BR2_PACKAGE_RTK8192EU=y
#BR2_PACKAGE_RTK8192EU_LOCAL=y
#BR2_PACKAGE_RTK8192EU_STANDALONE=y
#BR2_PACKAGE_RTK8192EU_GIT_VERSION="m-amlogic"
#BR2_PACKAGE_RTK8192EU_LOCAL_PATH="$(TOPDIR)/../hardware/aml-4.9/wifi/realtek/drivers/8192eu"
#BR2_PACKAGE_RTK8189ES=y
#BR2_PACKAGE_RTK8189ES_LOCAL=y
#BR2_PACKAGE_RTK8189ES_STANDALONE=y
#BR2_PACKAGE_RTK8189ES_GIT_VERSION="l-amlogic"
#BR2_PACKAGE_RTK8189ES_LOCAL_PATH="$(TOPDIR)/../hardware/aml-4.9/wifi/realtek/drivers/8189es"
#BR2_PACKAGE_RTK8189FTV=y
#BR2_PACKAGE_RTK8189FTV_LOCAL=y
#BR2_PACKAGE_RTK8189FTV_STANDALONE=y
#BR2_PACKAGE_RTK8189FTV_GIT_VERSION="m-amlogic"
#BR2_PACKAGE_RTK8189FTV_LOCAL_PATH="$(TOPDIR)/../hardware/aml-4.9/wifi/realtek/drivers/8189ftv"
#BR2_PACKAGE_RTK8723BS=y
#BR2_PACKAGE_RTK8723BS_LOCAL=y
#BR2_PACKAGE_RTK8723BS_STANDALONE=y
#BR2_PACKAGE_RTK8723BS_GIT_VERSION="l-amlogic"
#BR2_PACKAGE_RTK8723BS_LOCAL_PATH="$(TOPDIR)/../hardware/aml-4.9/wifi/realtek/drivers/8723bs"
#BR2_PACKAGE_RTK8723AU=y
#BR2_PACKAGE_RTK8723AU_LOCAL=y
#BR2_PACKAGE_RTK8723AU_GIT_VERSION="8723au"
#BR2_PACKAGE_RTK8723AU_LOCAL_PATH="$(TOPDIR)/../hardware/aml-4.9/wifi/realtek/drivers/8723au"
#BR2_PACKAGE_RTK8723BU=y
#BR2_PACKAGE_RTK8723BU_LOCAL=y
#BR2_PACKAGE_RTK8723BU_STANDALONE=y
#BR2_PACKAGE_RTK8723BU_GIT_VERSION="m-amlogic"
#BR2_PACKAGE_RTK8723BU_LOCAL_PATH="$(TOPDIR)/../hardware/aml-4.9/wifi/realtek/drivers/8723bu"
#BR2_PACKAGE_RTK8723DS=y
#BR2_PACKAGE_RTK8723DS_LOCAL=y
#BR2_PACKAGE_RTK8723DS_STANDALONE=y
#BR2_PACKAGE_RTK8723DS_GIT_VERSION="n-amlogic"
#BR2_PACKAGE_RTK8723DS_LOCAL_PATH="$(TOPDIR)/../hardware/aml-4.9/wifi/realtek/drivers/8723ds"
#BR2_PACKAGE_RTK8811AU=y
#BR2_PACKAGE_RTK8811AU_LOCAL=y
#BR2_PACKAGE_RTK8811AU_GIT_VERSION="8811au"
#BR2_PACKAGE_RTK8811AU_LOCAL_PATH="$(TOPDIR)/../hardware/aml-4.9/wifi/realtek/drivers/8811au"
#BR2_PACKAGE_RTK8812AU=y
#BR2_PACKAGE_RTK8812AU_LOCAL=y
#BR2_PACKAGE_RTK8812AU_STANDALONE=y
#BR2_PACKAGE_RTK8812AU_GIT_VERSION="m-amlogic"
#BR2_PACKAGE_RTK8812AU_LOCAL_PATH="$(TOPDIR)/../hardware/aml-4.9/wifi/realtek/drivers/8812au"
#BR2_PACKAGE_RTK8822BU=y
#BR2_PACKAGE_RTK8822BU_LOCAL=y
#BR2_PACKAGE_RTK8822BU_STANDALONE=y
#BR2_PACKAGE_RTK8822BU_GIT_VERSION="m-amlogic"
#BR2_PACKAGE_RTK8822BU_LOCAL_PATH="$(TOPDIR)/../hardware/aml-4.9/wifi/realtek/drivers/8822bu"
#BR2_PACKAGE_REALTEK_BT=y
#BR2_PACKAGE_REALTEK_BT_LOCAL_PATH="$(TOPDIR)/../hardware/aml-4.9/realtek/bluetooth"
#BR2_PACKAGE_REALTEK_UART_BT=y
#BR2_PACKAGE_REALTEK_USB_BT=y
BR2_PACKAGE_BRCMAP6XXX=y
BR2_PACKAGE_BRCMAP6XXX_LOCAL=y
BR2_PACKAGE_BRCMAP6XXX_STANDALONE=y
BR2_PACKAGE_BRCMAP6XXX_GIT_VERSION="m-amlogic"
BR2_PACKAGE_BRCMAP6XXX_LOCAL_PATH="$(TOPDIR)/../hardware/aml-4.9/wifi/broadcom/drivers/ap6xxx"
BR2_PACKAGE_BRCMAP6XXX_SDIO_VERSION="bcmdhd.1.363.59.144.x.cn"
BR2_PACKAGE_BRCMAP6XXX_USB_VERSION="bcmdhd-usb.1.363.110.17.x"
BR2_PACKAGE_DHD_PRIV=y
BR2_PACKAGE_BRCM_SMARTCONFIG=y
BR2_PACKAGE_BRCM_SMARTCONFIG_LOCAL_PATH="$(TOPDIR)/../hardware/aml-4.9/amlogic/wifi/bcm_ampak/tools/easySetupTarget"
#BR2_PACKAGE_BRCMUSI=y
#BR2_PACKAGE_BRCMUSI_LOCAL=y
#BR2_PACKAGE_BRCMUSI_GIT_VERSION="kk-amlogic"
#BR2_PACKAGE_BRCMUSI_LOCAL_PATH="$(TOPDIR)/../hardware/aml-4.9/wifi/broadcom/drivers/usi"
#BR2_PACKAGE_MTK7601=y
#BR2_PACKAGE_MTK7601_LOCAL=y
#BR2_PACKAGE_MTK7601_GIT_VERSION="m-amlogic"
#BR2_PACKAGE_MTK7601_LOCAL_PATH="$(TOPDIR)/../hardware/aml-4.9/wifi/mtk/drivers/mt7601"
#BR2_PACKAGE_MTK7603=y
#BR2_PACKAGE_MTK7603_LOCAL=y
#BR2_PACKAGE_MTK7603_GIT_VERSION="m-amlogic"
#BR2_PACKAGE_MTK7603_LOCAL_PATH="$(TOPDIR)/../hardware/aml-4.9/wifi/mtk/drivers/mt7603"
BR2_PACKAGE_AML_UTIL=y

# media modules
#BR2_PACKAGE_MEDIA_MODULES is not set
#BR2_PACKAGE_MEDIA_MODULES_STANDALONE is not set
#BR2_PACKAGE_MEDIA_MODULES_LOCAL is not set
#BR2_PACKAGE_MEDIA_MODULES_LOCAL_PATH="$(TOPDIR)/../hardware/aml-4.9/amlogic/media_modules"
#BR2_PACKAGE_MEDIA_MODLUES_VERSION="amlogic-4.9-dev"

BR2_TARGET_UBOOT=y
BR2_TARGET_UBOOT_CUSTOM_LOCAL=y
BR2_TARGET_UBOOT_CUSTOM_LOCAL_VERSION_VALUE="next-2015-dev"
BR2_TARGET_UBOOT_CUSTOM_LOCAL_LOCATION="$(TOPDIR)/../bootloader/uboot-repo"
BR2_TARGET_UBOOT_PATCH=""
BR2_TARGET_UBOOT_BOARDNAME="axg_s420_v1"
#BR2_TARGET_UBOOT_AMLOGIC_2015=y
BR2_TARGET_UBOOT_AMLOGIC_REPO=y
BR2_TARGET_UBOOT_PLATFORM="axg"
#BR2_PACKAGE_AML_AF_ALG=y
#BR2_PACKAGE_AML_AF_ALG_GIT_URL="git://git.myamlogic.com/vendor/amlogic/external/af_alg.git"
#BR2_PACKAGE_AML_AF_ALG_VERSION="amlogic"
BR2_TARGET_USBTOOL_AMLOGIC=y
BR2_TARGET_USBTOOL_UBI_AMLOGIC=y
BR2_TARGET_UBOOT_AMLOGIC_BOOTARGS="root=/dev/ubi0_0 rootfstype=ubifs init=/sbin/init"


#
#shairport-sync and dependence
#
BR2_PACKAGE_AVAHI=y
BR2_PACKAGE_AVAHI_DAEMON=y
BR2_PACKAGE_AVAHI_AUTOIPD=y
BR2_PACKAGE_AVAHI_LIBDNSSD_COMPATIBILITY=y
BR2_PACKAGE_DBUS=y
BR2_PACKAGE_LIBSOXR=y
BR2_PACKAGE_SHAIRPORT_SYNC=y

BR2_PACKAGE_HOSTAPD=y
BR2_PACKAGE_HOSTAPD_ACS=y
BR2_PACKAGE_HOSTAPD_EAP=y
BR2_PACKAGE_HOSTAPD_WPS=y

#
# amlogic test tools
#
#BR2_PACKAGE_TEST_TOOLS is not set

#
#DLNA-upnp audio function
#
BR2_PACKAGE_UPNP_APP=y
BR2_PACKAGE_NETCHECK=y

#BR2_PACKAGE_LFTP is not set

#
# Commands
#
#BR2_PACKAGE_LFTP_CMD_MIRROR is not set
#BR2_PACKAGE_LFTP_CMD_SLEEP is not set
# BR2_PACKAGE_LFTP_CMD_TORRENT is not set

#
# Protocols
#
# BR2_PACKAGE_LFTP_PROTO_FISH is not set
#BR2_PACKAGE_LFTP_PROTO_FTP is not set
# BR2_PACKAGE_LFTP_PROTO_HTTP is not set
# BR2_PACKAGE_LFTP_PROTO_SFTP is not set

#BR2_PACKAGE_IOZONE is not set
#BR2_PACKAGE_MEMSTAT is not set
BR2_PACKAGE_OPENSSH=y
#BR2_PACKAGE_RSYNC is not set

#BR2_PACKAGE_SAMBA4 is not set
# BR2_PACKAGE_SAMBA4_AD_DC is not set
# BR2_PACKAGE_SAMBA4_ADS is not set
# BR2_PACKAGE_SAMBA4_SMBTORTURE is not set

#BR2_PACKAGE_VALGRIND is not set
#BR2_PACKAGE_VALGRIND_MEMCHECK is not set
#BR2_PACKAGE_VALGRIND_CACHEGRIND is not set
#BR2_PACKAGE_VALGRIND_CALLGRIND is not set
#BR2_PACKAGE_VALGRIND_HELGRIND is not set
#BR2_PACKAGE_VALGRIND_DRD is not set
#BR2_PACKAGE_VALGRIND_MASSIF is not set
#BR2_PACKAGE_VALGRIND_DHAT is not set
# BR2_PACKAGE_VALGRIND_SGCHECK is not set
# BR2_PACKAGE_VALGRIND_BBV is not set
# BR2_PACKAGE_VALGRIND_LACKEY is not set
# BR2_PACKAGE_VALGRIND_NULGRIND is not set

#
#Boa web server
#
BR2_PACKAGE_BOA=y

#
#Web ui wifi config
#
BR2_PACKAGE_WEB_UI_WIFI=y

# spotify
#
BR2_PACKAGE_LIBRESPOT_SYNC=y
#
#ntp
#
BR2_PACKAGE_NTP=y
BR2_PACKAGE_NTP_NTPDATE=y
#
#avs-support
#
BR2_PACKAGE_NGHTTP2=y
BR2_PACKAGE_MBEDTLS=y
BR2_PACKAGE_LIBCURL_MBEDTLS=y
BR2_PACKAGE_LIBTOOL=y
BR2_PACKAGE_LIBGMIME=y
BR2_PACKAGE_GLIB_NETWORKING=y
BR2_PACKAGE_GNUTLS=y
BR2_PACKAGE_LIBSOUP=y
BR2_PACKAGE_LIBSOUP_SSL=y
BR2_PACKAGE_LIBTOTEM=y
BR2_PACKAGE_LIBARCHIVE=y
BR2_PACKAGE_PORTAUDIO=y
#
#avs
#
BR2_PACKAGE_AVS_SDK=y
BR2_AVS_DSPC_AEC=y
BR2_AVS_AMAZON_WWE=y
#BR2_AVS_RDSPC=y
#BR2_AML_BT_DSPC=y
BR2_AVS_CLIENT_API=n

#
# bcm bluetooth
#
BR2_PACKAGE_AML_BRCM_BSA=y

#
#DuerOS for amlogoc public platform
#
#BR2_PACKAGE_DUEROS=y

#
#led ring
#
BR2_PACKAGE_LEDRING=y

#
##swupdate
#
BR2_PACKAGE_SWUPDATE=y
BR2_PACKAGE_SWUPDATE_CONFIG="package/swupdate/swupdate.config"
BR2_PACKAGE_SWUPDATE_INSTALL_WEBSITE=y
#BR2_PACKAGE_SWUPDATE_AB_SUPPORT="absystem"

#
#usb adb
#
BR2_PACKAGE_ANDROID_TOOLS=y
BR2_PACKAGE_ANDROID_TOOLS_FASTBOOT_GOOD_KERNEL_HEADERS=y
BR2_PACKAGE_ANDROID_TOOLS_ADBD=y

#
#uboot env
#
BR2_PACKAGE_AML_UBOOTENV=y

#
#alsa speaker process
#
BR2_PACKAGE_AML_SPEAKER_PROCESS=y

#
#misc bootloader_message
#
BR2_PACKAGE_AML_BOOTLOADER_MESSAGE=y

#
# usb function
#
BR2_PACKAGE_AML_USB_CONFIG=y
BR2_PACKAGE_ADB_RNDIS=y
#BR2_PACKAGE_MASS_STORAGE=y
#BR2_PACKAGE_DOSFSTOOLS=y
#BR2_PACKAGE_DOSFSTOOLS_MKFS_FAT=y
#
#pulseaudio
BR2_PACKAGE_ALSA_PLUGINS=y
#BR2_PACKAGE_PULSEAUDIO=y
#BR2_PACKAGE_PULSEAUDIO_DAEMON=y
#htop
BR2_PACKAGE_HTOP=y
#procrank
BR2_PACKAGE_PROCRANK_LINUX=y
```
