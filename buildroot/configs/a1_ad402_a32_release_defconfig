## buildroot/configs/mesonaxg_s410_sbr_32_release_defconfig
```kconfig
# Mirrors and Download locations
BR2_BACKUP_SITE="http://sources.buildroot.net"

# Architecture
BR2_arm=y
BR2_cortex_a9=y
BR2_ARM_ENABLE_VFP=y
BR2_ARM_KERNEL_64=y
BR2_ARM_ENABLE_NEON=y
BR2_ARM_FPU_NEON=y
BR2_DEPRECATED=y
BR2_TOOLCHAIN_EXTERNAL_LINARO_ARM_6DOT2_201702_PREINSTALLED=y
BR2_TOOLCHAIN_EXTERNAL=y
BR2_TOOLCHAIN_EXTERNAL_PREINSTALLED=y
BR2_TOOLCHAIN_EXTERNAL_PATH="$(TOPDIR)/../toolchain/gcc/linux-x86/arm/gcc-linaro-6.3.1-2017.02-x86_64_arm-linux-gnueabihf"
BR2_KERNEL_TOOLCHAIN_PATH="$(TOPDIR)/../toolchain/gcc/linux-x86/aarch64/gcc-linaro-6.3.1-2017.02-x86_64_aarch64-linux-gnu"
BR2_KERNEL_TOOLCHAIN_LINARO_AARCH64_201702=y
#BR2_ENABLE_DEBUG=y

BR2_TARGET_ROOTFS_CPIO=y
BR2_TARGET_ROOTFS_CPIO_GZIP=y
BR2_TARGET_ROOTFS_CPIO_UIMAGE=y
BR2_TARGET_ROOTFS_INITRAMFS_LIST="board/amlogic/common/initramfs/initramfs-49/ramfslist-32-ubi-release"

# Config for 2k Nand
#
BR2_TARGET_ROOTFS_UBIFS=y
BR2_TARGET_ROOTFS_UBIFS_LEBSIZE=0x1f000
BR2_TARGET_ROOTFS_UBIFS_MAXLEBCNT=2212
BR2_TARGET_ROOTFS_UBIFS_OPTS="-v"
BR2_TARGET_ROOTFS_UBI=y
BR2_TARGET_ROOTFS_UBI_SUBSIZE=2048

# Config for 4k Nand
#
#BR2_TARGET_ROOTFS_UBIFS=y
#BR2_TARGET_ROOTFS_UBI=y
#BR2_TARGET_ROOTFS_UBIFS_LEBSIZE=0x3e000
#BR2_TARGET_ROOTFS_UBIFS_MAXLEBCNT=1120
#BR2_TARGET_ROOTFS_UBIFS_OPTS="-F"
#BR2_TARGET_ROOTFS_UBI_SUBSIZE=4096
#BR2_TARGET_ROOTFS_UBIFS_MINIOSIZE=0x1000
#BR2_TARGET_ROOTFS_UBI_PEBSIZE=0x40000

#BR2_TARGET_ROOTFS_EXT2=y
#BR2_TARGET_ROOTFS_EXT2_4=y
BR2_TARGET_ROOTFS_TAR_GZIP=y

BR2_ROOTFS_DEVICE_CREATION_DYNAMIC_MDEV=y
BR2_ROOTFS_COMMON_OVERLAY="board/amlogic/common/rootfs/rootfs-49-audio/"
BR2_ROOTFS_OVERLAY="board/amlogic/mesonaxg_s410_sbr/rootfs/"
BR2_ROOTFS_UPGRADE_DIR="board/amlogic/common/upgrade/upgrade-axg/"
BR2_RECOVERY_OTA_DIR="board/amlogic/common/ota/ota-axg/"
#BR2_ROOTFS_POST_BUILD_SCRIPT="$(TOPDIR)/board/amlogic/mesonaxg_s420/bt_costdown_post_build.sh"
BR2_ROOTFS_POST_BUILD_SCRIPT="$(TOPDIR)/board/amlogic/mesonaxg_s410_sbr/post_build.sh"

BR2_LINUX_KERNEL=y
BR2_LINUX_KERNEL_CUSTOM_LOCAL_VERSION_VALUE="amlogic-4.9-dev"
BR2_LINUX_KERNEL_CUSTOM_LOCAL=y
BR2_LINUX_KERNEL_CUSTOM_LOCAL_PATH="$(TOPDIR)/../kernel/aml-4.9"
BR2_LINUX_KERNEL_DEFCONFIG="meson64_smarthome"
BR2_LINUX_KERNEL_IMAGE_LOADADDR="0x1008000"
BR2_LINUX_KERNEL_PATCH="amlogic-4.9"
BR2_LINUX_KERNEL_DTS_SUPPORT=y
BR2_LINUX_KERNEL_USE_INTREE_DTS=y
BR2_LINUX_KERNEL_INTREE_DTS_NAME="axg_s410_v03sbr"
BR2_LINUX_KERNEL_AMLOGIC_DTD=y
BR2_LINUX_KERNEL_ANDROID_FORMAT=y
BR2_LINUX_KERNEL_IMAGE=y
BR2_TARGET_BOARD_PLATFORM="mesonaxg"

BR2_TARGET_UBOOT=y
BR2_TARGET_UBOOT_CUSTOM_LOCAL=y
BR2_TARGET_UBOOT_CUSTOM_LOCAL_VERSION_VALUE="next-2015-dev"
BR2_TARGET_UBOOT_CUSTOM_LOCAL_LOCATION="$(TOPDIR)/../bootloader/uboot-repo"
BR2_TARGET_UBOOT_PATCH=""
BR2_TARGET_UBOOT_BOARDNAME="axg_s410_v1_sbr"
#BR2_TARGET_UBOOT_AMLOGIC_2015=y
BR2_TARGET_UBOOT_AMLOGIC_REPO=y
BR2_TARGET_UBOOT_PLATFORM="axg"
BR2_TARGET_USBTOOL_AMLOGIC=y
BR2_TARGET_USBTOOL_UBI_AMLOGIC=y
BR2_TARGET_UBOOT_AMLOGIC_BOOTARGS="root=/dev/ubi0_0 rootfstype=ubifs init=/sbin/init"

# Audio/Sound
BR2_PACKAGE_LIBSAMPLERATE=y
BR2_PACKAGE_ALSA_PLUGINS=y

#For ALSALIB
BR2_PACKAGE_ALSA_LIB=y
BR2_PACKAGE_ALSA_LIB_DEVDIR="/dev/snd"
BR2_PACKAGE_ALSA_LIB_PCM_PLUGINS="all"
BR2_PACKAGE_ALSA_LIB_CTL_PLUGINS="all"
BR2_PACKAGE_ALSA_LIB_ALOAD=y
BR2_PACKAGE_ALSA_LIB_MIXER=y
BR2_PACKAGE_ALSA_LIB_PCM=y
BR2_PACKAGE_ALSA_LIB_RAWMIDI=y
BR2_PACKAGE_ALSA_LIB_HWDEP=y
BR2_PACKAGE_ALSA_LIB_SEQ=y
BR2_PACKAGE_ALSA_LIB_ALISP=y
BR2_PACKAGE_ALSA_LIB_OLD_SYMBOLS=y

#For ALSAUTILS
BR2_PACKAGE_ALSA_UTILS=y
BR2_PACKAGE_ALSA_UTILS_ALSACTL=y
BR2_PACKAGE_ALSA_UTILS_ALSACONF=y
BR2_PACKAGE_ALSA_UTILS_AMIXER=y
BR2_PACKAGE_ALSA_UTILS_ALSAMIXER=y
BR2_PACKAGE_ALSA_UTILS_APLAY=y
BR2_PACKAGE_ALSA_UTILS_ALSALOOP=y
BR2_PACKAGE_ALSA_UTILS_ALSATPLG=y
BR2_PACKAGE_ALSA_UTILS_BAT=y
BR2_PACKAGE_ALSA_UTILS_IECSET=y
BR2_PACKAGE_ALSA_UTILS_SPEAKER_TEST=y

#ATMOS
BR2_PACKAGE_DOLBY_ATMOS_RELEASE=y

#For Audio Service
BR2_PACKAGE_DBUS=y
BR2_PACKAGE_AUDIOSERVICE=y
#BR2_PACKAGE_AUDIOSERVICE_FFMPEG=y
BR2_PACKAGE_AUDIOSERVICE_S410_SBR=y
BR2_PACKAGE_AUDIOSERVICE_STRESSTEST=y
BR2_PACKAGE_AUDIOSERVICE_AMLUART=y

#For rsyslog, needed by audio service
BR2_PACKAGE_RSYSLOG=y
BR2_PACKAGE_LIBESTR=y
BR2_PACKAGE_LIBFASTJSON=y
BR2_PACKAGE_LIBLOGGING=y

#For MTD
BR2_PACKAGE_MTD=y
BR2_PACKAGE_MTD_FLASHCP=y
BR2_PACKAGE_MTD_FLASH_ERASE=y
BR2_PACKAGE_MTD_FLASH_LOCK=y
BR2_PACKAGE_MTD_FLASH_UNLOCK=y
BR2_PACKAGE_MTD_MKFSUBIFS=y
BR2_PACKAGE_MTD_MTDINFO=y
BR2_PACKAGE_MTD_MTD_DEBUG=y
BR2_PACKAGE_MTD_NANDDUMP=y
BR2_PACKAGE_MTD_NANDTEST=y
BR2_PACKAGE_MTD_NANDWRITE=y
BR2_PACKAGE_MTD_UBIATTACH=y
BR2_PACKAGE_MTD_UBIDETACH=y
BR2_PACKAGE_MTD_UBIFORMAT=y
BR2_PACKAGE_MTD_UBIMKVOL=y
BR2_PACKAGE_MTD_UBINFO=y
BR2_PACKAGE_MTD_UBINIZE=y

#For BT
BR2_PACKAGE_AML_BRCM_BSA=y
#BR2_PACKAGE_SBC=y
#BR2_PACKAGE_BLUEZ5_UTILS=y
#BR2_PACKAGE_READLINE=y
#For BT Firmware
BR2_PACKAGE_WIFI_FW=y
BR2_PACKAGE_WIFI_FW_LOCAL=y
BR2_PACKAGE_WIFI_CUSTOM_GIT_VERSION="m-amlogic"
BR2_PACKAGE_WIFI_FW_CUSTOM_LOCAL_PATH="$(TOPDIR)/../hardware/aml-4.9/amlogic/wifi"
BR2_PACKAGE_WIFI_FW_WIFI_MODULE="AP6256"
BR2_PACKAGE_FAAD2=y

BR2_PACKAGE_BRCMAP6XXX=y
BR2_PACKAGE_BRCMAP6XXX_LOCAL=y
BR2_PACKAGE_BRCMAP6XXX_STANDALONE=y
BR2_PACKAGE_BRCMAP6XXX_GIT_VERSION="m-amlogic"
BR2_PACKAGE_BRCMAP6XXX_LOCAL_PATH="$(TOPDIR)/../hardware/aml-4.9/wifi/broadcom/drivers/ap6xxx"
BR2_PACKAGE_BRCMAP6XXX_SDIO_VERSION="bcmdhd.1.363.59.144.x.cn"
BR2_PACKAGE_BRCMAP6XXX_USB_VERSION="bcmdhd-usb.1.363.110.17.x"
BR2_PACKAGE_DHD_PRIV=y
BR2_PACKAGE_BRCM_SMARTCONFIG=y
BR2_PACKAGE_BRCM_SMARTCONFIG_LOCAL_PATH="$(TOPDIR)/../hardware/aml-4.9/amlogic/wifi/bcm_ampak/tools/easySetupTarget"

BR2_PACKAGE_HOSTAPD=y
BR2_PACKAGE_HOSTAPD_ACS=y
BR2_PACKAGE_HOSTAPD_EAP=y
BR2_PACKAGE_HOSTAPD_WPS=y
BR2_PACKAGE_DHCPCD=y
BR2_PACKAGE_DNSMASQ=y
BR2_PACKAGE_DNSMASQ_TFTP=y
BR2_PACKAGE_DNSMASQ_DHCP=y
BR2_PACKAGE_DNSMASQ_DNSSEC=y
BR2_PACKAGE_DNSMASQ_IDN=y
BR2_PACKAGE_DNSMASQ_CONNTRACK=y


#For Debug
BR2_PACKAGE_ANDROID_TOOLS=y
BR2_PACKAGE_ANDROID_TOOLS_FASTBOOT_GOOD_KERNEL_HEADERS=y
BR2_PACKAGE_ANDROID_TOOLS_ADBD=y
BR2_PACKAGE_AML_USB_CONFIG=y
BR2_PACKAGE_ADB_RNDIS=y
BR2_PACKAGE_AML_UTIL=y
BR2_PACKAGE_UTIL_LINUX_BINARIES=y
BR2_PACKAGE_OPENSSL=y

#----------Just for pass compile----------------#
##For WiFi, without wpa_supplicant/iw/wpa_cli, ramfile.list will report error.
BR2_PACKAGE_WPA_SUPPLICANT=y
BR2_PACKAGE_WPA_SUPPLICANT_CLI=y
BR2_PACKAGE_IW=y

#For SWUpdate, without swupdate, recovery.img will be generate
BR2_PACKAGE_AML_UBOOTENV=y
BR2_PACKAGE_AML_BOOTLOADER_MESSAGE=y
BR2_PACKAGE_SWUPDATE=y
BR2_PACKAGE_SWUPDATE_CONFIG="package/swupdate/swupdate.config"
```
