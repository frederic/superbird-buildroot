## buildroot/configs/a1_ad402_a32_release_defconfig
```kconfig
#----------------------------------------------------------#
#include "arch_a32_armv8_7.3.1.config"

#----------------------------------------------------------#
#include "a1_ad402.config"
BR2_TARGET_ROOTFS_INITRAMFS_LIST="board/amlogic/common/initramfs/initramfs-419/ramfslist-32-ubi-release"
```

## buildroot/configs/axg_s400_sbr_a6432_release_defconfig
```kconfig
#----------------------------------------------------------#
#include "arch_a6432_6.3.1.config"

#----------------------------------------------------------#
#include "a113_s400_PurelySBR.config"
#include "flash_nand_2k.config"
BR2_TARGET_ROOTFS_INITRAMFS_LIST="board/amlogic/common/initramfs/initramfs-49/ramfslist-32-ubi-release"
```

## buildroot/configs/c1_ae400-nand_legacy_a6432_release_defconfig
```kconfig
#----------------------------------------------------------#
#include "arch_a6432_7.3.1.config"

#----------------------------------------------------------#
#include "c1_ae400_legacy.config"
#include "flash_nand_4k.config"
BR2_PACKAGE_AML_RTOS=n
BR2_TARGET_ROOTFS_INITRAMFS_LIST="board/amlogic/mesonc1_ae400/initramfs/ramfslist-32-ubi-release"
```

## buildroot/configs/c1_ae400_a6432_release_defconfig
```kconfig
#----------------------------------------------------------#
#include "arch_a6432_7.3.1.config"

#----------------------------------------------------------#
#include "c1_ae400.config"
#include "flash_emmc.config"
BR2_TARGET_ROOTFS_INITRAMFS_LIST="board/amlogic/mesonc1_ae400/initramfs/ramfslist-32"
```

## buildroot/configs/c1_ae400_legacy_a64_release_defconfig
```kconfig
#----------------------------------------------------------#
#include "arch_a64_7.3.1.config"

#----------------------------------------------------------#
#include "c1_ae400_legacy.config"
#include "flash_emmc.config"
BR2_TARGET_ROOTFS_INITRAMFS_LIST="board/amlogic/mesonc1_ae400/initramfs/ramfslist-64"
```

## buildroot/configs/c1_ae401_a64_release_defconfig
```kconfig
#----------------------------------------------------------#
#include "arch_a64_7.3.1.config"

#----------------------------------------------------------#
#include "c1_ae401.config"
#include "flash_emmc.config"
BR2_TARGET_ROOTFS_INITRAMFS_LIST="board/amlogic/mesonc1_ae401/initramfs/ramfslist-64"
```

## buildroot/configs/g12a_u200_a6432_release_defconfig
```kconfig
#----------------------------------------------------------#
#include "arch_a6432_6.3.1.config"

#----------------------------------------------------------#
#include "g12a_u200.config"
BR2_TARGET_ROOTFS_INITRAMFS_LIST="board/amlogic/mesong12a_u200/initramfs/ramfslist-32"
```

## buildroot/configs/g12a_u211_a6432_release_defconfig
```kconfig
#----------------------------------------------------------#
#include "arch_a6432_6.3.1.config"

#----------------------------------------------------------#
#include "g12a_u211.config"
BR2_TARGET_ROOTFS_INITRAMFS_LIST="board/amlogic/mesong12a_u211/initramfs/ramfslist-32"
```

## buildroot/configs/g12a_u211_a64_release_defconfig
```kconfig
#----------------------------------------------------------#
#include "arch_a64_6.3.1.config"

#----------------------------------------------------------#
#include "g12a_u211.config"
BR2_PACKAGE_LAUNCHER_USE_COBALT=n
BR2_PACKAGE_COBALT=n
BR2_TARGET_ROOTFS_INITRAMFS_LIST="board/amlogic/mesong12a_u211/initramfs/ramfslist-64"
```

## buildroot/configs/g12a_u212_a6432_release_defconfig
```kconfig
#----------------------------------------------------------#
#include "arch_a6432_6.3.1.config"

#----------------------------------------------------------#
#include "g12a_u212.config"
BR2_TARGET_ROOTFS_INITRAMFS_LIST="board/amlogic/mesong12a_u212/initramfs/ramfslist-32"
```

## buildroot/configs/g12b_w400_a311_a64_release_defconfig
```kconfig
#----------------------------------------------------------#
#include "arch_a64_6.3.1.config"

#----------------------------------------------------------#
#include "g12b_w400_a311.config"
BR2_TARGET_ROOTFS_INITRAMFS_LIST="board/amlogic/mesong12b_w400/initramfs/ramfslist-64"
```

## buildroot/configs/g12b_w400_s922_a6432_release_defconfig
```kconfig
#----------------------------------------------------------#
#include "arch_a6432_6.3.1.config"

#----------------------------------------------------------#
#include "g12b_w400_s922.config"
BR2_TARGET_ROOTFS_INITRAMFS_LIST="board/amlogic/mesong12b_w400/initramfs/ramfslist-32"
```

## buildroot/configs/g12b_w400_s922_a64_release_defconfig
```kconfig
#----------------------------------------------------------#
#include "arch_a64_6.3.1.config"

#----------------------------------------------------------#
#include "g12b_w400_s922.config"
BR2_PACKAGE_LAUNCHER_USE_COBALT=n
BR2_PACKAGE_COBALT=n
BR2_TARGET_ROOTFS_INITRAMFS_LIST="board/amlogic/mesong12b_w400/initramfs/ramfslist-64"
```

## buildroot/configs/g12b_w411_a6432_release_defconfig
```kconfig
#----------------------------------------------------------#
#include "arch_a6432_6.3.1.config"

#----------------------------------------------------------#
#include "g12b_w411.config"
BR2_TARGET_ROOTFS_INITRAMFS_LIST="board/amlogic/mesong12b_w411/initramfs/ramfslist-32"
```

## buildroot/configs/gxl_p212_a64_release_defconfig
```kconfig
#----------------------------------------------------------#
#include "arch_a64_6.3.1.config"

#----------------------------------------------------------#
#include "gxl_p212.config"
BR2_TARGET_ROOTFS_INITRAMFS_LIST="board/amlogic/mesongxl_p212_kernel49/initramfs/ramfslist-64"
```

## buildroot/configs/gxl_p230_a6432_release_defconfig
```kconfig
#----------------------------------------------------------#
#include "arch_a6432_6.3.1.config"

#----------------------------------------------------------#
#include "gxl_p230.config"
BR2_TARGET_ROOTFS_INITRAMFS_LIST="board/amlogic/mesongxl_p230_32_kernel49/initramfs/ramfslist-32"
```

## buildroot/configs/gxl_p241_a6432_release_defconfig
```kconfig
#----------------------------------------------------------#
#include "arch_a6432_6.3.1.config"

#----------------------------------------------------------#
#include "gxl_p241.config"
BR2_TARGET_ROOTFS_INITRAMFS_LIST="board/amlogic/mesongxl_p241_kernel49/initramfs/ramfslist-32"
```

## buildroot/configs/gxl_p241_a64_release_defconfig
```kconfig
#----------------------------------------------------------#
#include "arch_a64_6.3.1.config"

#----------------------------------------------------------#
#include "gxl_p241.config"
BR2_TARGET_ROOTFS_INITRAMFS_LIST="board/amlogic/mesongxl_p241_kernel49/initramfs/ramfslist-64"
```

## buildroot/configs/gxlx_p271_a6432_release_defconfig
```kconfig
#----------------------------------------------------------#
#include "arch_a6432_6.3.1.config"

#----------------------------------------------------------#
#include "gxlx_p271.config"
BR2_TARGET_ROOTFS_INITRAMFS_LIST="board/amlogic/mesongxlx_p271/initramfs/ramfslist-32"
```
