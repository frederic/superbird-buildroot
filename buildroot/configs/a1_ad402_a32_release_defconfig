## buildroot/configs/mesonc1_ae400_a64_neu_release_defconfig
```kconfig
# Mirrors and Download locations
BR2_BACKUP_SITE="http://sources.buildroot.net"
# Architecture
BR2_aarch64=y
BR2_ARM_ENABLE_NEON=y
BR2_ARM_FPU_NEON=y
BR2_DEPRECATED=y


#-------------------------Toolchain-------------------------------#
BR2_TOOLCHAIN_EXTERNAL=y
BR2_TOOLCHAIN_EXTERNAL_PREINSTALLED=y
BR2_TOOLCHAIN_EXTERNAL_LINARO_AARCH64_7DOT3_201805_PREINSTALLED=y
BR2_TOOLCHAIN_EXTERNAL_PATH="$(TOPDIR)/../toolchain/gcc/linux-x86/aarch64/gcc-linaro-7.3.1-2018.05-x86_64_aarch64-linux-gnu"
BR2_KERNEL_TOOLCHAIN_PATH="$(TOPDIR)/../toolchain/gcc/linux-x86/aarch64/gcc-linaro-7.3.1-2018.05-x86_64_aarch64-linux-gnu"
BR2_KERNEL_TOOLCHAIN_LINARO_AARCH64_201805=y


#-------------------------Kernel-------------------------------#
#
BR2_LINUX_KERNEL=y
BR2_LINUX_KERNEL_CUSTOM_LOCAL_VERSION_VALUE="amlogic-4.19-dev"
BR2_LINUX_KERNEL_CUSTOM_LOCAL=y
BR2_LINUX_KERNEL_CUSTOM_LOCAL_PATH="$(TOPDIR)/../kernel/aml-4.19"
BR2_LINUX_KERNEL_DEFCONFIG="meson64_a64_smarthome"
BR2_TARGET_BOARD_PLATFORM="mesonc1"
#BR2_LINUX_KERNEL_IMAGE_LOADADDR="0x20000"
#BR2_LINUX_KERNEL_BOOTIMAGE_OFFSET="0x20000"
BR2_LINUX_KERNEL_IMAGE_LOADADDR="0x1008000"
BR2_LINUX_KERNEL_PATCH="amlogic-4.19"
BR2_LINUX_KERNEL_DTS_SUPPORT=y
BR2_LINUX_KERNEL_USE_INTREE_DTS=y
BR2_LINUX_KERNEL_INTREE_DTS_NAME="meson-c1-c308x-ae400"
BR2_LINUX_KERNEL_AMLOGIC_DTD=y
BR2_LINUX_KERNEL_ANDROID_FORMAT=y
BR2_LINUX_KERNEL_IMAGE=y
BR2_LINUX_KERNEL_IMAGE_NOGZIP=y

# Kernel Additional Config
BR2_PACKAGE_AML_CUSTOMIZE_KERNEL=y
BR2_PACKAGE_AML_CUSTOMIZE_KERNEL_ENABLE_OPT_LIST="CONFIG_NTFS_FS CONFIG_FUSE_FS"
BR2_PACKAGE_AML_AAA=y

#-------------------------Uboot-------------------------------#
##
BR2_TARGET_UBOOT=y
BR2_TARGET_UBOOT_CUSTOM_LOCAL=y
BR2_TARGET_UBOOT_CUSTOM_LOCAL_VERSION_VALUE="2019"
BR2_TARGET_UBOOT_CUSTOM_LOCAL_LOCATION="$(TOPDIR)/../bootloader/uboot-repo"
BR2_TARGET_UBOOT_PATCH=""
BR2_TARGET_UBOOT_BOARDNAME="c1_ae400"
BR2_TARGET_UBOOT_AMLOGIC_REPO=y
BR2_TARGET_UBOOT_PLATFORM="c1"


#-------------------------ROOTFS-------------------------------#
##
BR2_TARGET_ROOTFS_CPIO=y
#BR2_TARGET_ROOTFS_CPIO_GZIP=y
BR2_TARGET_ROOTFS_CPIO_UIMAGE=y
BR2_TARGET_ROOTFS_INITRAMFS_LIST="board/neucore/mesonc1_ae400/initramfs/ramfslist-64"
BR2_TARGET_ROOTFS_EXT2=y
BR2_TARGET_ROOTFS_EXT2_4=y
BR2_TARGET_ROOTFS_EXT2_SIZE="2048M"
BR2_TARGET_ROOTFS_TAR_GZIP=y
BR2_ROOTFS_DEVICE_CREATION_DYNAMIC_EUDEV=y
BR2_ROOTFS_COMMON_OVERLAY="board/neucore/common/rootfs/rootfs-419/"
BR2_ROOTFS_OVERLAY="board/neucore/mesonc1_ae400/rootfs/"
BR2_ROOTFS_UPGRADE_DIR="board/neucore/common/upgrade/upgrade-c1/"
BR2_ROOTFS_UPGRADE_DIR_OVERLAY="board/neucore/mesonc1_ae400/upgrade/"
BR2_ROOTFS_POST_BUILD_SCRIPT="$(TOPDIR)/board/neucore/mesonc1_ae400/post_build.sh"
BR2_RECOVERY_OTA_DIR="board/neucore/common/ota/ota-c1/"


#-------------------------NPU-------------------------------#
##
BR2_PACKAGE_NPU=y
BR2_PACKAGE_NPU_VERSION=""
BR2_PACKAGE_NPU_GIT_URL=""
BR2_PACKAGE_NPU_CUSTOM_TARBALL_LOCATION=""
BR2_PACKAGE_NPU_LOCAL=y
BR2_PACKAGE_NPU_LOCAL_PATH="$(TOPDIR)/../hardware/aml-4.19/npu/nanoq"
BR2_PACKAGE_NPU_NBG_IMAGE="c1_c308x_model.img"


#-------------------------ISP-------------------------------#
##
BR2_PACKAGE_ARM_ISP=y
BR2_PACKAGE_ARM_ISP_VERSION="amlogic-4.19-dev"
BR2_PACKAGE_ARM_ISP_LOCAL=y
BR2_PACKAGE_ARM_ISP_LOCAL_PATH="$(TOPDIR)/../hardware/aml-4.19/amlogic/arm_isp"


#-------------------------NN Detect-------------------------------#
##
BR2_PACKAGE_AML_NN_DETECT=y
BR2_PACKAGE_AML_NN_DETECT_LIBRARY=y
BR2_PACKAGE_AML_NN_DETECT_MTCNN_V1=y
BR2_PACKAGE_AML_NN_DETECT_YOLOFACE=y
BR2_PACKAGE_AML_NN_FACENET=y
BR2_PACKAGE_AML_NN_FACE_RECOGNITION=y
BR2_PACKAGE_AML_NN_FACE_DETECTION=y

#-------------------------Media Modules-------------------------------#
BR2_PACKAGE_MEDIA_MODULES=y
BR2_PACKAGE_MEDIA_MODULES_STANDALONE=y
BR2_PACKAGE_MEDIA_MODULES_LOCAL=y
BR2_PACKAGE_MEDIA_MODULES_LOCAL_PATH="$(TOPDIR)/../hardware/aml-4.19/amlogic/media_modules"
BR2_PACKAGE_MEDIA_MODLUES_VERSION="amlogic-4.19-dev"


#-------------------------WiFi/BT-------------------------------#
##
BR2_PACKAGE_WIFI_FW=y
BR2_PACKAGE_WIFI_FW_LOCAL=y
BR2_PACKAGE_WIFI_CUSTOM_GIT_VERSION="p-amlogic"
BR2_PACKAGE_WIFI_FW_CUSTOM_LOCAL_PATH="$(TOPDIR)/../hardware/aml-4.19/amlogic/wifi"
BR2_PACKAGE_WIFI_FW_WIFI_MODULE="AP6398"
BR2_PACKAGE_FAAD2=y

BR2_PACKAGE_AML_BRCM_BSA=y
BR2_PACKAGE_DHD_PRIV=y
BR2_PACKAGE_BRCMAP6XXX=y
BR2_PACKAGE_BRCMAP6XXX_LOCAL=y
BR2_PACKAGE_BRCMAP6XXX_STANDALONE=y
BR2_PACKAGE_BRCMAP6XXX_GIT_VERSION="q-amlogic"
BR2_PACKAGE_BRCMAP6XXX_LOCAL_PATH="$(TOPDIR)/../hardware/aml-4.19/wifi/broadcom/drivers/ap6xxx"
BR2_PACKAGE_BRCMAP6XXX_SDIO_VERSION="bcmdhd.100.10.315.x"
#BR2_PACKAGE_BRCMAP6XXX_USB_VERSION="bcmdhd-usb.1.363.110.17.x"
#BR2_PACKAGE_BRCM_SMARTCONFIG=y
#BR2_PACKAGE_BRCM_SMARTCONFIG_LOCAL_PATH="$(TOPDIR)/../hardware/aml-4.9/amlogic/wifi/bcm_ampak/tools/easySetupTarget"

#-------------------------Network-------------------------------#
##
BR2_PACKAGE_HOSTAPD=y
BR2_PACKAGE_HOSTAPD_ACS=y
BR2_PACKAGE_HOSTAPD_EAP=y
BR2_PACKAGE_HOSTAPD_WPS=y

BR2_PACKAGE_DHCPCD=y
BR2_SYSTEM_DHCP="eth0"

BR2_PACKAGE_DNSMASQ=y
BR2_PACKAGE_DNSMASQ_TFTP=y
BR2_PACKAGE_DNSMASQ_DHCP=y
BR2_PACKAGE_DNSMASQ_DNSSEC=y
BR2_PACKAGE_DNSMASQ_IDN=y
BR2_PACKAGE_DNSMASQ_CONNTRACK=y

BR2_PACKAGE_IW=y
BR2_PACKAGE_WPA_SUPPLICANT=y
BR2_PACKAGE_WPA_SUPPLICANT_CLI=y

BR2_PACKAGE_NETPLUG=y

BR2_TARGET_GENERIC_ROOT_PASSWD="123456"
BR2_PACKAGE_OPENSSH=y

BR2_PACKAGE_DROPBEAR=y
BR2_PACKAGE_DROPBEAR_CLIENT=y
BR2_PACKAGE_DROPBEAR_SMALL=y


#-------------------------ALSA-------------------------------#
##
BR2_PACKAGE_ALSA_UTILS=y
# FFTW for alsabat
BR2_PACKAGE_FFTW=y
BR2_PACKAGE_FFTW_FAST=y
#
# ALSA utils selection
#
BR2_PACKAGE_ALSA_UTILS_ALSACTL=y
BR2_PACKAGE_ALSA_UTILS_ALSACONF=y
BR2_PACKAGE_ALSA_UTILS_AMIXER=y
BR2_PACKAGE_ALSA_UTILS_ALSAMIXER=y
BR2_PACKAGE_ALSA_UTILS_APLAY=y
BR2_PACKAGE_ALSA_UTILS_ALSALOOP=y
BR2_PACKAGE_ALSA_UTILS_ALSATPLG=y
BR2_PACKAGE_ALSA_UTILS_BAT=y
BR2_PACKAGE_ALSA_UTILS_IECSET=y
BR2_PACKAGE_ALSA_UTILS_SPEAKER_TEST=y

#
# Audio/Sound
#
BR2_PACKAGE_ALSA_LIB=y
BR2_PACKAGE_LIBSAMPLERATE=y

#
# ALSA lib selection
#
BR2_PACKAGE_ALSA_LIB_DEVDIR="/dev/snd"
BR2_PACKAGE_ALSA_LIB_PCM_PLUGINS="all"
BR2_PACKAGE_ALSA_LIB_CTL_PLUGINS="all"
BR2_PACKAGE_ALSA_LIB_ALOAD=y
BR2_PACKAGE_ALSA_LIB_MIXER=y
BR2_PACKAGE_ALSA_LIB_PCM=y
BR2_PACKAGE_ALSA_LIB_RAWMIDI=y
BR2_PACKAGE_ALSA_LIB_HWDEP=y
BR2_PACKAGE_ALSA_LIB_SEQ=y
BR2_PACKAGE_ALSA_LIB_ALISP=y
BR2_PACKAGE_ALSA_LIB_OLD_SYMBOLS=y
BR2_PACKAGE_LIBMAD=y
BR2_PACKAGE_LIBMAD_OPTIMIZATION_DEFAULT=y
BR2_PACKAGE_LIBMAD_ASO=y
BR2_PACKAGE_AMAUDIO=y


#-------------------------SWUpdate-------------------------------#
#
BR2_PACKAGE_SWUPDATE=y
BR2_PACKAGE_SWUPDATE_CONFIG="package/swupdate/swupdate.config"
BR2_PACKAGE_SWUPDATE_INSTALL_WEBSITE=y
BR2_PACKAGE_AML_UBOOTENV=y
BR2_PACKAGE_AML_BOOTLOADER_MESSAGE=y
BR2_PACKAGE_BOA=y
BR2_PACKAGE_WEB_UI_WIFI=y


#-------------------------Debug-------------------------------#
##
#
# ANDROID_TOOLS
#
BR2_PACKAGE_ANDROID_TOOLS=y
BR2_PACKAGE_ANDROID_TOOLS_FASTBOOT_GOOD_KERNEL_HEADERS=y
BR2_PACKAGE_ANDROID_TOOLS_ADBD=y
BR2_PACKAGE_ADB_RNDIS=y

BR2_PACKAGE_HTOP=y
BR2_PACKAGE_PROCRANK_LINUX=y
BR2_PACKAGE_MEMSTAT=y
BR2_PACKAGE_RSYNC=y

BR2_PACKAGE_IOZONE=y


#-------------------------AML-SYSTEM-------------------------------#
BR2_PACKAGE_AML_SOC_FAMILY_NAME="C1"
BR2_PACKAGE_AML_UTIL=y
BR2_TARGET_USBTOOL_AMLOGIC=y
BR2_PACKAGE_AML_USB_CONFIG=y
#BR2_PACKAGE_AML_LIBS=y


#-------------------------MISC-------------------------------#
#
# gst-omx requires a OpenMAX implementation
#
BR2_PACKAGE_KODI_ARCH_SUPPORTS=y
BR2_PACKAGE_KODI_EGL_GLES=y
BR2_PACKAGE_GST_AML_PLUGINS1=y
BR2_PACKAGE_MPLAYER_ARCH_SUPPORTS=y
BR2_PACKAGE_WAVPACK=y

BR2_PACKAGE_GDB=n
BR2_PACKAGE_GDB_SERVER=y
BR2_PACKAGE_GDB_DEBUGGER=y
BR2_PACKAGE_DIRECTFB=y
BR2_PACKAGE_E2FSPROGS=y
BR2_PACKAGE_FBDUMP=y
BR2_PACKAGE_FBGRAB=n
BR2_PACKAGE_FBSET=y
BR2_PACKAGE_FBTERM=n
BR2_PACKAGE_FB_TEST_APP=n
BR2_PACKAGE_UTIL_LINUX_BINARIES=y
# other GUIs


# X.org XCB backend available if X.org is enabled
#
BR2_PACKAGE_OPENSSL=y
BR2_PACKAGE_OPENSSL_BIN=y
BR2_PACKAGE_OPENSSL_ENGINES=y
BR2_PACKAGE_SQLITE=y
BR2_PACKAGE_LIBJPEG=y
BR2_PACKAGE_JPEG=y
BR2_PACKAGE_NCURSES=y
BR2_PACKAGE_NCURSES_TARGET_PANEL=y
BR2_PACKAGE_NCURSES_TARGET_FORM=y
BR2_PACKAGE_NCURSES_TARGET_MENU=y
BR2_PACKAGE_KMOD=y
BR2_PACKAGE_REMOTECFG=y
BR2_PACKAGE_LIBCARES=y
BR2_PACKAGE_LIBCURL=y
BR2_PACKAGE_LIBEVENT=y
BR2_PACKAGE_CJSON=y
BR2_PACKAGE_LIBXSLT=y
BR2_PACKAGE_LIBNL=y
BR2_PACKAGE_VIM=n
BR2_PACKAGE_NTFS_3G=y


BR2_PACKAGE_DBUS=y

BR2_PACKAGE_XKEYBOARD_CONFIG=n
BR2_PACKAGE_LIBPTHREAD_STUBS=y
BR2_PACKAGE_LIBINPUT=n
BR2_PACKAGE_LIBXKBCOMMON=n
#Weston drm
BR2_PACKAGE_LINUX_PAM=y
#EUDEV, for wayland
BR2_PACKAGE_EUDEV=y
BR2_PACKAGE_PROVIDES_UDEV="eudev"
BR2_PACKAGE_EUDEV_ENABLE_HWDB=y
BR2_PACKAGE_HAS_UDEV=y
BR2_PACKAGE_MTDEV=y
BR2_PACKAGE_LIBEVDEV=y

#-------------------------RTOS-Depends------------------------------#
BR2_PACKAGE_AML_RTOS=y
BR2_PACKAGE_AML_RTOS_LOCAL_PATH="$(TOPDIR)/../vendor/amlogic/rtos/freertos"
BR2_PACKAGE_AML_RTOS_ARM_BUILD_OPTION="c1_c308x_ae400"
#BR2_PACKAGE_AML_RTOS_DSPA_BUILD_OPTION="c1_c308x_ae400_hifi4a"
#BR2_PACKAGE_AML_RTOS_DSPB_BUILD_OPTION="c1_c308x_ae400_hifi4b"
#BR2_PACKAGE_AML_RTOS_DSPA_INSTALL=y
#BR2_PACKAGE_AML_RTOS_DSPB_INSTALL=y


#-------------------------IPC-Depends------------------------------#
BR2_PACKAGE_AML_LIBGE2D_LOCAL_PATH="$(TOPDIR)/../hardware/aml-4.9/amlogic/libge2d"
BR2_PACKAGE_AML_LIBGDC_LOCAL_PATH="$(TOPDIR)/../hardware/aml-4.9/amlogic/libgdc"
BR2_PACKAGE_AML_LIBION_LOCAL_PATH="$(TOPDIR)/../hardware/aml-4.9/amlogic/libion"
BR2_PACKAGE_LIBVPCODEC_LOCAL_PATH="$(TOPDIR)/../hardware/aml-4.9/amlogic/libencoder/h264"
BR2_PACKAGE_LIBVPHEVCODEC_LOCAL_PATH="$(TOPDIR)/../hardware/aml-4.9/amlogic/libencoder/h265"
BR2_PACKAGE_LIBMULTIENC_LOCAL_PATH="$(TOPDIR)/../hardware/aml-4.9/amlogic/libencoder/multiEnc"
BR2_PACKAGE_AML_SOC_USE_MULTIENC=y

#-------------------------IPC-------------------------------#
##
BR2_PACKAGE_PTZ_CONTROL=y
BR2_LINUX_KERNEL_IRCUT=y
BR2_TARGET_TZ_INFO=y
BR2_PACKAGE_NTP=y
# for multi-lang of webui
BR2_GENERATE_LOCALE="en_US zh_CN"



#-------------------------GStreamer-------------------------------#
##

#
# Gstreamer 1
#
BR2_PACKAGE_GSTREAMER1=y
BR2_PACKAGE_GSTREAMER1_PARSE=y
BR2_PACKAGE_GSTREAMER1_TRACE=y
BR2_PACKAGE_GSTREAMER1_GST_DEBUG=y
BR2_PACKAGE_GSTREAMER1_PLUGIN_REGISTRY=y
BR2_PACKAGE_GSTREAMER1_INSTALL_TOOLS=y
BR2_PACKAGE_GST1_PLUGINS_BASE=y

#
# dependency-less plugins
#
BR2_PACKAGE_GST1_PLUGINS_BASE_PLUGIN_APP=y
BR2_PACKAGE_GST1_PLUGINS_BASE_PLUGIN_AUDIOCONVERT=y
BR2_PACKAGE_GST1_PLUGINS_BASE_PLUGIN_VIDEOCONVERT=y
BR2_PACKAGE_GST1_PLUGINS_BASE_PLUGIN_PLAYBACK=y
BR2_PACKAGE_GST1_PLUGINS_BASE_PLUGIN_AUDIORESAMPLE=y
BR2_PACKAGE_GST1_PLUGINS_BASE_PLUGIN_SUBPARSE=y
BR2_PACKAGE_GST1_PLUGINS_BASE_PLUGIN_TYPEFIND=y
BR2_PACKAGE_GST1_PLUGINS_BASE_PLUGIN_VIDEORATE=y
BR2_PACKAGE_GST1_PLUGINS_BASE_PLUGIN_VIDEOSCALE=y
BR2_PACKAGE_GST1_PLUGINS_BASE_PLUGIN_VOLUME=y

#
# plugins with external dependencies
#
BR2_PACKAGE_GST1_PLUGINS_BASE_PLUGIN_OGG=y
BR2_PACKAGE_GST1_PLUGINS_GOOD=y
BR2_PACKAGE_GST1_PLUGINS_GOOD_ZLIB=y

#
# dependency-less plugins
#
BR2_PACKAGE_GST1_PLUGINS_GOOD_PLUGIN_ALPHA=y
BR2_PACKAGE_GST1_PLUGINS_GOOD_PLUGIN_APETAG=y
BR2_PACKAGE_GST1_PLUGINS_GOOD_PLUGIN_AUDIOPARSERS=y
BR2_PACKAGE_GST1_PLUGINS_GOOD_PLUGIN_AUPARSE=y
BR2_PACKAGE_GST1_PLUGINS_GOOD_PLUGIN_AUTODETECT=y
BR2_PACKAGE_GST1_PLUGINS_GOOD_PLUGIN_AVI=y
BR2_PACKAGE_GST1_PLUGINS_GOOD_PLUGIN_DEINTERLACE=y
BR2_PACKAGE_GST1_PLUGINS_GOOD_PLUGIN_FLV=y
BR2_PACKAGE_GST1_PLUGINS_GOOD_PLUGIN_ICYDEMUX=y
BR2_PACKAGE_GST1_PLUGINS_GOOD_PLUGIN_ID3DEMUX=y
BR2_PACKAGE_GST1_PLUGINS_GOOD_PLUGIN_ISOMP4=y
BR2_PACKAGE_GST1_PLUGINS_GOOD_PLUGIN_MATROSKA=y
BR2_PACKAGE_GST1_PLUGINS_GOOD_PLUGIN_RTP=y
BR2_PACKAGE_GST1_PLUGINS_GOOD_PLUGIN_RTPMANAGER=y
BR2_PACKAGE_GST1_PLUGINS_GOOD_PLUGIN_RTSP=y
BR2_PACKAGE_GST1_PLUGINS_GOOD_PLUGIN_UDP=y
BR2_PACKAGE_GST1_PLUGINS_GOOD_PLUGIN_VIDEOFILTER=y

#
# plugins with external dependencies
#
BR2_PACKAGE_GST1_PLUGINS_GOOD_PLUGIN_SOUPHTTPSRC=y
BR2_PACKAGE_GST1_PLUGINS_GOOD_PLUGIN_TAGLIB=y
BR2_PACKAGE_GST1_PLUGINS_GOOD_PLUGIN_V4L2=y
BR2_PACKAGE_GST1_PLUGINS_BAD=y

#
# dependency-less plugins
#
BR2_PACKAGE_GST1_PLUGINS_BAD_PLUGIN_AIFF=y
BR2_PACKAGE_GST1_PLUGINS_BAD_PLUGIN_AUTOCONVERT=y
BR2_PACKAGE_GST1_PLUGINS_BAD_PLUGIN_ID3TAG=y
BR2_PACKAGE_GST1_PLUGINS_BAD_PLUGIN_INTERLACE=y
BR2_PACKAGE_GST1_PLUGINS_BAD_PLUGIN_IVFPARSE=y
BR2_PACKAGE_GST1_PLUGINS_BAD_PLUGIN_MPEGDEMUX=y
BR2_PACKAGE_GST1_PLUGINS_BAD_PLUGIN_MPEGTSDEMUX=y
BR2_PACKAGE_GST1_PLUGINS_BAD_PLUGIN_PCAPPARSE=y
BR2_PACKAGE_GST1_PLUGINS_BAD_PLUGIN_RAWPARSE=y
BR2_PACKAGE_GST1_PLUGINS_BAD_PLUGIN_SMOOTH=y
BR2_PACKAGE_GST1_PLUGINS_BAD_PLUGIN_VIDEOFILTERS=y
BR2_PACKAGE_GST1_PLUGINS_BAD_PLUGIN_VIDEOPARSERS=y

#
# plugins with external dependencies
#
BR2_PACKAGE_GST1_PLUGINS_BAD_PLUGIN_BZ2=y
BR2_PACKAGE_GST1_PLUGINS_BAD_PLUGIN_CURL=y
BR2_PACKAGE_GST1_PLUGINS_BAD_PLUGIN_DASH=y
BR2_PACKAGE_GST1_PLUGINS_BAD_PLUGIN_DIRECTFB=y
#
# gl needs the gst1-plugins-bad opengl library
#
BR2_PACKAGE_GST1_PLUGINS_BAD_PLUGIN_HLS=y
BR2_PACKAGE_GST1_PLUGINS_UGLY=n

#
# dependency-less plugins
#
BR2_PACKAGE_GST1_PLUGINS_UGLY_PLUGIN_ASFDEMUX=y
BR2_PACKAGE_GST1_PLUGINS_UGLY_PLUGIN_REALMEDIA=y

#
# plugins with external dependencies (there may be more available)
#
BR2_PACKAGE_GST1_VALIDATE=y

BR2_PACKAGE_GST1_RTSP_SERVER=y
```
