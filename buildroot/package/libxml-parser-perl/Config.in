## buildroot/package/libxml-parser-perl/Config.in
```kconfig
config BR2_PACKAGE_LIBXML_PARSER_PERL
       bool "libxml-parser-perl"
       select BR2_PACKAGE_EXPAT
       # Hide from configuration as we only support the host package
       # for the moment

       help
         The Perl XML::Parser module.
```

## buildroot/package/netcheck/Config.in
```kconfig
config BR2_PACKAGE_NETCHECK
    bool "upnp-net-check"
    help
        dlna net check.
```

## buildroot/package/weston/Config.in
```kconfig
comment "weston needs udev and a toolchain w/ locale, threads, dynamic library, headers >= 3.0"
	depends on !BR2_PACKAGE_HAS_UDEV || !BR2_TOOLCHAIN_HAS_THREADS || \
		!BR2_TOOLCHAIN_HEADERS_AT_LEAST_3_0 || BR2_STATIC_LIBS || \
		!BR2_ENABLE_LOCALE

config BR2_PACKAGE_WESTON
	bool "weston"
	depends on BR2_ENABLE_LOCALE # libinput
	depends on BR2_PACKAGE_HAS_UDEV
	depends on !BR2_STATIC_LIBS # wayland
	depends on BR2_TOOLCHAIN_HAS_THREADS # wayland
	depends on BR2_TOOLCHAIN_HEADERS_AT_LEAST_3_0
	select BR2_PACKAGE_WAYLAND
	select BR2_PACKAGE_WAYLAND_PROTOCOLS
	select BR2_PACKAGE_LIBXKBCOMMON
	select BR2_PACKAGE_CAIRO
	select BR2_PACKAGE_CAIRO_PNG
	select BR2_PACKAGE_LIBPNG
	select BR2_PACKAGE_JPEG
	select BR2_PACKAGE_MTDEV
	select BR2_PACKAGE_LIBINPUT
	# Runtime dependency
	select BR2_PACKAGE_XKEYBOARD_CONFIG
	# Make sure at least one compositor is selected.
	select BR2_PACKAGE_WESTON_FBDEV if !BR2_PACKAGE_WESTON_HAS_COMPOSITOR
	help
	  Weston is the reference implementation of a Wayland
	  compositor, and a useful compositor in its own right.
	  Weston has various backends that lets it run on Linux kernel
	  modesetting and evdev input as well as under X11.

	  http://wayland.freedesktop.org/

if BR2_PACKAGE_WESTON

config BR2_PACKAGE_WESTON_VERSION
	string ""

# Helper to make sure at least one compositor is selected.
config BR2_PACKAGE_WESTON_HAS_COMPOSITOR
	bool

config BR2_PACKAGE_WESTON_DRM
	bool "DRM compositor"
	depends on BR2_PACKAGE_MESON_MALI
	select BR2_PACKAGE_LIBDRM
	select BR2_PACKAGE_WESTON_HAS_COMPOSITOR

# Uses libgbm from mesa3d
comment "DRM compositor needs an OpenGL EGL backend provided by mesa3d"
	depends on !BR2_PACKAGE_MESA3D_OPENGL_EGL

if BR2_PACKAGE_WESTON_DRM

config BR2_PACKAGE_WESTON_DRM_HELPER
	bool "Meson DRM compositor helper framework"
	select BR2_PACKAGE_MESON_DISPLAY
	select BR2_PACKAGE_MESON_WESTON_DRM_HELPER
	help
	  This enable meson weston drm helper framework, which allows
	  weston through the ipc with ipc client.

endif


config BR2_PACKAGE_WESTON_FBDEV
	bool "fbdev compositor"

# FreeRDP needs threads and !static, already the case for weston
config BR2_PACKAGE_WESTON_RDP
	bool "RDP compositor"
	depends on BR2_USE_MMU # freerdp, libglib2
	depends on BR2_TOOLCHAIN_HAS_SYNC_4
	depends on BR2_USE_WCHAR # freerdp
	depends on BR2_INSTALL_LIBSTDCPP # freerdp
	select BR2_PACKAGE_FREERDP
	select BR2_PACKAGE_WESTON_HAS_COMPOSITOR
	help
	  This enables the RDP backend, which allows accessing weston
	  through the network with any RDP-compliant client.

	  Please note that one must pass those options to weston for RDP
	  to be functional:
	    --rdp-tls-cert=/path/to/server.crt
	    --rdp-tls-key=/path/to/server.key

	  By default, Buildroot installs such files in /etc/freerdp/server/
	  so you may want to change them in a post-build script or a rootfs
	  overlay.

comment "RDP compositor needs a toolchain w/ wchar, C++"
	depends on BR2_USE_MMU
	depends on BR2_TOOLCHAIN_HAS_SYNC_4
	depends on !BR2_USE_WCHAR || !BR2_INSTALL_LIBSTDCPP

config BR2_PACKAGE_WESTON_X11
	bool "X11 compositor"
	depends on BR2_PACKAGE_XORG7
	select BR2_PACKAGE_LIBXCB
	select BR2_PACKAGE_XLIB_LIBX11
	select BR2_PACKAGE_WESTON_HAS_COMPOSITOR

comment "X11 compositor needs X.org enabled"
	depends on !BR2_PACKAGE_XORG7

config BR2_PACKAGE_WESTON_XWAYLAND
	bool "XWayland support"
	depends on BR2_PACKAGE_XORG7
	depends on BR2_PACKAGE_LIBEPOXY
	select BR2_PACKAGE_CAIRO
	select BR2_PACKAGE_LIBXCB
	select BR2_PACKAGE_XLIB_LIBX11
	select BR2_PACKAGE_XLIB_LIBXCURSOR

comment "XWayland support needs libepoxy and X.org enabled"
	depends on !BR2_PACKAGE_XORG7 || !BR2_PACKAGE_LIBEPOXY

config BR2_PACKAGE_WESTON_DEMO_CLIENTS
	bool "demo clients"
	help
	  This enables the installation of Weston's demo clients.

config BR2_PACKAGE_WESTON_DRM_FIX_UI_SIZE
	bool "Use fixed ui size on differ display mode"
	help
	  Use fixed ui size on differ display mode.

config BR2_PACKAGE_WESTON_MAX_OUTPUT_PIPLINE
	int "max output pipline supported"
	default "1"
	help
	  For multi connector support, We set max output pipline and
	  use connector's priority config to enable maximum connectors.

if BR2_PACKAGE_WESTON_DRM
config BR2_PACKAGE_WESTON_OUTPUT_DYNAMIC_SWITCH
	bool "dynamic switch output hdmi/cvbs"
	default y
	help
	  For hdmi/cvbs bind with same crtc,hdmi and cvbs could not
	  output same time.
endif

source "package/weston/weston-daemon/Config.in"

endif
```

## buildroot/package/weston/weston-daemon/Config.in
```kconfig
config BR2_PACKAGE_WESTON_DAEMON
        bool "weston daemon"
	default y if BR2_PACKAGE_WESTON
```

## buildroot/toolchain/toolchain-external/toolchain-external-linaro-aarch64-4dot9/Config.in
```kconfig
config BR2_TOOLCHAIN_EXTERNAL_LINARO_AARCH64_4DOT9
	bool "Linaro AArch64 4.9-201602"
	depends on BR2_aarch64
	depends on BR2_HOSTARCH = "x86_64" || BR2_HOSTARCH = "x86"
	depends on !BR2_STATIC_LIBS
	select BR2_TOOLCHAIN_EXTERNAL_GLIBC
	select BR2_TOOLCHAIN_HAS_SSP
	select BR2_INSTALL_LIBSTDCPP
	select BR2_HOSTARCH_NEEDS_IA32_LIBS
	select BR2_TOOLCHAIN_HAS_NATIVE_RPC
	select BR2_TOOLCHAIN_HEADERS_AT_LEAST_4_0
	select BR2_TOOLCHAIN_GCC_AT_LEAST_4_9
	help
	  Toolchain for the AArch64 architecture, from
	  http://www.linaro.org/engineering/armv8/
```

## buildroot/toolchain/toolchain-external/toolchain-external-linaro-arm-6dot2-201702-preinstalled/Config.in
```kconfig
config BR2_TOOLCHAIN_EXTERNAL_LINARO_ARM_6DOT2_201702_PREINSTALLED
	bool "Linaro ARM 6.2-201702"
	depends on BR2_arm
	depends on BR2_ARM_CPU_ARMV7A || BR2_ARM_CPU_ARMV8
	depends on BR2_HOSTARCH = "x86_64" || BR2_HOSTARCH = "x86"
	depends on BR2_ARM_EABIHF
	depends on !BR2_STATIC_LIBS
	select BR2_TOOLCHAIN_EXTERNAL_GLIBC
	select BR2_TOOLCHAIN_HAS_SSP
	select BR2_TOOLCHAIN_HAS_NATIVE_RPC
	select BR2_INSTALL_LIBSTDCPP
	select BR2_TOOLCHAIN_HEADERS_AT_LEAST_4_6
	select BR2_TOOLCHAIN_GCC_AT_LEAST_6
	select BR2_TOOLCHAIN_HAS_FORTRAN
	help
	  Linaro toolchain for the ARM architecture.
```

## hardware/aml-4.9/arm/gpu/bifrost/r10p0/kernel/drivers/base/ump/Kconfig
```kconfig
#
# (C) COPYRIGHT 2012 ARM Limited. All rights reserved.
#
# This program is free software and is provided to you under the terms of the
# GNU General Public License version 2 as published by the Free Software
# Foundation, and any use by you of this program is subject to the terms
# of such GNU licence.
#
# This program is distributed in the hope that it will be useful,
# but WITHOUT ANY WARRANTY; without even the implied warranty of
# MERCHANTABILITY or FITNESS FOR A PARTICULAR PURPOSE. See the
# GNU General Public License for more details.
#
# You should have received a copy of the GNU General Public License
# along with this program; if not, you can access it online at
# http://www.gnu.org/licenses/gpl-2.0.html.
#
# SPDX-License-Identifier: GPL-2.0
#
#


config UMP
	tristate "Enable Unified Memory Provider (UMP) support"
	default n
    help
	  Enable this option to build support for the ARM UMP module.
	  UMP can be used by the Mali T6xx module to improve performance
	  by reducing the copying of data by sharing memory.

	  To compile this driver as a module, choose M here:
	  this will generate one module, called ump.
```

## hardware/aml-4.9/wifi/broadcom/drivers/ap6xxx/bcmdhd_1_201_59_x/Kconfig
```kconfig
config BCM6359
	tristate "Broadcom FullMAC wireless cards support"
	---help---
	  This module adds support for wireless adapters based on
	  Broadcom FullMAC chipset.

config BCMDHD_FW_PATH
	depends on BCM6359
	string "Firmware path"
	default "/system/etc/firmware/fw_bcmdhd.bin"
	---help---
	  Path to the firmware file.

config BCMDHD_NVRAM_PATH
	depends on BCM6359
	string "NVRAM path"
	default "/system/etc/firmware/nvram.txt"
	---help---
	  Path to the calibration file.

config BCMDHD_WEXT
	bool "Enable WEXT support"
	depends on BCM6359 && CFG80211 = n
	select WIRELESS_EXT
	select WEXT_PRIV
	help
	  Enables WEXT support

choice
	prompt "Enable Chip Interface"
	depends on BCM6359
	---help---
		Enable Chip Interface.
config BCMDHD_SDIO
		bool "SDIO bus interface support"
		depends on BCM6359 && MMC
config BCMDHD_PCIE
		bool "PCIe bus interface support"
		depends on BCM6359 && PCI
endchoice

choice
	depends on BCM6359 && BCMDHD_SDIO
	prompt "Interrupt type"
	---help---
		Interrupt type
config BCMDHD_OOB
	depends on BCM6359 && BCMDHD_SDIO
	bool "Out-of-Band Interrupt"
	default y
	---help---
		Interrupt from WL_HOST_WAKE.
config BCMDHD_SDIO_IRQ
	depends on BCM6359 && BCMDHD_SDIO
	bool "In-Band Interrupt"
	---help---
	  Interrupt from SDIO DAT[1]
endchoice
```

## hardware/aml-4.9/wifi/qualcomm/drivers/qca6174/AIO/drivers/backports/drivers/media/usb/msi2500/Kconfig
```kconfig
config USB_MSI2500
	depends on !BACKPORT_KERNEL_3_4
	tristate "Mirics MSi2500"
	depends on m
	depends on VIDEO_V4L2 && SPI
	select VIDEOBUF2_VMALLOC
	select MEDIA_TUNER_MSI001
```

## kernel/aml-4.9/drivers/amlogic/media/common/uvm/Kconfig
```kconfig
#
# uvm core configuration
#


menuconfig AMLOGIC_UVM_CORE
	bool "Amlogic unified video memory management"
	default n
	help
	  say y to enable Amlogic unified video memory management.
	  uvm wrap the video metadata info vframe_s so that decoder
	  and display can decouple.
```

## kernel/aml-4.9/drivers/amlogic/media/video_processor/vdetect/Kconfig
```kconfig
#
# Amlogic video2 device configuation
#

menu "V4L2 Video Support"

config AMLOGIC_VDETECT
		tristate "Amlogic v4l vdetect device support"
		depends on VIDEO_DEV
		select VIDEOBUF_GEN
		depends on AMLOGIC_MEDIA_COMMON
		depends on AMLOGIC_VIDEOBUF_RESOURCE
		depends on AMLOGIC_MEDIA_GE2D
		default n
		help
				Select to enable "Amlogic v4l vdetect device support.
endmenu
```

## multimedia/Config.in
```kconfig
menu "Audio and video applications"
source "../multimedia/alsa-plugins/Config.in"
source "../multimedia/amaudio/Config.in"
source "../multimedia/audiocapture/Config.in"
source "../multimedia/mediasupport/Config.in"
source "../multimedia/dolby_atmos_release/Config.in"
source "../multimedia/dolby_ms12_release/Config.in"
source "../multimedia/v4l2-uvm-test/Config.in"

# Gstreamer 0.10.x & Plugins
source "../multimedia/gst-fluendo-mpegdemux/Config.in"
source "../multimedia/gst-aml-plugins/Config.in"
source "../multimedia/gst-aml-plugins1/Config.in"
source "../multimedia/gst-app/Config.in"

source "../multimedia/libplayer/Config.in"
source "../multimedia/wifidisplay/Config.in"
source "../multimedia/test_tool/spdif_in_dd_decoder/Config.in"

# secure video firmware load 
source "../multimedia/secfirmload/Config.in"
# hal audio
source "../multimedia/aml_halaudio/Config.in"
# drm prebuild
source "../multimedia/libmediadrm/Config.in"
endmenu
```

## multimedia/aml_halaudio/Config.in
```kconfig
config BR2_PACKAGE_AML_HALAUDIO
        bool "aml_halaudio"
        select BR2_PACKAGE_ALSA_LIB
        select BR2_PACKAGE_CJSON
        help
          amlogic lib hal audio.

          http://openlinux.amlogic.com
```

## multimedia/aml_plugins/trumpet/dolby_daws_plugin/Config.in
```kconfig
config BR2_PACKAGE_DOLBY_DAWS_PLUGIN
	bool "dolby_daws_plugin"
	depends on BR2_PACKAGE_ALSA_LIB
	help
	  Advanced Linux Sound Architecture Plugins

	  http://www.alsa-project.org/
```

## multimedia/aml_plugins/trumpet/dolby_daws_security/Config.in
```kconfig
config BR2_PACKAGE_DOLBY_DAWS_SECURITY
	bool "dolby_daws_security"
	depends on BR2_PACKAGE_ALSA_LIB
	help
	  Advanced Linux Sound Architecture Plugins

	  http://www.alsa-project.org/
```

## multimedia/aml_plugins/trumpet/dolby_daws_service/Config.in
```kconfig
config BR2_PACKAGE_DOLBY_DAWS_SERVICE
	bool "dolby_daws_servicce"
	depends on BR2_PACKAGE_ALSA_LIB
	help
	  Advanced Linux Sound Architecture Plugins

	  http://www.alsa-project.org/
```

## multimedia/dolby_atmos_release/Config.in
```kconfig
config BR2_PACKAGE_DOLBY_ATMOS_RELEASE
	bool "dolby_atmos"
	help
	  Dolby Atmos For Soundbar Products
```

## multimedia/dolby_ms12_release/Config.in
```kconfig
config BR2_PACKAGE_DOLBY_MS12_RELEASE
	bool "dolby_ms12"
	help
	  Dolby MS12 For Soundbar Products
```

## multimedia/libmediadrm/Config.in
```kconfig
menu "Media DRM Prebuilt"
source "../multimedia/libmediadrm/widevine-bin/Config.in"
source "../multimedia/libmediadrm/libsecmem-bin/Config.in"
#source "../multimedia/libmediadrm/playready-bin/Config.in"
source "../multimedia/libmediadrm/youtubesign-bin/Config.in"
endmenu
```

## multimedia/libmediadrm/libsecmem-bin/Config.in
```kconfig
config BR2_PACKAGE_LIBSECMEM_BIN
        bool "libsecmem"
        select BR2_PACKAGE_TDK
        help
          libsecmem files.

          http://openlinux.amlogic.com
```

## multimedia/libmediadrm/widevine-bin/Config.in
```kconfig
config BR2_PACKAGE_WIDEVINE_BIN
        bool "widevine prebuilt"
        select BR2_PACKAGE_TDK
        help
          widevine prebuilt files.

          http://openlinux.amlogic.com
choice
        prompt "Widevine Version"
        default BR2_PACKAGE_WIDEVINE_BIN_VERSION_14
        depends on BR2_PACKAGE_WIDEVINE_BIN
        help
          Select the version of widevine so.

config BR2_PACKAGE_WIDEVINE_BIN_VERSION_10
        bool "widevine v10"
        help
          widevine prebuilt version v10 for 2017.

config BR2_PACKAGE_WIDEVINE_BIN_VERSION_14
        bool "widevine v14"
        help
          widevine prebuilt version v14 for 2019.

endchoice
```

## multimedia/libmediadrm/youtubesign-bin/Config.in
```kconfig
config BR2_PACKAGE_YOUTUBESIGN_BIN
        bool "youtube sign binary"
        select BR2_PACKAGE_TDK
        help
          prebuilt for youtube device sign.

          http://openlinux.amlogic.com
```

## multimedia/libplayer/Config.in
```kconfig
config BR2_PACKAGE_LIBPLAYER
        bool "libplayer"
        select BR2_PACKAGE_ALSA_LIB
        select BR2_PACKAGE_ZLIB
        select BR2_PACKAGE_LIBCURL
        help
          amlogic media player library.

          http://openlinux.amlogic.com
```

## multimedia/secfirmload/Config.in
```kconfig
config BR2_PACKAGE_SECFIRMLOAD
	bool "secfirmload"
	default n
	help
	  secure load  video firmware under optee.
	  
config BR2_PACKAGE_LAUNCHER_USE_SECFIRMLOAD
	bool "preload secure firmware when boot"
	default n
        depends on BR2_PACKAGE_SECFIRMLOAD
	help
	  preload secure firmware when boot.
	  
```

## multimedia/test_tool/spdif_in_dd_decoder/Config.in
```kconfig
config BR2_PACKAGE_SPDIF_IN_DD_DECODER
        bool "pdif_in_dd_decoder"
        depends on BR2_PACKAGE_ALSA_LIB
        help
        Advanced Linux Sound Architecture Plugins

        http://www.alsa-project.org/
```
