## buildroot/package/amlogic/aml_rtos/Config.in
```kconfig
config BR2_PACKAGE_AML_RTOS
	bool "AML RTOS"
    select BR2_PACKAGE_AML_DSP_UTIL
	help
	  Amlogic RTOS

config BR2_PACKAGE_AML_RTOS_LOCAL_PATH
	string "amlogic RTOS local path"
	depends on BR2_PACKAGE_AML_RTOS
	help
	aml rtos local path

config BR2_PACKAGE_AML_RTOS_PREBUILT_PATH
	string "amlogic RTOS prebuilt path"
	depends on BR2_PACKAGE_AML_RTOS
	help
	aml rtos prebuilt path

config BR2_PACKAGE_AML_RTOS_ARM_BUILD_OPTION
    string "AML RTOS ARM build option"
    depends on BR2_PACKAGE_AML_RTOS
    help
      AML RTOS ARM build option

config BR2_PACKAGE_AML_RTOS_DSPA_BUILD_OPTION
    string "AML RTOS DSPA build option"
    depends on BR2_PACKAGE_AML_RTOS
    help
      AML RTOS DSPA build option

config BR2_PACKAGE_AML_RTOS_DSPA_INSTALL
    bool "AML RTOS DSPA INSTALL to /usr/dsp"
    depends on BR2_PACKAGE_AML_RTOS
    help
      Whether we install dspA bin to /usr/dsp folder

config BR2_PACKAGE_AML_RTOS_DSPA_AUTOLOAD
    bool "Auto load DSP_A RTOS image"
    depends on BR2_PACKAGE_AML_RTOS_DSPA_INSTALL
    help
      Auto load DSP_A RTOS image

config BR2_PACKAGE_AML_RTOS_DSPB_BUILD_OPTION
    string "AML RTOS DSPB build option"
    depends on BR2_PACKAGE_AML_RTOS
    help
      AML RTOS DSPB build option

config BR2_PACKAGE_AML_RTOS_DSPB_INSTALL
    bool "AML RTOS DSPB INSTALL to /usr/dsp"
    depends on BR2_PACKAGE_AML_RTOS
    help
      Whether we install dspB bin to /usr/dsp folder

config BR2_PACKAGE_AML_RTOS_DSPB_AUTOLOAD
    bool "Auto load DSP_B RTOS image"
    depends on BR2_PACKAGE_AML_RTOS_DSPB_INSTALL
    help
      Auto load DSP_B RTOS image
```

## buildroot/package/amlogic/aml_share/Config.in
```kconfig
config BR2_PACKAGE_AML_CUSTOMIZE_KERNEL
	bool  "Strip kernel size by disable addon options"
	default n
	help
	  Allow project to disable additional kernel options to decrease size

if BR2_PACKAGE_AML_CUSTOMIZE_KERNEL

config BR2_PACKAGE_AML_CUSTOMIZE_KERNEL_DISABLE_OPT_LIST
	string  "Add-on disabled kernel options, separate by whitespace"
	default ""
	help
	  Please add project specified disabled kernel options which is not covered by buildroot by default

config BR2_PACKAGE_AML_CUSTOMIZE_KERNEL_ENABLE_OPT_LIST
	string  "Add-on enable kernel options, separate by whitespace"
	default ""
	help
	  Please add project specified enable kernel options which is not covered by buildroot by default

config BR2_PACKAGE_AML_CUSTOMIZE_KERNEL_SET_OPT_LIST
	string  "Add-on kernel options new value, separate by whitespace"
	default ""
	help
	  Please add project specified new kernel options value which is not covered by buildroot by default
endif

config BR2_PACKAGE_AML_SOC_FAMILY_NAME
	string "Amlogic SoC Family Name"
	default "TBD"
    help
	  Amlogic SoC Family Name, such as AXG, GXL, G12A, G12B, SM1, TM2, A1, C1

config BR2_PACKAGE_AML_SOC_CHIP_NAME
	string "Amlogic SoC CHIP Name"
	default "TBD"
    help
	  Amlogic SoC Chip Name, such as A113D, A113X, A113L, S905D, S905X

config BR2_PACKAGE_AML_SOC_CHIP_REV
	string "Amlogic SoC Chip Rev"
	default "TBD"
    help
	  Amlogic SoC Chip Rev RevA, RevB

config BR2_PACKAGE_AML_SOC_BOARD_NAME
	string "Amlogic SoC BOARD Name"
	default "TBD"
    help
	  Amlogic SoC Board Name, such as P212, W400, W411, AD401, AE400

config BR2_PACKAGE_AML_SOC_USE_MULTIENC
    bool "use multi-encoder library"
    default n
    help
      check if use multi-encoder library

config BR2_PACKAGE_AML_VENDOR_PARTITION
    bool "Support with vendor partition"
    default n
    help
      check if use vendor partition

if BR2_PACKAGE_AML_VENDOR_PARTITION
config BR2_PACKAGE_AML_VENDOR_PARTITION_SIZE
	string  "Vendor paritition size"
	default "256M"
	help
	  Please provide vendor partition size defined in DTS file

config BR2_PACKAGE_AML_VENDOR_PARTITION_PATH
	string  "Vendor partition content path"
	default ""
	help
	  Please provide vendor partition content path
endif
```

## buildroot/package/amlogic/aml_soundai/Config.in
```kconfig
config BR2_PACKAGE_AML_SOUNDAI
	bool "aml_soundai demo"

	select BR2_PACKAGE_VLC
	select BR2_PACKAGE_LIBIDN
	select BR2_PACKAGE_ALSA_LIB
	select BR2_PACKAGE_ALSA_UTILS

	help
	  aml_soundai_demo
```

## buildroot/package/amlogic/aml_speaker_process/Config.in
```kconfig
config BR2_PACKAGE_AML_SPEAKER_PROCESS
    bool "aml speaker process tool"
    help
        aml speaker process tool.
```

## buildroot/package/amlogic/aml_thermal/Config.in
```kconfig
comment "aml_thermal needs a Linux kernel to be built"
	depends on !BR2_LINUX_KERNEL

config BR2_PACKAGE_AML_THERMAL
	depends on BR2_LINUX_KERNEL
	bool "aml thermal control"
	help
		aml thermal control

config BR2_PACKAGE_AML_THERMAL_URL
	depends on BR2_PACKAGE_AML_THERMAL
	string "aml thermal url"
	help
		aml thermal url

config BR2_PACKAGE_AML_THERMAL_VERSION
	depends on BR2_PACKAGE_AML_THERMAL
	string "aml thermal version"
	help
		aml thermal version

config BR2_PACKAGE_AML_THERMAL_LOCAL
	bool "aml thermal local"
	help
		aml thermal local

config BR2_PACKAGE_AML_THERMAL_LOCAL_PATH
	string "aml thermal local path"
	depends on BR2_PACKAGE_AML_THERMAL_LOCAL
	help
		aml thermal local path
```

## buildroot/package/amlogic/aml_touch/Config.in
```kconfig
config BR2_PACKAGE_AML_TOUCH
	bool "aml touch"
	depends on BR2_LINUX_KERNEL	
	help
	  touch driver

config BR2_PACKAGE_AML_TOUCH_GIT_VERSION
	string "touch branch"
	depends on BR2_PACKAGE_AML_TOUCH
	help
		Branch for touch

config BR2_PACKAGE_AML_TOUCH_GIT_REPO_URL
	string "touch git"
	depends on BR2_PACKAGE_AML_TOUCH
	help
		touch git

config BR2_PACKAGE_AML_TOUCH_LOCAL
	bool "touch local"
	help
		touch local

config BR2_PACKAGE_AML_TOUCH_LOCAL_PATH
	string "touch local"
	depends on BR2_PACKAGE_AML_TOUCH_LOCAL
	help
		touch local path
```

## buildroot/package/amlogic/aml_tvin/Config.in
```kconfig
config BR2_PACKAGE_AML_TVIN
	bool "amltvin"
	depends on BR2_LINUX_KERNEL	
	help
	  tvin driver

config BR2_PACKAGE_AML_TVIN_GIT_VERSION
	string "tvin branch"
	depends on BR2_PACKAGE_AML_TVIN
	help
		Branch for tvin

config BR2_PACKAGE_AML_TVIN_GIT_REPO_URL
	string "tvin git"
	depends on BR2_PACKAGE_AML_TVIN
	help
		tvin git

config BR2_PACKAGE_AML_TVIN_LOCAL
	bool "tvin local"
	help
		tvin local

config BR2_PACKAGE_AML_TVIN_LOCAL_PATH
	string "tvin local path"
	depends on BR2_PACKAGE_AML_TVIN_LOCAL
	help
		tvin local path
```

## buildroot/package/amlogic/aml_tvserver/Config.in
```kconfig
config BR2_PACKAGE_AML_TVSERVER
        bool "aml_tvserver"
        select BR2_PACKAGE_DBUS
        select BR2_PACKAGE_HAL_AUDIO_SERVICE
        help
          amlogic tv library and bin.

          http://openlinux.amlogic.com
```

## buildroot/package/amlogic/aml_ubootenv/Config.in
```kconfig
config BR2_PACKAGE_AML_UBOOTENV
	bool "aml uboot env"
	depends on BR2_PACKAGE_ZLIB
	help
	  uboot env
```

## buildroot/package/amlogic/aml_usb_config/Config.in
```kconfig
config BR2_PACKAGE_AML_USB_CONFIG
	bool  "aml usb config"
	help
		usb function

if BR2_PACKAGE_AML_USB_CONFIG

config BR2_PACKAGE_MASS_STORAGE
	bool  "mass storage"
	help
		U disk function

config BR2_PACKAGE_ADB_RNDIS
	bool  "adb & rndis"
	help
		adb & rndis function

endif
```

## buildroot/package/amlogic/aml_zvbi/Config.in
```kconfig
config BR2_PACKAGE_AML_ZVBI
    bool "aml zvbi libs"
    help
        aml zvbi libs
```

## buildroot/package/amlogic/arm_isp/Config.in
```kconfig
config BR2_PACKAGE_ARM_ISP
	bool "arm isp"
	depends on BR2_LINUX_KERNEL
	help
	  arm isp drivers

config BR2_PACKAGE_ARM_ISP_VERSION
	string "arm isp version"
	depends on BR2_PACKAGE_ARM_ISP
	help
		match with kernel 4.9

config BR2_PACKAGE_ARM_ISP_GIT_VERSION
	string "arm isp branch"
	depends on BR2_PACKAGE_ARM_ISP
	help
		Branch for isp

config BR2_PACKAGE_ARM_ISP_GIT_REPO_URL
	string "arm isp git"
	depends on BR2_PACKAGE_ARM_ISP
	help
		arm isp git

config BR2_PACKAGE_ARM_ISP_LOCAL
	bool "arm isp local"
	help
		arm isp local

config BR2_PACKAGE_ARM_ISP_LOCAL_PATH
	string "arm isp local path"
	depends on BR2_PACKAGE_ARM_ISP_LOCAL
	help
		arm isp local path
```

## buildroot/package/amlogic/assistant-sdk/Config.in
```kconfig
config BR2_PACKAGE_ASSISTANT_SDK
	bool "assistant-sdk"
	help
	  This is a comment that explains what libfoo is.
```

## buildroot/package/amlogic/audioservice/Config.in
```kconfig
menuconfig BR2_PACKAGE_AUDIOSERVICE
	bool  "aml audioservice"
	select  BR2_PACKAGE_DBUS
	select  BR2_PACKAGE_DBUS_GLIB
	select  BR2_PACKAGE_CJSON
	select  BR2_PACKAGE_AML_HALAUDIO
	select  BR2_PACKAGE_RSYSLOG
	help
		demo app to show

if BR2_PACKAGE_AUDIOSERVICE

config BR2_PACKAGE_AUDIOSERVICE_PULSEAUDIO
	bool  "Enable audioservice with PulseAudio"
	select  BR2_PACKAGE_PULSEAUDIO
	select  BR2_PACKAGE_PULSEAUDIO_DAEMON
	default n

config BR2_PACKAGE_AUDIOSERVICE_FFMPEG
	bool  "Enable audioservice with ffmpeg"
	select  BR2_PACKAGE_FFMPEG
	default n

config BR2_PACKAGE_AUDIOSERVICE_ASR
	bool  "Enable audioservice client asr uartcmd"
	default n

config BR2_PACKAGE_AUDIOSERVICE_PYTHON
	bool  "Enable audioservice python client"
	select  BR2_PACKAGE_DBUS_PYTHON
	select  BR2_PACKAGE_PYTHON_PYEXPAT
	select  BR2_PACKAGE_PYTHON
	select  BR2_PACKAGE_PYTHON_GOBJECT
  default n

config BR2_PACKAGE_AUDIOSERVICE_S400_SBR
	bool  "Amlogic SoundBar Refernece platform"
	default n
	help
	  It's for dynamic control MCLK and SCLK.

config BR2_PACKAGE_AUDIOSERVICE_S410_SBR
	bool  "S410 SoundBar Refernece platform"
	default n
	help
	  It's for dynamic control MCLK and SCLK.

config BR2_PACKAGE_AUDIOSERVICE_CONFIG_FILE
	string "set the audioservice configuration file"
	default "default_audioservice_s400_sb.conf"
	help
		It selects which default_audioservice.conf

config BR2_PACKAGE_AUDIOSERVICE_EXTERNAL_M6350
	bool "Enable external M6350 device"
	default n
	help
		Enable external input handle m6350

config BR2_PACKAGE_AUDIOSERVICE_EXTERNAL_962E
	bool "Enable 962E device"
	default n
	help
		Enable 962E

config BR2_PACKAGE_AUDIOSERVICE_STRESSTEST
	bool "Enable stress test"
	default n

config BR2_PACKAGE_AUDIOSERVICE_USBPLAYER
	bool  "Enable usb Player in homeapp"
	select BR2_PACKAGE_FFMPEG
	select  BR2_PACKAGE_AML_AUDIO_PLAYER
	default n

config BR2_PACKAGE_AUDIOSERVICE_AIRPLAY
	bool  "Enable airplay client in homeapp"
	select BR2_PACKAGE_AIRPLAY2
	default n

config BR2_PACKAGE_AUDIOSERVICE_AMLUART
	bool  "Enable AMLUART client in homeapp"
	default n
endif
```

## buildroot/package/amlogic/avs-sdk/Config.in
```kconfig
config BR2_PACKAGE_AVS_SDK
	bool "avs-sdk"
	select BR2_PACKAGE_LIBGMIME
	select BR2_PACKAGE_LIBTOTEM
	select BR2_PACKAGE_LIBCURL
	select BR2_PACKAGE_NGHTTP2
	select BR2_PACKAGE_OPENSSL
	select BR2_PACKAGE_SQLITE
	select BR2_PACKAGE_GSTREAMER1
	select BR2_PACKAGE_GST1_PLUGINS_BASE
	select BR2_PACKAGE_PKGCONF
	select BR2_PACKAGE_LEDRING
	select BR2_PACKAGE_DBUS
	help
		The Alexa Voice Service (AVS) enables developers to integrate Alexa directly
	   	into their products, bringing the
		convenience of voice control to any connected device. AVS provides developers
	   	with access to a suite of resources
		to quickly and easily build Alexa-enabled products, including APIs, hardware
	   	development kits, software development kits, and documentation.

config BR2_AVS_DSPC_AEC
        bool "only enable DSPC AEC"

config BR2_AVS_AMAZON_WWE
        bool "enable amazon wwe"

config BR2_AVS_RDSPC
        bool "enable RDSPC AFE"

config BR2_PACKAGE_DISPLAYCARD_AML_IMP
        bool "enable avs displaycard ."
        default n

config BR2_AVS_CLIENT_API
        bool "enable client api support"
```

## buildroot/package/amlogic/bluez-alsa/Config.in
```kconfig
config BR2_PACKAGE_BLUEZ_ALSA
	bool "blue-alas"
	depends on BR2_PACKAGE_BLUEZ5_UTILS
	select BR2_PACKAGE_SBC
	select BR2_PACKAGE_FDK_AAC
	help
		audio plugins for bluez
```

## buildroot/package/amlogic/broadcom/Config.in
```kconfig
source "package/amlogic/broadcom/brcmap6xxx/Config.in"
source "package/amlogic/broadcom/brcm_smartconfig/Config.in"
source "package/amlogic/broadcom/brcmusi/Config.in"
source "package/amlogic/broadcom/dhd_priv/Config.in"
```

## buildroot/package/amlogic/broadcom/brcm_smartconfig/Config.in
```kconfig
config BR2_PACKAGE_BRCM_SMARTCONFIG
	bool "bcm_smartconfig"
	depends on BR2_LINUX_KERNEL
	help
		bcm smartconfig

config BR2_PACKAGE_BRCM_SMARTCONFIG_LOCAL_PATH
	string "bcm smartconfig code local path"
	help
		bcm smartconfig code local path
```

## buildroot/package/amlogic/broadcom/brcmap6xxx/Config.in
```kconfig
config BR2_PACKAGE_BRCMAP6XXX
	bool "brcmap6xxx"
	depends on BR2_LINUX_KERNEL	
	help
	  brcmap6xxx driver

config BR2_PACKAGE_BRCMAP6XXX_GIT_VERSION
	string "brcmap6xxx branch"
	depends on BR2_PACKAGE_BRCMAP6XXX
	help
		Branch for brcmap6xxx	

config BR2_PACKAGE_BRCMAP6XXX_GIT_REPO_URL
	string "brcmap6xxx git"
	depends on BR2_PACKAGE_BRCMAP6XXX
	help
		brcmap6xxx git

config BR2_PACKAGE_BRCMAP6XXX_LOCAL
	bool "brcmap6xxx local"
	help
		brcmap6xxx local

config BR2_PACKAGE_BRCMAP6XXX_LOCAL_PATH
	string "brcmap6xxx local path"
	depends on BR2_PACKAGE_BRCMAP6XXX_LOCAL
	help
		brcmap6xxx local path

config BR2_PACKAGE_BRCMAP6XXX_SDIO_VERSION
	string "brcmap6xxx sdio build version"
	depends on BR2_PACKAGE_BRCMAP6XXX_LOCAL
	help
		brcmap6xxx sdio build version

config BR2_PACKAGE_BRCMAP6XXX_PCI_VERSION
	string "brcmap6xxx pci build version"
	depends on BR2_PACKAGE_BRCMAP6XXX_LOCAL
	help
		brcmap6xxx pci build version

config BR2_PACKAGE_BRCMAP6XXX_USB_VERSION
	string "brcmap6xxx usb build version"
	depends on BR2_PACKAGE_BRCMAP6XXX_LOCAL
	help
		brcmap6xxx usb build version

config BR2_PACKAGE_BRCMAP6XXX_STANDALONE
	bool "standalone kernel module"
	depends on BR2_PACKAGE_BRCMAP6XXX
	help
	  compile ko directly
```

## buildroot/package/amlogic/broadcom/brcmusi/Config.in
```kconfig
config BR2_PACKAGE_BRCMUSI
	bool "brcmusi"
	depends on BR2_LINUX_KERNEL	
	help
	  brcm dhd driver

config BR2_PACKAGE_BRCMUSI_GIT_VERSION
	string "brcm usi branch"
	depends on BR2_PACKAGE_BRCMUSI
	help
		Branch for brcm usi

config BR2_PACKAGE_BRCMUSI_GIT_REPO_URL
	string "brcm usi git"
	depends on BR2_PACKAGE_BRCMUSI
	help
		brcm usi git

config BR2_PACKAGE_BRCMUSI_LOCAL
	bool "brcm usi local"
	help
		brcm usi local

config BR2_PACKAGE_BRCMUSI_LOCAL_PATH
	string "brcm usi local path"
	depends on BR2_PACKAGE_BRCMUSI_LOCAL
	help
		brcm usi local path
```

## buildroot/package/amlogic/chromium/Config.in
```kconfig
config BR2_PACKAGE_CHROMIUM
	bool "Build Chromium package"
	select BR2_PACKAGE_PCIUTILS
	select BR2_PACKAGE_PULSEAUDIO
	select BR2_PACKAGE_KRB5
	select BR2_PACKAGE_LIBEXIF
	select BR2_PACKAGE_GCONF
	select BR2_PACKAGE_LIBXKBCOMMON
	select BR2_PACKAGE_CUPS
	select BR2_PACKAGE_LIBNSS
	select BR2_PACKAGE_PANGO
	select BR2_PACKAGE_LIBPLAYER
	select BR2_PACKAGE_WAYLAND
	select BR2_PACKAGE_WAYLAND_PROTOCOLS
	select BR2_PACKAGE_CA_CERTIFICATES

	help
	  chromium browser

#	select BR2_PACKAGE_CAIRO
#	select BR2_PACKAGE_FONTCONFIG
#	select BR2_PACKAGE_LIBCAP
#	select BR2_PACKAGE_NINJA
#	select BR2_PACKAGE_WAYLAND
#	select BR2_PACKAGE_OPENSSL

if BR2_PACKAGE_CHROMIUM

choice
	prompt "chromium compile mode choice"
	default BR2_PACKAGE_CHROMIUM_PREBUILT
	help
	  Select using prebuilt chromium bin or recompile chromium project.

config BR2_PACKAGE_CHROMIUM_COMPILE_ALL
	bool "recompile the total chromium"
    select BR2_PACKAGE_BROWSER_TOOLCHAIN_DEPOT_TOOLS
    select BR2_PACKAGE_BROWSER_TOOLCHAIN_GCC_LINARO_AARCH64 if BR2_aarch64
    select BR2_PACKAGE_BROWSER_TOOLCHAIN_GCC_LINARO_ARMEABIHF if BR2_arm

config BR2_PACKAGE_CHROMIUM_PREBUILT
	bool "Use prebuilt chromium bin"

endchoice

config BR2_PACKAGE_CHROMIUM_ENABLE_WIDEVINE
    depends on BR2_PACKAGE_CHROMIUM_COMPILE_ALL
    bool "enable widevine"
    default n

menuconfig BR2_PACKAGE_CHROMIUM_ENABLE_CCACHE
    depends on BR2_PACKAGE_CHROMIUM_COMPILE_ALL
    bool "enable ccache for chromium compilation"

if BR2_PACKAGE_CHROMIUM_ENABLE_CCACHE
config BR2_PACKAGE_CHROMIUM_CCACHE_BIN_PATH
    string "ccache binary path"
    default "ccache"
    help
        set the ccache binary path
endif

endif
```
