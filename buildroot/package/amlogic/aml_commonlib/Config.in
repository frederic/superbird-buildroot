## buildroot/package/amlogic/aml_commonlib/Config.in
```kconfig
config BR2_PACKAGE_AML_COMMONLIB
	bool "aml common library"
	help
	  aml common library
```

## buildroot/package/amlogic/aml_cypress_bsa/Config.in
```kconfig
config BR2_PACKAGE_AML_CYPRESS_BSA
    bool "cypress bsa server and app"
    default n
    help
	cypress bsa server and app

config BR2_AML_BT_DSPC
    bool "bluetooth audio capture use libdspc"
    default n
    help
	bluetooth audio capture use libdspc
```

## buildroot/package/amlogic/aml_dsp_util/Config.in
```kconfig
config BR2_PACKAGE_AML_DSP_UTIL
    bool "aml_dsp_util"
    help
        amlogic DSP utility
```

## buildroot/package/amlogic/aml_dvb/Config.in
```kconfig
config BR2_PACKAGE_AML_DVB
    bool "aml dvb libs"
    help
        aml dvb libs
```

## buildroot/package/amlogic/aml_launcher/Config.in
```kconfig
config BR2_PACKAGE_AML_LAUNCHER
	bool "amlogic launcher"
    help
        Configure AML Browser launcher

choice
        bool "choose a launcher"
        default BR2_PACKAGE_LAUNCHER_USE_CHROME if BR2_PACKAGE_CHROMIUM
        default BR2_PACKAGE_LAUNCHER_USE_COBALT if !BR2_PACKAGE_CHROMIUM && BR2_PACKAGE_COBALT
        default BR2_PACKAGE_LAUNCHER_USE_WPE if !BR2_PACKAGE_CHROMIUM && !BR2_PACKAGE_COBALT && BR2_PACKAGE_WPE_LAUNCHER
        default BR2_PACKAGE_LAUNCHER_USE_DIRECTFB if !BR2_PACKAGE_CHROMIUM && !BR2_PACKAGE_COBALT && !BR2_PACKAGE_WPE_LAUNCHER && BR2_PACKAGE_DIRECTFB
        default BR2_PACKAGE_LAUNCHER_NONE if !BR2_PACKAGE_CHROMIUM && !BR2_PACKAGE_COBALT && !BR2_PACKAGE_WPE_LAUNCHER && !BR2_PACKAGE_DIRECTFB
        help
                choose chrome or WPE launcher, or none

config BR2_PACKAGE_LAUNCHER_USE_CHROME
        bool "chrome"
        help
                use chrome as launcher

config BR2_PACKAGE_LAUNCHER_USE_COBALT
        bool "cobalt"
        help
                use cobalt as launcher

config BR2_PACKAGE_LAUNCHER_USE_WPE
        bool "wpe"
        help
                use wpe as launcher

config BR2_PACKAGE_LAUNCHER_USE_DIRECTFB
	bool "directfb"
	help
		use directfb as launcher

config BR2_PACKAGE_LAUNCHER_NONE
        bool "none"
        help
                Do not use launcher

endchoice
```

## buildroot/package/amlogic/aml_libgdc/Config.in
```kconfig
config BR2_PACKAGE_AML_LIBGDC
    bool "GDC library"
    select BR2_PACKAGE_AML_LIBION
    help
        Support AML GDC library

config BR2_PACKAGE_AML_LIBGDC_LOCAL_PATH
    string "amlogic libgdc local path"
    depends on BR2_PACKAGE_AML_LIBGDC
    help
        aml gdc local path
```

## buildroot/package/amlogic/aml_libge2d/Config.in
```kconfig
config BR2_PACKAGE_AML_LIBGE2D
    bool "GE2D library"
    select BR2_PACKAGE_AML_LIBION
    help
        Support AML GE2D library

config BR2_PACKAGE_AML_LIBGE2D_LOCAL_PATH
    string "amlogic libge2d local path"
    depends on BR2_PACKAGE_AML_LIBGE2D
    help
        aml ge2d local path
```

## buildroot/package/amlogic/aml_libion/Config.in
```kconfig
config BR2_PACKAGE_AML_LIBION
    bool "aml_libion"
    help
      amlogic libion

config BR2_PACKAGE_AML_LIBION_LOCAL_PATH
    string "amlogic libion local path"
    depends on BR2_PACKAGE_AML_LIBION
	help
    aml ion local path
```

## buildroot/package/amlogic/aml_libs_nf/Config.in
```kconfig
config BR2_PACKAGE_AML_LIBS_NF
        bool "aml_libs_nf"
        help
          amlogic media player library for netflix.

          http://openlinux.amlogic.com
```

## buildroot/package/amlogic/aml_minigbm/Config.in
```kconfig
config BR2_PACKAGE_AML_MINIGBM
	bool "Amlogic Minigbm"
	select BR2_PACKAGE_LIBDRM
	help
	    amlogic minigbm programs
```

## buildroot/package/amlogic/aml_minigbmtest/Config.in
```kconfig
config BR2_PACKAGE_AML_MINIGBMTEST
	bool "Amlogic Minigbm Test"
	default y
	depends on BR2_PACKAGE_AML_MINIGBM
	depends on BR2_PACKAGE_LIBDRM
	help
	    amlogic minigbmtest programs
```

## buildroot/package/amlogic/aml_nand/Config.in
```kconfig
config BR2_PACKAGE_AML_NAND
	bool "amlogic Nand FTL"
	help
	  amlogic Nand FTL support

config BR2_PACKAGE_AML_NAND_VERSION
	string "amlogic nand branch" 
	depends on BR2_PACKAGE_AML_NAND
	help
	  the branch of amlogic nand

config BR2_PACKAGE_AML_NAND_GIT_URL
	string "amlogic nand git url"
	depends on BR2_PACKAGE_AML_NAND
	help
	  the URL of amlogic nand git

config BR2_PACKAGE_AML_NAND_LOCAL
	bool "amlogic nand local"
	help
		amlogic nand local

config BR2_PACKAGE_AML_NAND_LOCAL_PATH
	string "amlogic nand local path"
	depends on BR2_PACKAGE_AML_NAND_LOCAL
	help
		amlogic nand local path

config BR2_PACKAGE_AML_NAND_STANDALONE
	bool "standalone kernel module"
	depends on BR2_PACKAGE_AML_NAND
	help
	  compile ko directly
```

## buildroot/package/amlogic/aml_nn_detect_library/Config.in
```kconfig
config BR2_PACKAGE_AML_NN_DETECT_LIBRARY
    bool "aml nn_detect library"
    help
        Support nn detection library

if BR2_PACKAGE_AML_NN_DETECT_LIBRARY
menu "model sopport"
source "package/amlogic/aml_nn_detect_library/aml_nn_detect/Config.in"
endmenu
endif
```

## buildroot/package/amlogic/aml_nn_detect_library/aml_nn_detect/Config.in
```kconfig
config BR2_PACKAGE_AML_NN_DETECT
    bool "aml nn_detect"
    help
        Support nn detection base library

if BR2_PACKAGE_AML_NN_DETECT
source "package/amlogic/aml_nn_detect_library/aml_nn_detect_mtcnn_v1/Config.in"
source "package/amlogic/aml_nn_detect_library/aml_nn_detect_yolo_v2/Config.in"
source "package/amlogic/aml_nn_detect_library/aml_nn_detect_yolo_v3/Config.in"
source "package/amlogic/aml_nn_detect_library/aml_nn_detect_yoloface/Config.in"
source "package/amlogic/aml_nn_detect_library/aml_nn_facenet/Config.in"
source "package/amlogic/aml_nn_detect_library/aml_nn_face_recognition/Config.in"
source "package/amlogic/aml_nn_detect_library/aml_nn_face_detection/Config.in"
endif
```

## buildroot/package/amlogic/aml_nn_detect_library/aml_nn_detect_mtcnn_v1/Config.in
```kconfig
config BR2_PACKAGE_AML_NN_DETECT_MTCNN_V1
    bool "aml nn_detect mtcnn library"
    help
        Support mtcnn_v1 detection
```

## buildroot/package/amlogic/aml_nn_detect_library/aml_nn_detect_yolo_v2/Config.in
```kconfig
config BR2_PACKAGE_AML_NN_DETECT_YOLO_V2
    bool "aml nn_detect yolo_v2 library"
    depends on BR2_PACKAGE_NPU
    help
        Support yolo_v2 detection
```

## buildroot/package/amlogic/aml_nn_detect_library/aml_nn_detect_yolo_v3/Config.in
```kconfig
config BR2_PACKAGE_AML_NN_DETECT_YOLO_V3
    bool "aml nn_detect yolo_v3 library"
    depends on BR2_PACKAGE_NPU
    help
        Support yolo_v3 detection
```

## buildroot/package/amlogic/aml_nn_detect_library/aml_nn_detect_yoloface/Config.in
```kconfig
config BR2_PACKAGE_AML_NN_DETECT_YOLOFACE
    bool "aml nn_detect yoloface library"
    depends on BR2_PACKAGE_NPU
    help
        Support yoloface detection
```

## buildroot/package/amlogic/aml_nn_detect_library/aml_nn_face_detection/Config.in
```kconfig
config BR2_PACKAGE_AML_NN_FACE_DETECTION
    bool "aml nn face detection library"
    depends on BR2_PACKAGE_NPU
    help
        Support nn face detection library
```

## buildroot/package/amlogic/aml_nn_detect_library/aml_nn_face_recognition/Config.in
```kconfig
config BR2_PACKAGE_AML_NN_FACE_RECOGNITION
    bool "aml nn face recognition library"
    depends on BR2_PACKAGE_NPU
    select BR2_PACKAGE_OPENCV3
    select BR2_PACKAGE_OPENCV3_LIB_HIGHGUI
    select BR2_PACKAGE_OPENCV3_GUI_NONE
    select BR2_PACKAGE_OPENCV3_LIB_IMGCODECS
    select BR2_PACKAGE_OPENCV3_LIB_IMGPROC
    select BR2_PACKAGE_OPENCV3_LIB_VIDEOIO
    select BR2_PACKAGE_OPENCV3_WITHOUT_GSTREAMER
    select BR2_PACKAGE_OPENCV3_WITH_V4L
    select BR2_PACKAGE_OPENCV3_LIB_VIDEO
    help
        Support nn face recognition library
```

## buildroot/package/amlogic/aml_nn_detect_library/aml_nn_facenet/Config.in
```kconfig
config BR2_PACKAGE_AML_NN_FACENET
    bool "aml nn facenet library"
    depends on BR2_PACKAGE_NPU
    help
        Support nn facenet library
```

## buildroot/package/amlogic/aml_pdm_mic_test/Config.in
```kconfig
config BR2_PACKAGE_AML_PDM_MIC_TEST
    bool "aml_pdm_mic_test"
    help
      aml_pdm_mic_test package is an algorithm and tool 
	  for detecting virtual welding and sensitivity.
```

## buildroot/package/amlogic/aml_pmu/Config.in
```kconfig
config BR2_PACKAGE_AML_PMU
	bool "aml pmu"
	depends on BR2_LINUX_KERNEL	
	help
	  pmu driver

config BR2_PACKAGE_AML_PMU_GIT_VERSION
	string "pmu branch"
	depends on BR2_PACKAGE_AML_PMU
	help
		Branch for pmu

config BR2_PACKAGE_AML_PMU_GIT_REPO_URL
	string "pmu git"
	depends on BR2_PACKAGE_AML_PMU
	help
		pmu git

config BR2_PACKAGE_AML_PMU_LOCAL
	bool "pmu local"
	help
		pmu local

config BR2_PACKAGE_AML_PMU_LOCAL_PATH
	string "pmu local path"
	depends on BR2_PACKAGE_AML_PMU_LOCAL
	help
		pmu local path
```

## buildroot/package/amlogic/aml_provision/Config.in
```kconfig
config BR2_PACKAGE_AML_PROVISION
	bool "provision ca and ta"
	help
	  provision ca and ta
```
