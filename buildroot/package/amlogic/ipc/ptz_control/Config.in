## buildroot/package/amlogic/ipc/ptz_control/Config.in
```kconfig
config BR2_PACKAGE_PTZ_CONTROL
	bool "ptz control package"
	default n
	help
	  ptz control
```

## buildroot/package/amlogic/ledring/Config.in
```kconfig
config BR2_PACKAGE_LEDRING
    bool "LED ring light"
    select BR2_PACKAGE_POPT
    help
        led ring light.
```

## buildroot/package/amlogic/liblog/Config.in
```kconfig
config BR2_PACKAGE_LIBLOG
    bool "liblog"
    help
      logger library
      
```

## buildroot/package/amlogic/libmultienc/Config.in
```kconfig
config BR2_PACKAGE_LIBMULTIENC
	bool "amlogic h264/h265 multi video encoder"
	select BR2_PACKAGE_AML_LIBGE2D
	help
	  h264/h265 multi video encoder library

config BR2_PACKAGE_LIBMULTIENC_LOCAL_PATH
    string "amlogic h264/h265 multi video encoder local path"
    depends on BR2_PACKAGE_LIBMULTIENC
	help
    aml h264/h265 video encoder local path
```

## buildroot/package/amlogic/librespot-sync/Config.in
```kconfig
config BR2_PACKAGE_LIBRESPOT_SYNC
	bool "librespot-sync"
	help
		spotify connector call librespot_sync
```

## buildroot/package/amlogic/librespot/Config.in
```kconfig
config BR2_PACKAGE_LIBRESPOT
	bool "librespot"
	select BR2_PACKAGE_ALSA_LIB
	help
	     spotify connector call librespot
```

## buildroot/package/amlogic/libtotem/Config.in
```kconfig
config BR2_PACKAGE_LIBTOTEM
	bool "libtotem"
	select BR2_PACKAGE_LIBGLIB2
	select BR2_PACKAGE_GLIB_NETWORKING
	select BR2_PACKAGE_LIBSOUP
	select BR2_PACKAGE_LIBXML2
	select BR2_PACKAGE_LIBARCHIVE
	select BR2_PACKAGE_LIBGCRYPT
	select BR2_PACKAGE_LIBTOOL
	depends on BR2_USE_WCHAR
	depends on BR2_TOOLCHAIN_HAS_THREADS
	depends on BR2_USE_MMU
	help
		totem-pl-parser is a simple GObject-based library to parse a host of
		playlist formats, as well as save those
```

## buildroot/package/amlogic/libvpcodec/Config.in
```kconfig
config BR2_PACKAGE_LIBVPCODEC
	bool "amlogic h264 video encoder"
	help
	  h264 video encoder library

config BR2_PACKAGE_LIBVPCODEC_LOCAL_PATH
    string "amlogic h264 video encoder local path"
    depends on BR2_PACKAGE_LIBVPCODEC
	help
    aml h264 video encoder local path
```

## buildroot/package/amlogic/libvphevcodec/Config.in
```kconfig
config BR2_PACKAGE_LIBVPHEVCODEC
	bool "amlogic h265 video encoder"
	select BR2_PACKAGE_AML_LIBGE2D
	help
	  h265 video encoder library

config BR2_PACKAGE_LIBVPHEVCODEC_LOCAL_PATH
    string "amlogic h265 video encoder local path"
    depends on BR2_PACKAGE_LIBVPHEVCODEC
	help
    aml h265 video encoder local path
```

## buildroot/package/amlogic/logcat/Config.in
```kconfig
config BR2_PACKAGE_LOGCAT
    bool "logcat"
    select BR2_PACKAGE_LIBLOG
    select BR2_PACKAGE_LOGWRAPPER
    help
      logcat
```

## buildroot/package/amlogic/marvell/mrvl_wifibt/Config.in
```kconfig
config BR2_PACKAGE_MRVL_WIFIBT
	bool "marvell wifi/bt"
	depends on BR2_LINUX_KERNEL
	help
	marvell wifi/bt

config BR2_PACKAGE_SD8977
	bool "sd8977"
	depends on BR2_PACKAGE_MRVL_WIFIBT
	help
	marvell sd8977 support

config BR2_PACKAGE_SD8987
	bool "sd8987"
	depends on BR2_PACKAGE_MRVL_WIFIBT
	help
	marvell sd8987 support

config BR2_PACKAGE_MRVL_WIFI_LOCAL_PATH
	string "marvell wifi driver local path"
	depends on BR2_PACKAGE_MRVL_WIFIBT
	help
	marvell wifi local path

config BR2_PACKAGE_MRVL_BT_LOCAL_PATH
	string "marvell bt driver local path"
	depends on BR2_PACKAGE_MRVL_WIFIBT
	help
	marvell bt local path

config BR2_PACKAGE_MRVL_FW_LOCAL_PATH
	string "marvell wifi/bt fw local path"
	depends on BR2_PACKAGE_MRVL_WIFIBT
	help
	marvell wifi/bt fw local path
```

## buildroot/package/amlogic/mdnsresponder/Config.in
```kconfig
config BR2_PACKAGE_MDNSRESPONDER
	bool "mdnsresponder"
	default n
	help
	  The mDNSResponder project is a component of Bonjour,
	  Apple's initiative for zero-configuration networking.

	  http://developer.apple.com/networking/bonjour/index.html
```

## buildroot/package/amlogic/media_modules/Config.in
```kconfig
config BR2_PACKAGE_MEDIA_MODULES
	bool "media modules"
	depends on BR2_LINUX_KERNEL
	help
	  media drivers

config BR2_PACKAGE_MEDIA_MODLUES_VERSION
	string "media modules version"
	depends on BR2_PACKAGE_MEDIA_MODULES
	help
		match with kernel 4.9

config BR2_PACKAGE_MEDIA_MODLUES_GIT_VERSION
	string "media branch"
	depends on BR2_PACKAGE_MEDIA_MODULES
	help
		Branch for media

config BR2_PACKAGE_MEDIA_MODULES_GIT_REPO_URL
	string "media git"
	depends on BR2_PACKAGE_MEDIA_MODULES
	help
		media git

config BR2_PACKAGE_MEDIA_MODULES_LOCAL
	bool "media local"
	help
		media local

config BR2_PACKAGE_MEDIA_MODULES_LOCAL_PATH
	string "media local path"
	depends on BR2_PACKAGE_MEDIA_MODULES_LOCAL
	help
		media local path
```

## buildroot/package/amlogic/mediatek/Config.in
```kconfig
source "package/amlogic/mediatek/mtk7601/Config.in"
source "package/amlogic/mediatek/mtk7603/Config.in"
```

## buildroot/package/amlogic/meson-display/Config.in
```kconfig
config BR2_PACKAGE_MESON_DISPLAY
	bool "meson-display"
	select BR2_PACKAGE_JSON_C
	help
	  A help function for weston.

if BR2_PACKAGE_MESON_DISPLAY

config BR2_PACKAGE_MESON_WESTON_DRM_HELPER
	bool "meson-weston-drm-helper"
	depends on BR2_PACKAGE_MESON_DISPLAY
	help
	  A help function for weston.
endif
```

## buildroot/package/amlogic/meson-mali/Config.in
```kconfig
config BR2_PACKAGE_MESON_MALI
	bool "amlogic mali opengl provider"
	select BR2_PACKAGE_HAS_LIBGLES
	select BR2_PACKAGE_HAS_LIBEGL
	help
		amlogic mali400 opengl driver.

		http://openlinux.amlogic.com

config BR2_PACKAGE_MESON_MALI_MODEL
	string "mali hw model"

config BR2_PACKAGE_MESON_MALI_VERSION
	string "mali opengl version"

choice
        bool "choose a mali egl"
        default BR2_PACKAGE_MESON_MALI_WAYLAND_DRM_EGL if BR2_PACKAGE_WESTON_DRM
        default BR2_PACKAGE_MESON_MALI_WAYLAND_FBDEV_EGL if BR2_PACKAGE_WESTON_FBDEV && !BR2_PACKAGE_WESTON_DRM
        default BR2_PACKAGE_MESON_MALI_DUMMY_EGL if !BR2_PACKAGE_WESTON && BR2_PACKAGE_AML_MINIGBM
        default BR2_PACKAGE_MESON_MALI_FBDEV_EGL if !BR2_PACKAGE_WESTON && !BR2_PACKAGE_AML_MINIGBM
        help
                choose wayland_fbdev, wayland_drm, dummy or fbdev

config BR2_PACKAGE_MESON_MALI_WAYLAND_FBDEV_EGL
        bool "wayland with fbdev backend"
        select BR2_PACKAGE_HAS_LIBEGL_WAYLAND
        help
                support wayland api for app, backend is fbdev

config BR2_PACKAGE_MESON_MALI_WAYLAND_DRM_EGL
        bool "wayland with drm backend"
        select BR2_PACKAGE_HAS_LIBEGL_WAYLAND
        help
                support wayland api for app, backend is drm

config BR2_PACKAGE_MESON_MALI_DUMMY_EGL
        bool "dummy"
        help
                support dummy for chromeos to use

config BR2_PACKAGE_MESON_MALI_FBDEV_EGL
        bool "fbdev"
        help
                support fbdev for app to control

endchoice

config BR2_PACKAGE_PROVIDES_LIBEGL
	default "meson-mali" if BR2_PACKAGE_MESON_MALI

config BR2_PACKAGE_PROVIDES_LIBGLES
	default "meson-mali" if BR2_PACKAGE_MESON_MALI
```

## buildroot/package/amlogic/npu/Config.in
```kconfig
config BR2_PACKAGE_NPU
	bool "amlogic npu driver git repo"
	depends on BR2_LINUX_KERNEL	
	help
	  The git of amlogic npu driver git repo

config BR2_PACKAGE_NPU_VERSION
	string "amlogic npu branch" 
	depends on BR2_PACKAGE_NPU
	help
	  the branch of amlogic npu driver

config BR2_PACKAGE_NPU_GIT_URL
	string "amlogic npu driver git repo url"
	depends on BR2_PACKAGE_NPU
	help
	  the URL of amlogic npu driver git repo

config BR2_PACKAGE_NPU_CUSTOM_TARBALL_LOCATION
	string "amlogic npu driver tarball url"
	depends on BR2_PACKAGE_NPU
	help
	  the URL of amlogic npu driver

config BR2_PACKAGE_NPU_LOCAL
	bool "amlogic npu driver local"
	depends on BR2_PACKAGE_NPU
	help
		npu local

config BR2_PACKAGE_NPU_LOCAL_PATH
	string "amlogic npu local path"
	depends on BR2_PACKAGE_NPU_LOCAL
	depends on BR2_PACKAGE_NPU
	help
		npu local path

config BR2_PACKAGE_NPU_NBG_IMAGE
	string "amlogic npu NBG image"
	depends on BR2_PACKAGE_NPU
	help
		npu local NBG image
```

## buildroot/package/amlogic/qualcomm/qualcomm_wifi/Config.in
```kconfig
config BR2_PACKAGE_QUALCOMM_WIFI
	bool "qualcomm wifi"
	depends on BR2_LINUX_KERNEL
	help
	qualcomm wifi

config BR2_PACKAGE_QUALCOMM_QCA9377
	bool "qca9377 wifi"
	depends on BR2_LINUX_KERNEL
	depends on BR2_PACKAGE_QUALCOMM_WIFI
	help
	qualcomm qca9377 driver

config BR2_PACKAGE_QUALCOMM_QCA6174
	bool "qca6174 wifi"
	depends on BR2_LINUX_KERNEL
	depends on BR2_PACKAGE_QUALCOMM_WIFI
	help
	qualcomm qca6174 driver

config BR2_PACKAGE_QUALCOMM_WIFI_LOCAL_PATH
	string "qualcomm wifi drivers local path"
	depends on BR2_PACKAGE_QUALCOMM_WIFI
	help
	qualcomm wifi drivers local path

config BR2_PACKAGE_QUALCOMM_WIFIFWM_LOCAL_PATH
    string "qualcomm wifi fw local path"
    depends on BR2_PACKAGE_QUALCOMM_WIFI
    help
    wifi fw local path
```

## buildroot/package/amlogic/realtek/Config.in
```kconfig
source "package/amlogic/realtek/realtek_bt/Config.in"
source "package/amlogic/realtek/rtk8188eu/Config.in"
source "package/amlogic/realtek/rtk8189es/Config.in"
source "package/amlogic/realtek/rtk8189ftv/Config.in"
source "package/amlogic/realtek/rtk8192cu/Config.in"
source "package/amlogic/realtek/rtk8192du/Config.in"
source "package/amlogic/realtek/rtk8192es/Config.in"
source "package/amlogic/realtek/rtk8192eu/Config.in"
source "package/amlogic/realtek/rtk8723au/Config.in"
source "package/amlogic/realtek/rtk8723bs/Config.in"
source "package/amlogic/realtek/rtk8723bu/Config.in"
source "package/amlogic/realtek/rtk8723ds/Config.in"
source "package/amlogic/realtek/rtk8811au/Config.in"
source "package/amlogic/realtek/rtk8812au/Config.in"
source "package/amlogic/realtek/rtk8822bu/Config.in"
```

## buildroot/package/amlogic/realtek/realtek_bt/Config.in
```kconfig
config BR2_PACKAGE_REALTEK_BT
	bool "realtek bt for bluez"
	depends on BR2_LINUX_KERNEL
	help
	realtek bt

config BR2_PACKAGE_REALTEK_BT_LOCAL_PATH
	string "realtek bt codes local path"
	depends on BR2_PACKAGE_REALTEK_BT
	help
		realtek bt codes local path

config BR2_PACKAGE_REALTEK_UART_BT
	bool "realtek uart bt driver"
	depends on BR2_PACKAGE_REALTEK_BT
	help
	realtek uart bt driver

config BR2_PACKAGE_REALTEK_USB_BT
	bool "realtek usb bt driver"
	depends on BR2_PACKAGE_REALTEK_BT
	help
	realtek usb bt driver
```

## buildroot/package/amlogic/realtek/rtk8192du/Config.in
```kconfig
config BR2_PACKAGE_RTK8192DU
	bool "rtk8192du"
	depends on BR2_LINUX_KERNEL	
	help
	  rtk8192du driver

config BR2_PACKAGE_RTK8192DU_GIT_VERSION
	string "rtk8192du branch"
	depends on BR2_PACKAGE_RTK8192DU
	help
		Branch for rtk8192du	

config BR2_PACKAGE_RTK8192DU_GIT_REPO_URL
	string "rtk8192du git"
	depends on BR2_PACKAGE_RTK8192DU
	help
		rtk8192du git

config BR2_PACKAGE_RTK8192DU_LOCAL
	bool "rtk8192du local"
	help
		rtk8192du local

config BR2_PACKAGE_RTK8192DU_LOCAL_PATH
	string "rtk8192du local path"
	depends on BR2_PACKAGE_RTK8192DU_LOCAL
	help
		rtk8192du local path
```
