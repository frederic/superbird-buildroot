## buildroot/package/amlogic/fota/Config.in
```kconfig
config BR2_PACKAGE_FOTA
    bool "aml ota package"
    help
        aml ota process.
```

## buildroot/package/amlogic/hal_audio_service/Config.in
```kconfig
config BR2_PACKAGE_HAL_AUDIO_SERVICE
        bool "hal_audio_service"
	select BR2_PACKAGE_GRPC
	select BR2_PACKAGE_BOOST
	select BR2_PACKAGE_BOOST_SYSTEM
	select BR2_PACKAGE_BOOST_FILESYSTEM
	select BR2_PACKAGE_LIBLOG
        help
          Audio HAL server and client API
```

## buildroot/package/amlogic/helloworld/Config.in
```kconfig
config BR2_PACKAGE_HELLOWORLD
    bool "helloworld"
    help
      Hello World package says hello world to you
      see http://helloworld.com for more on this software
```

## buildroot/package/amlogic/ipc/Config.in
```kconfig
menu "ip camera"
source "package/amlogic/ipc/onvif_prebuilt/Config.in"
source "package/amlogic/ipc/onvif_srvd/Config.in"
source "package/amlogic/ipc/onvif_wsdd/Config.in"
source "package/amlogic/ipc/onvif_rtsp/Config.in"
source "package/amlogic/ipc/ipc-property/Config.in"
source "package/amlogic/ipc/ipc-webui/Config.in"
source "package/amlogic/ipc/ipc_autocap/Config.in"
source "package/amlogic/ipc/gst-amlion-allocator/Config.in"
source "package/amlogic/ipc/gst-plugin-amlimgcap/Config.in"
source "package/amlogic/ipc/gst-plugin-amloverlay/Config.in"
source "package/amlogic/ipc/gst-plugin-amlvconv/Config.in"
source "package/amlogic/ipc/gst-plugin-amlgdc/Config.in"
source "package/amlogic/ipc/gst-plugin-amlvenc/Config.in"
source "package/amlogic/ipc/gst-plugin-amlnn/Config.in"
source "package/amlogic/ipc/ptz_control/Config.in"
source "package/amlogic/ipc/gst-plugin-amlwebstreamserversink/Config.in"
config BR2_LINUX_KERNEL_IRCUT
	bool "amlogic ircut"
	default n
	help
	  amlogic ircut control
endmenu
```

## buildroot/package/amlogic/ipc/gst-amlion-allocator/Config.in
```kconfig
config BR2_PACKAGE_GST_AMLION_ALLOCATOR
	bool "Amlogic gstreamer ion allocator lib"
	select BR2_PACKAGE_AML_LIBION
	help
	  gstreamer 1.0 lib
```

## buildroot/package/amlogic/ipc/gst-plugin-amlgdc/Config.in
```kconfig
config BR2_PACKAGE_GST_PLUGIN_AMLGDC
	bool "Amlogic gstream1 gdc plugin"
	select BR2_PACKAGE_AML_LIBGE2D
	select BR2_PACKAGE_AML_LIBGDC
	select BR2_PACKAGE_GST_AMLION_ALLOCATOR
	help
	  gstreamer 1.0 plugins
```

## buildroot/package/amlogic/ipc/gst-plugin-amlimgcap/Config.in
```kconfig
config BR2_PACKAGE_GST_PLUGIN_AMLIMGCAP
	bool "Amlogic gstream1 image capture plugin"
	select BR2_PACKAGE_LIBJPEG
	select BR2_PACKAGE_AML_LIBGE2D
	select BR2_PACKAGE_GST_AMLION_ALLOCATOR
	help
	  gstreamer 1.0 plugins
```

## buildroot/package/amlogic/ipc/gst-plugin-amlnn/Config.in
```kconfig
config BR2_PACKAGE_GST_PLUGIN_AMLNN
  bool "gstream1 plugin NN"
  select BR2_PACKAGE_AML_NN_DETECT
  select BR2_PACKAGE_SQLITE
  select BR2_PACKAGE_AML_LIBGE2D
  select BR2_PACKAGE_LIBJPEG
  select BR2_PACKAGE_GST_AMLION_ALLOCATOR
	help
	  gstreamer 1.0 plugins
```

## buildroot/package/amlogic/ipc/gst-plugin-amloverlay/Config.in
```kconfig
config BR2_PACKAGE_GST_PLUGIN_AMLOVERLAY
	bool "Amlogic gstream1 text overlay plugin"
	select BR2_PACKAGE_DIRECTFB
	select BR2_PACKAGE_AML_LIBGE2D
	select BR2_PACKAGE_GST_AMLION_ALLOCATOR
	help
	  gstreamer 1.0 plugins
```

## buildroot/package/amlogic/ipc/gst-plugin-amlvconv/Config.in
```kconfig
config BR2_PACKAGE_GST_PLUGIN_AMLVCONV
	bool "Amlogic gstream1 video convert/resize plugin"
	select BR2_PACKAGE_AML_LIBGE2D
	select BR2_PACKAGE_GST_AMLION_ALLOCATOR
	help
	  gstreamer 1.0 plugins
```

## buildroot/package/amlogic/ipc/gst-plugin-amlvenc/Config.in
```kconfig
config BR2_PACKAGE_GST_PLUGIN_AMLVENC
	bool "gstream1 plugin amlogic x264/x265 encoder"
	help
	  gstreamer 1.0 plugins
	select BR2_PACKAGE_LIBVPCODEC if !BR2_PACKAGE_AML_SOC_USE_MULTIENC
	select BR2_PACKAGE_LIBVPHEVCODEC if !BR2_PACKAGE_AML_SOC_USE_MULTIENC
	select BR2_PACKAGE_LIBMULTIENC if BR2_PACKAGE_AML_SOC_USE_MULTIENC
	select BR2_PACKAGE_GST_AMLION_ALLOCATOR if BR2_PACKAGE_AML_SOC_USE_MULTIENC
	select BR2_PACKAGE_AML_LIBGE2D
```

## buildroot/package/amlogic/ipc/gst-plugin-amlwebstreamserversink/Config.in
```kconfig
config BR2_PACKAGE_GST_PLUGIN_AMLWEBSTREAMSERVERSINK
	bool "Amlogic Websocket streaming server sink"
	select BR2_PACKAGE_LIBWEBSOCKETS
	help
	  This package will enable a gstreamer plugin that can send GstBuffer to websocket client
```

## buildroot/package/amlogic/ipc/ipc-property/Config.in
```kconfig
config BR2_PACKAGE_IPC_PROPERTY
  bool "ipc property service and library"
  select BR2_PACKAGE_IPC_PROPERTY_JSON

  help
     include ipc property service and library

source "package/amlogic/ipc/ipc-property/ipc-property-json/Config.in"
```

## buildroot/package/amlogic/ipc/ipc-property/ipc-property-json/Config.in
```kconfig
config BR2_PACKAGE_IPC_PROPERTY_JSON
  bool "nlohmann json library"

  help
     the json library used by ipc property
```

## buildroot/package/amlogic/ipc/ipc-refapp/Config.in
```kconfig
config BR2_PACKAGE_IPC_REFAPP
	bool "ipc reference app"
	select BR2_PACKAGE_GSTREAMER1
	select BR2_PACKAGE_GST1_RTSP_SERVER
	select BR2_PACKAGE_GST1_PLUGINS_BASE_PLUGIN_APP
	select BR2_PACKAGE_GST1_PLUGINS_GOOD
	select BR2_PACKAGE_GST1_PLUGINS_GOOD_PLUGIN_MULTIFILE
	select BR2_PACKAGE_AML_NN_DETECT
	select BR2_PACKAGE_SQLITE
	select BR2_PACKAGE_LIBJPEG
	select BR2_PACKAGE_IPC_SDK
	select BR2_PACKAGE_IPC_PROPERTY
	select BR2_PACKAGE_LIBWEBSOCKETS
	select BR2_PACKAGE_LIBGPIOD
	select BR2_PACKAGE_LIBGPIOD_TOOLS
	help
	  ipc reference application
```

## buildroot/package/amlogic/ipc/ipc-sdk/Config.in
```kconfig
menu "ipc sdk"
config BR2_PACKAGE_IPC_SDK
	bool "ipc sdk"
	select BR2_PACKAGE_JPEG
	select BR2_PACKAGE_LIBJPEG
	select BR2_PACKAGE_LIBPNG
	select BR2_PACKAGE_ALSA_LIB
	select BR2_PACKAGE_FDK_AAC
	select BR2_PACKAGE_FREETYPE
	select BR2_PACKAGE_SPEEXDSP
	select BR2_PACKAGE_AML_LIBGE2D
	select BR2_PACKAGE_AML_LIBGDC
	select BR2_PACKAGE_AML_LIBION
	select BR2_PACKAGE_LIBVPCODEC if !BR2_PACKAGE_AML_SOC_USE_MULTIENC
	select BR2_PACKAGE_LIBVPHEVCODEC if !BR2_PACKAGE_AML_SOC_USE_MULTIENC
	select BR2_PACKAGE_LIBMULTIENC if BR2_PACKAGE_AML_SOC_USE_MULTIENC
	help
	  ipc sdk

config BR2_PACKAGE_IPC_SDK_BUILD_EXAMPLE
	bool "build with examples"
    select BR2_PACKAGE_GSTREAMER1
    select BR2_PACKAGE_GST1_RTSP_SERVER
    select BR2_PACKAGE_GST1_PLUGINS_BASE_PLUGIN_APP
    select BR2_PACKAGE_LIBWEBSOCKETS
    select BR2_PACKAGE_AML_NN_DETECT
	default n
	help
	  build with examples

config BR2_PACKAGE_IPC_SDK_BUILD_TEST
	bool "build test cases"
	select BR2_PACKAGE_GTEST
	default n
	help
	  build with test cases
endmenu
```

## buildroot/package/amlogic/ipc/ipc-system-service/Config.in
```kconfig
config BR2_PACKAGE_IPC_SYSTEM_SERVICE
  bool "ipc system service"

  help
     ipc system service
```

## buildroot/package/amlogic/ipc/ipc-webui/Config.in
```kconfig
config BR2_PACKAGE_IPC_WEBUI
  bool "ipc webui"
  select BR2_PACKAGE_GETTEXT
  select BR2_SYSTEM_ENABLE_NLS
  select BR2_PACKAGE_NGINX
  select BR2_PACKAGE_PHP
  select BR2_PACKAGE_PHP_SAPI_CGI
  select BR2_PACKAGE_PHP_SAPI_FPM
  select BR2_PACKAGE_PHP_EXT_SQLITE
  select BR2_PACKAGE_PHP_EXT_JSON
  select BR2_PACKAGE_PHP_EXT_GETTEXT

  help
     include ipc webui
```

## buildroot/package/amlogic/ipc/ipc_autocap/Config.in
```kconfig
config BR2_PACKAGE_IPC_AUTOCAP
  bool "auto capture pipeline of ipc" 
  select BR2_PACKAGE_GSTREAMER1
  select BR2_PACKAGE_GST1_PLUGINS_BASE
  select BR2_PACKAGE_GST1_PLUGINS_BASE_PLUGIN_APP
  select BR2_PACKAGE_GST1_PLUGINS_BASE_PLUGIN_RAWPARSE
  select BR2_PACKAGE_GST1_PLUGINS_GOOD
  select BR2_PACKAGE_GST1_LIBAV
  select BR2_PACKAGE_GST_PLUGIN_AMLVENC
  select BR2_PACKAGE_GST_PLUGIN_AMLVCONV

  help
     auto capture pipeline
```

## buildroot/package/amlogic/ipc/onvif_prebuilt/Config.in
```kconfig
config BR2_PACKAGE_ONVIF_PREBUILT
	bool "Apply/Generate ONVIF prebuilt"
	help
	  Apply/Generate ONVIF prebuilt package

if BR2_PACKAGE_ONVIF_PREBUILT

config ONVIF_PREBUILT_LEGACY
	bool "ONVIF prebuilt for legacy IPC Pipeline"
    default y if !BR2_PACKAGE_IPC_REFAPP

config BR2_PACKAGE_ONVIF_APPLY_PREBUILT
	bool "Apply ONVIF prebuilt"
    depends on !BR2_PACKAGE_ONVIF_SRVD

    #When enable prebuilt, we will not build ONVIF_SRVD, ONVIF_WSDD, ONVIF_RTSP, so we must select all these pacakge's dependent packages

    #Package for ONVIF_SRVD
    select BR2_PACKAGE_FFMPEG

    #Package for ONVIF_WSDD
    select BR2_PACKAGE_OPENSSL
    select BR2_PACKAGE_ZLIB

    #Package for IPC-WebUI
	select BR2_PACKAGE_GETTEXT
	select BR2_SYSTEM_ENABLE_NLS
	select BR2_PACKAGE_NGINX
	select BR2_PACKAGE_PHP
	select BR2_PACKAGE_PHP_SAPI_CGI
	select BR2_PACKAGE_PHP_SAPI_FPM
	select BR2_PACKAGE_PHP_EXT_SQLITE
	select BR2_PACKAGE_PHP_EXT_JSON
	select BR2_PACKAGE_PHP_EXT_GETTEXT
	select BR2_PACKAGE_IPC_SYSTEM_SERVICE

    #Package for ONVIF_RTSP only used in legacy pipeline
	select BR2_PACKAGE_LIBWEBSOCKETS                            if ONVIF_PREBUILT_LEGACY
	select BR2_PACKAGE_SQLITE                                   if ONVIF_PREBUILT_LEGACY
	select BR2_PACKAGE_PULSEAUDIO                               if ONVIF_PREBUILT_LEGACY
	select BR2_PACKAGE_CA_CERTIFICATES                          if ONVIF_PREBUILT_LEGACY
	select BR2_PACKAGE_GSTREAMER1                               if ONVIF_PREBUILT_LEGACY
	select BR2_PACKAGE_GST1_RTSP_SERVER                         if ONVIF_PREBUILT_LEGACY
	select BR2_PACKAGE_GST1_LIBAV                               if ONVIF_PREBUILT_LEGACY
	select BR2_PACKAGE_GST1_PLUGINS_BASE_PLUGIN_ALSA            if ONVIF_PREBUILT_LEGACY
	select BR2_PACKAGE_GST1_PLUGINS_BASE_PLUGIN_AUDIOTESTSRC    if ONVIF_PREBUILT_LEGACY
	select BR2_PACKAGE_GST1_PLUGINS_BASE_PLUGIN_VIDEORATE       if ONVIF_PREBUILT_LEGACY
	select BR2_PACKAGE_GST1_PLUGINS_GOOD                        if ONVIF_PREBUILT_LEGACY
	select BR2_PACKAGE_GST1_PLUGINS_GOOD_PLUGIN_V4L2            if ONVIF_PREBUILT_LEGACY
	select BR2_PACKAGE_GST1_PLUGINS_GOOD_PLUGIN_LAW             if ONVIF_PREBUILT_LEGACY
	select BR2_PACKAGE_GST1_PLUGINS_GOOD_PLUGIN_LAME            if ONVIF_PREBUILT_LEGACY
	select BR2_PACKAGE_GST1_PLUGINS_BAD                         if ONVIF_PREBUILT_LEGACY
	select BR2_PACKAGE_GST1_PLUGINS_BAD_PLUGIN_MPEGTSMUX        if ONVIF_PREBUILT_LEGACY
	select BR2_PACKAGE_LIBVPCODEC if BR2_PACKAGE_AML_SOC_FAMILY_NAME != "C1" && ONVIF_PREBUILT_LEGACY
	select BR2_PACKAGE_LIBVPHEVCODEC if BR2_PACKAGE_AML_SOC_FAMILY_NAME != "C1" && ONVIF_PREBUILT_LEGACY
	select BR2_PACKAGE_LIBMULTIENC if BR2_PACKAGE_AML_SOC_FAMILY_NAME = "C1" && ONVIF_PREBUILT_LEGACY
	select BR2_PACKAGE_AML_NN_DETECT                            if ONVIF_PREBUILT_LEGACY
	select BR2_PACKAGE_AML_LIBGE2D                              if ONVIF_PREBUILT_LEGACY
	select BR2_PACKAGE_AML_LIBGDC                               if ONVIF_PREBUILT_LEGACY

	help
	  Use ONVIF prebuilt package

config BR2_PACKAGE_ONVIF_GENERATE_PREBUILT
	bool "Generate ONVIF prebuilt"
    depends on BR2_PACKAGE_ONVIF_SRVD
    depends on ((BR2_PACKAGE_ONVIF_RTSP && ONVIF_PREBUILT_LEGACY) || ! ONVIF_PREBUILT_LEGACY)
    depends on BR2_PACKAGE_IPC_WEBUI

	help
	  Generate ONVIF prebuilt package
endif
```

## buildroot/package/amlogic/ipc/onvif_rtsp/Config.in
```kconfig
config BR2_PACKAGE_ONVIF_RTSP
  bool "rtsp server for onvif"
  select BR2_PACKAGE_GSTREAMER1
  select BR2_PACKAGE_GST1_PLUGINS_BASE_PLUGIN_ALSA
  select BR2_PACKAGE_GST1_PLUGINS_BASE_PLUGIN_AUDIOTESTSRC
  select BR2_PACKAGE_GST1_PLUGINS_BASE_PLUGIN_VIDEORATE
  select BR2_PACKAGE_GST1_PLUGINS_GOOD
  select BR2_PACKAGE_GST1_PLUGINS_GOOD_PLUGIN_V4L2
  select BR2_PACKAGE_GST1_PLUGINS_GOOD_PLUGIN_LAW
  select BR2_PACKAGE_GST1_PLUGINS_GOOD_PLUGIN_LAME
  select BR2_PACKAGE_GST1_PLUGINS_BAD
  select BR2_PACKAGE_GST1_PLUGINS_BAD_PLUGIN_MPEGTSMUX
  select BR2_PACKAGE_GST1_RTSP_SERVER
  select BR2_PACKAGE_GST1_LIBAV
  select BR2_PACKAGE_GST_PLUGIN_AMLOVERLAY
  select BR2_PACKAGE_GST_PLUGIN_AMLVENC
  select BR2_PACKAGE_GST_PLUGIN_AMLNN
  select BR2_PACKAGE_GST_PLUGIN_AMLIMGCAP
  select BR2_PACKAGE_GST_PLUGIN_AMLVCONV
  select BR2_PACKAGE_GST_PLUGIN_AMLGDC
  select BR2_PACKAGE_GST_PLUGIN_AMLWEBSTREAMSERVERSINK
  select BR2_PACKAGE_IPC_WEBUI
  select BR2_PACKAGE_IPC_AUTOCAP if BR2_PACKAGE_AML_SOC_FAMILY_NAME = "C1"

  help
     rtsp server
```

## buildroot/package/amlogic/ipc/onvif_srvd/Config.in
```kconfig
config BR2_PACKAGE_ONVIF_SRVD
  bool "onvif server package"
  select BR2_PACKAGE_ONVIF_WSDD
  select BR2_PACKAGE_IPC_PROPERTY
  select BR2_PACKAGE_FFMPEG
  help
     onvif server
```

## buildroot/package/amlogic/ipc/onvif_wsdd/Config.in
```kconfig
config BR2_PACKAGE_ONVIF_WSDD
  bool "onvif wsdd package"
  help
     onvif wsdd server
```
