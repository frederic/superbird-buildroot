## buildroot/package/amlogic/realtek/rtk8723au/Config.in
```kconfig
config BR2_PACKAGE_RTK8723AU
	bool "rtk8723au"
	depends on BR2_LINUX_KERNEL	
	help
	  rtk8723au driver

config BR2_PACKAGE_RTK8723AU_GIT_VERSION
	string "rtk8723au branch"
	depends on BR2_PACKAGE_RTK8723AU
	help
		Branch for rtk8723au

config BR2_PACKAGE_RTK8723AU_GIT_REPO_URL
	string "rtk8723au git"
	depends on BR2_PACKAGE_RTK8723AU
	help
		rtk8723au git

config BR2_PACKAGE_RTK8723AU_LOCAL
	bool "rtk8723au local"
	help
		rtk8723au local

config BR2_PACKAGE_RTK8723AU_LOCAL_PATH
	string "rtk8723au local path"
	depends on BR2_PACKAGE_RTK8723AU_LOCAL
	help
		rtk8723au local path
```

## buildroot/package/amlogic/realtek/rtk8723ds/Config.in
```kconfig
config BR2_PACKAGE_RTK8723DS
	bool "rtk8723DS"
	depends on BR2_LINUX_KERNEL	
	help
	  rtk8723DS driver

config BR2_PACKAGE_RTK8723DS_GIT_VERSION
	string "rtk8723DS branch"
	depends on BR2_PACKAGE_RTK8723DS
	help
		Branch for rtk8723DS

config BR2_PACKAGE_RTK8723DS_GIT_REPO_URL
	string "rtk8723DS git"
	depends on BR2_PACKAGE_RTK8723DS
	help
		rtk8723DS git

config BR2_PACKAGE_RTK8723DS_LOCAL
	bool "rtk8723DS local"
	help
		rtk8723DS local

config BR2_PACKAGE_RTK8723DS_LOCAL_PATH
	string "rtk8723DS local path"
	depends on BR2_PACKAGE_RTK8723DS_LOCAL
	help
		rtk8723DS local path

config BR2_PACKAGE_RTK8723DS_STANDALONE
	bool "standalone kernel module"
	depends on BR2_PACKAGE_RTK8723DS
	help
	  compile ko directly
```

## buildroot/package/amlogic/realtek/rtk8822bu/Config.in
```kconfig
config BR2_PACKAGE_RTK8822BU
	bool "rtk8822bu"
	depends on BR2_LINUX_KERNEL	
	help
	  rtk8822bu driver

config BR2_PACKAGE_RTK8822BU_GIT_VERSION
	string "rtk8822bu branch"
	depends on BR2_PACKAGE_RTK8822BU
	help
		Branch for rtk8822bu	

config BR2_PACKAGE_RTK8822BU_GIT_REPO_URL
	string "rtk8822bu git"
	depends on BR2_PACKAGE_RTK8822BU
	help
		rtk8822bu git

config BR2_PACKAGE_RTK8822BU_LOCAL
	bool "rtk8822bu local"
	help
		rtk8822bu local

config BR2_PACKAGE_RTK8822BU_LOCAL_PATH
	string "rtk8822bu local path"
	depends on BR2_PACKAGE_RTK8822BU_LOCAL
	help
		rtk8822bu local path

config BR2_PACKAGE_RTK8822BU_STANDALONE
	bool "standalone kernel module"
	depends on BR2_PACKAGE_RTK8822BU
	help
	  compile ko directly
```

## buildroot/package/amlogic/realtek/rtk8822cs/Config.in
```kconfig
config BR2_PACKAGE_RTK8822CS
	bool "rtk8822cs"
	depends on BR2_LINUX_KERNEL
	help
	  rtk8822cs driver

config BR2_PACKAGE_RTK8822CS_GIT_VERSION
	string "rtk8822cs branch"
	depends on BR2_PACKAGE_RTK8822CS
	help
		Branch for rtk8822cs

config BR2_PACKAGE_RTK8822CS_GIT_REPO_URL
	string "rtk8822cs git"
	depends on BR2_PACKAGE_RTK8822CS
	help
		rtk8822cs git

config BR2_PACKAGE_RTK8822CS_LOCAL
	bool "rtk8822cs local"
	help
		rtk8822cs local

config BR2_PACKAGE_RTK8822CS_LOCAL_PATH
	string "rtk8822cs local path"
	depends on BR2_PACKAGE_RTK8822CS_LOCAL
	help
		rtk8822cs local path

config BR2_PACKAGE_RTK8822CS_STANDALONE
	bool "standalone kernel module"
	depends on BR2_PACKAGE_RTK8822CS
	help
	  compile ko directly
```

## buildroot/package/amlogic/slt/Config.in
```kconfig
# SLT Package
config BR2_PACKAGE_SLT
    bool  "Socket SLT"
    help
    SLT package collection

if BR2_PACKAGE_SLT
source "package/amlogic/slt/slt-isp/Config.in"
source "package/amlogic/slt/slt-gpu/Config.in"
source "package/amlogic/slt/slt-nn/Config.in"
endif
```

## buildroot/package/amlogic/slt/slt-gpu/Config.in
```kconfig
config BR2_PACKAGE_SLT_GPU
    bool "SLT for GPU"
    help
        SLT program for GPU
    depends on BR2_PACKAGE_GPU
```

## buildroot/package/amlogic/slt/slt-isp/Config.in
```kconfig
config BR2_PACKAGE_SLT_ISP
    bool "SLT for ISP"
    help
        SLT program for ISP
    depends on BR2_PACKAGE_ARM_ISP
```

## buildroot/package/amlogic/slt/slt-nn/Config.in
```kconfig
config BR2_PACKAGE_SLT_NN
    bool "SLT for NN"
    help
        SLT program for NN
    depends on BR2_PACKAGE_NPU
```

## buildroot/package/amlogic/system_control/Config.in
```kconfig
config BR2_PACKAGE_SYSTEM_CONTROL
    bool "aml system control"
    depends on BR2_LINUX_KERNEL
    select AML_UBOOTENV
    help
        system control
```

## buildroot/package/amlogic/tdk/Config.in
```kconfig
config BR2_PACKAGE_TDK
	bool "tdk driver and lib"
	depends on BR2_LINUX_KERNEL
	help
	  tdk driver and lib

config BR2_PACKAGE_TDK_GIT_VERSION
	string "tdk driver and lib branch"
	depends on BR2_PACKAGE_TDK
	help
		Branch for tdk driver and lib git

config BR2_PACKAGE_TDK_GIT_REPO_URL
	string "tdk driver and lib git"
	depends on BR2_PACKAGE_TDK
	help
		tdk driver and lib git
```

## buildroot/package/amlogic/test_tools/Config.in
```kconfig
config BR2_PACKAGE_TEST_TOOLS
	bool  "test tools"
	help
		function test for cpu & ddr & nand & emmc & usb & gpio & IR & wifi...
```

## buildroot/package/amlogic/uvc-gadget/Config.in
```kconfig
config BR2_PACKAGE_UVC_GADGET
    bool "aml uvc_gadget"
    depends on BR2_LINUX_KERNEL
    select BR2_PACKAGE_IPC_SDK
    help
        uvc_gadget

config BR2_PACKAGE_UVC_GADGET_USE_NN
    bool "aml uvc_gadget build nn"
    select BR2_PACKAGE_AML_NN_DETECT
    select BR2_PACKAGE_SQLITE
    select BR2_PACKAGE_LIBJPEG
    select BR2_PACKAGE_IPC_PROPERTY
    default n
    help
        uvc_gadget build nn depend
```

## buildroot/package/amlogic/web_ui_wifi/Config.in
```kconfig
config BR2_PACKAGE_WEB_UI_WIFI
	bool "web_ui_wifi"
	help
		All  files for web ui config wifi
```

## buildroot/package/amlogic/westeros/Config.in
```kconfig
config BR2_PACKAGE_WESTEROS
	bool "westeros"
	select BR2_PACKAGE_WAYLAND
	select BR2_PACKAGE_WAYLAND_PROTOCOLS
	select BR2_PACKAGE_LIBXKBCOMMON
	select BR2_PACKAGE_XKEYBOARD_CONFIG
	select BR2_PACKAGE_WESTEROS_SIMPLEBUFFER
	select BR2_PACKAGE_WESTEROS_SIMPLESHELL
	select BR2_PACKAGE_WESTEROS_SOC
	select BR2_PACKAGE_WESTEROS_SINK
	help

	  Westeros is an open source Wayland compositor library that allows
          applications to create Wayland displays including embedded
          Wayland displays
          http://wayland.freedesktop.org/

if BR2_PACKAGE_WESTEROS
	source "package/amlogic/westeros-simpleshell/Config.in"
	source "package/amlogic/westeros-simplebuffer/Config.in"
	source "package/amlogic/westeros-soc/Config.in"
	source "package/amlogic/westeros-sink/Config.in"
endif #BR2_PACKAGE_WESTEROS
```

## buildroot/package/cypress_wifi/Config.in
```kconfig
config BR2_PACKAGE_CYPRESS_WIFI
	bool "cypress_wifi"
	default n
	depends on BR2_LINUX_KERNEL
	help
	  cypress wifi driver

config BR2_PACKAGE_CYPRESS_WIFI_GIT_VERSION
	string "cypress_wifi branch"
	depends on BR2_PACKAGE_CYPRESS_WIFI
	help
		Branch for cypress_wifi

config BR2_PACKAGE_CYPRESS_WIFI_GIT_REPO_URL
	string "cypress_wifi git"
	depends on BR2_PACKAGE_CYPRESS_WIFI
	help
		cypress_wifi git

config BR2_PACKAGE_CYPRESS_WIFI_LOCAL
	bool "cypress_wifi local"
	help
		cypress_wifi local

config BR2_PACKAGE_CYPRESS_WIFI_LOCAL_PATH
	string "cypress_wifi local path"
	depends on BR2_PACKAGE_CYPRESS_WIFI_LOCAL
	help
		cypress_wifi local path

config BR2_PACKAGE_CYPRESS_WIFI_SDIO_VERSION
	string "cypress_wifi sdio build version"
	depends on BR2_PACKAGE_CYPRESS_WIFI_LOCAL
	help
		cypress_wifi sdio build version

config BR2_PACKAGE_CYPRESS_WIFI_PCI_VERSION
	string "cypress_wifi pci build version"
	depends on BR2_PACKAGE_CYPRESS_WIFI_LOCAL
	help
		cypress_wifi pci build version

config BR2_PACKAGE_CYPRESS_WIFI_USB_VERSION
	string "cypress_wifi usb build version"
	depends on BR2_PACKAGE_CYPRESS_WIFI_LOCAL
	help
		cypress_wifi usb build version

config BR2_PACKAGE_CYPRESS_WIFI_STANDALONE
	bool "standalone kernel module"
	depends on BR2_PACKAGE_CYPRESS_WIFI
	help
	  compile ko directly
```

## buildroot/package/dhd_priv/Config.in
```kconfig
config BR2_PACKAGE_DHD_PRIV
	bool  "dhd private tool"
	help
        a broadcom wifi tool
```

## buildroot/package/gstreamer1/gst1-libav/Config.in
```kconfig
config BR2_PACKAGE_GST1_LIBAV
	bool "gst1-libav"
	select BR2_PACKAGE_GST1_PLUGINS_BASE
	help
	  GStreamer plugin (formerly gst-ffmpeg).

	  This package contains GStreamer plugins based on
	  the libav project.

	  The codecs, muxers, bitstreams and filters to build can be
	  selected in the ffmpeg package.

	  http://gstreamer.freedesktop.org/

config BR2_PACKAGE_GST1_LIBAV_WITHOUT_FFMMPEG
       bool "gst1-libav-without-ffmpeg"
       default n
       help
           config-ffmpeg

config BR2_PACKAGE_GST1_LIBAV_WITH_FFMMPEG
       bool "gst1-libav-ffmpeg"
       default y if !BR2_PACKAGE_GST1_LIBAV_WITHOUT_FFMMPEG
       depends on BR2_PACKAGE_FFMPEG_ARCH_SUPPORTS
       select BR2_PACKAGE_FFMPEG
       select BR2_PACKAGE_FFMPEG_SWSCALE
       help
           This package contains GStreamer plugins based on
	   the libav project.
```

## buildroot/package/h264bitstream/Config.in
```kconfig
config BR2_PACKAGE_H264BITSTREAM
	bool "h264bitstream"
	#depends on BR2_PACKAGE_HAS_UDEV
	#depends on BR2_TOOLCHAIN_HAS_THREADS_NPTL
	#select BR2_PACKAGE_LIBUSB
	#select BR2_PACKAGE_LIBGUDEV
	select BR2_PACKAGE_LIBICONV if !BR2_ENABLE_LOCALE
	# runtime UTF conversion support
	select BR2_TOOLCHAIN_GLIBC_GCONV_LIBS_COPY if BR2_TOOLCHAIN_USES_GLIBC
	help
	  h264bitstream is a self-contained library for manipulating h264 bit streams
	  https://github.com/aizvorski/h264bitstream

#comment "hidapi needs udev /dev management and a toolchain w/ NPTL threads"
#	depends on !BR2_TOOLCHAIN_HAS_THREADS_NPTL || !BR2_PACKAGE_HAS_UDEV
```

## buildroot/package/initscripts/Config.in
```kconfig
config BR2_PACKAGE_INITSCRIPTS
	bool
	help
	  The basics startup scripts for both SysV and Busybox

config BR2_PACKAGE_INITSCRIPTS_720P
	bool "fb size 720p"
	default n
	help
	  set directfb mode by framebuffer size
```

## buildroot/package/intltool/Config.in
```kconfig
config BR2_PACKAGE_INTLTOOL
	bool "intltool"
	select BR2_PACKAGE_GETTEXT if BR2_NEEDS_GETTEXT
	select BR2_PACKAGE_LIBXML_PARSER_PERL
	# Hide from configuration as we only support the host package
	# for the moment

	help
	  Utility scripts for internationalizing XML
	  http://www.freedesktop.org/wiki/Software/intltool
```

## buildroot/package/kmscube/Config.in
```kconfig
config BR2_PACKAGE_KMSCUBE
	bool "mesa-kmscube"
	depends on BR2_PACKAGE_LIBDRM
	depends on BR2_PACKAGE_MESON_MALI
	help
          Example KMS/GBM/EGL application

          https://gitlab.freedesktop.org/mesa/kmscube/
```

## buildroot/package/krb5/Config.in
```kconfig
config BR2_PACKAGE_KRB5
	bool "krb5"
	depends on BR2_USE_MMU # fork()
	help
	  KRB5 is the MIT Kerberos Version 5 implementation

	  Kerberos is a network authentication protocol. It is designed
	  to provide strong authentication for client/server
	  applications by using secret-key cryptography. A free
	  implementation of this protocol is available from the
	  Massachusetts Institute of Technology.

	  http://web.mit.edu/Kerberos
```

## buildroot/package/libgmime/Config.in
```kconfig
config BR2_PACKAGE_LIBGMIME
	bool "libgmime"
	select BR2_PACKAGE_LIBGPG_ERROR
	select BR2_PACKAGE_LIBTOOL
	help
		GMime is a C/C++ library which may be used for the creation and parsing of
	   	messages using the Multipurposei
		Internet Mail Extension (MIME) as defined by numerous IETF specifications.
```

## buildroot/package/libsoundtouch/Config.in
```kconfig
config BR2_PACKAGE_LIBSOUNDTOUCH
	bool "libsoundtouch"
	depends on BR2_INSTALL_LIBSTDCPP
	help
	  SoundTouch is an open-source audio processing library for
	  changing the Tempo, Pitch and Playback Rates of audio streams
	  or audio files.

	  http://www.surina.net/soundtouch

config BR2_PACKAGE_LIBSOUNDTOUCHCWRAP
	bool "libsoundtouchcwrap"
	depends on BR2_PACKAGE_LIBSOUNDTOUCH
	help
       Provide a C wrapper for C++ SoundTouch library, so it can be dlopened in C code

comment "libsoundtouch needs a toolchain w/ C++"
	depends on !BR2_INSTALL_LIBSTDCPP
```
