## multimedia/v4l2-uvm-test/Config.in
```kconfig
config BR2_PACKAGE_V4L2_UVM_TEST
        bool "v4l2_UVM_test"
        select BR2_PACKAGE_LIBDRM
        select BR2_PACKAGE_FFMPEG
        help
          Test application for v4l2 decoder using DRM-GEM UVM buffer.
          http://openlinux.amlogic.com
```

## vendor/amlogic/external/platinum/Config.in
```kconfig
menu "platinum applications"
source "../vendor/amlogic/external/platinum/upnp-app/Config.in"
endmenu
```

## vendor/amlogic/external/platinum/upnp-app/Config.in
```kconfig
config BR2_PACKAGE_UPNP_APP
        bool "upnp-player"
        depends on BR2_PACKAGE_GSTREAMER1
        help
          amlogic dlna player.

          http://openlinux.amlogic.com
```

## vendor/amlogic/system_control/Config.in
```kconfig
config BR2_PACKAGE_SYSTEM_CONTROL
    bool "aml system control"
    depends on BR2_LINUX_KERNEL
    help
        system control
```
